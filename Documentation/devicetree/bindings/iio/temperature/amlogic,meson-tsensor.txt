## arch/arm64/boot/dts/nvidia/Documentation/devicetree/bindings/platform/tegra/tegra-aon-ivc.txt
```
NVIDIA Tegra SPE/AON aux CPU, with communication via the "IVC" IPC protocol.

AON is an aux CPU which communicates with CCPLEX over IVC.

The AON FW implements IVC, and uses HSP shared mailbox IRQs as part of IVC
notification. The AON FW expects AST regions 0/1 are already set up for the
AON to access SYSRAM and GSC carveout in DRAM. It configures the AST region
2 to point at DRAM IVC carveout upon receiving the carveout address and size
from CCPLEX.
 * Carveout address: SMMU IOVA of the IPC region
 * Slave address: Some hard coded location that SPE FW knows. Ex: 0x80000000

== AON top-level node ==

The AON core is represented by the top-level node.

Required properties:
- compatible: Should be "nvidia,tegra186-aon" for T18x.
- reg: Address entry of AON shared semaphore.
- nvidia,hsp-shared-mailbox: <HSP-phandle mailbox-number>
  * HSP is a set of HW synchronization primitives used in Tegra to allow
    multiple processors to share resources and communicate together.
  * hsp-shared-mailbox property points to shared mailbox pair used for
    IVC notification.
  * HSP-phandle points to the Tegra HSP platform device.
  * mailbox-number refers to the consumer side mailbox. The producer side
    mailbox is the other one in the same (even-odd) pair.
    Ex: consumer_mbox = 2; producer_mbox = (consumer_mbox ^ 1);
    A HSP irq notification allows a set of source agents in Tegra to request
    the attention of specified target agent. In general the agents are
    processors and irq is used as part of an IPC protocol notification.
  * For more HSP details, refer: ./tegra-hsp.txt.
- nvidia,ivc-carveout-base-ss: property holds the hsp shared semaphore index
  used to send the ivc carveout base address to the AON fw.
- nvidia,ivc-carveout-size-ss: property holds the hsp shared semaphore index
  used to send the ivc carveout size to the AON fw.
- nvidia,ivc-dbg-enable-ss: property holds the hsp shared semaphore index
  used to send the ivc channel id for debug to the AON fw.
- nvidia,ivc-notify-ss: property holds the hsp shared semaphore index used
  to send the ivc channels that are to be notified.

Mailbox controller properties:
- #mbox-cells
  Should be set to <1>.
The IVC channels are represented as mailbox channels.
Hence, this binding makes use of the mailbox binding at ../../mailbox/mailbox.txt.

SMMU properties:
- #stream-id-cells
  Should be set to <1>.
This property is used to configure the SMMU to SPE IVC carveout in DRAM.

== AON sub nodes ==

* ivc-channels
Contains a sub-node for each IVC channel implemented by the AON.
For IVC channel details, please refer: ./tegra-ivc-channel.txt

Possible example:

aon: aon@c160000 {
	compatible = "nvidia,tegra186-aon";
	reg = <0x0 0x0c1a0000 0x0 0x20000>; /* AON shared semaphore */
	#mbox-cells = <1>;
	#stream-id-cells = <1>;
	iommus = <&smmu TEGRA_SID_AON>;
	nvidia,hsp-shared-mailbox = <&aon_hsp 2>;
	nvidia,hsp-shared-mailbox-names = "ivc-pair";
	nvidia,ivc-carveout-base-ss = <0>;
	nvidia,ivc-carveout-size-ss = <1>;
	nvidia,ivc-notify-ss = <1>;
	nvidia,ivc-dbg-enable-ss = <0>;

	ivc-channels@80000000 {
		#address-cells = <1>;
		#size-cells = <0>;

		ivc_aon_echo@0 {
			reg = <0x0000>, <0x1000>;
			reg-names = "rx", "tx";
			nvidia,frame-count = <16>;
			nvidia,frame-size = <64>;
		};
		ivc_aon_aondbg@480 {
			reg = <0x0480>, <0x1480>;
			reg-names = "rx", "tx";
			nvidia,frame-count = <2>;
			nvidia,frame-size = <128>;
		};
	};
};
```

## arch/arm64/boot/dts/nvidia/Documentation/devicetree/bindings/platform/tegra/tegra_cbb.txt
```
NVIDIA Tegra19x CBB NOC driver
==================================

This document defines the device-specific binding for Tegra19x CBB NOC driver.

Control Backbone(CBB) comprises of the physical path from a master(or initiator)
to a slave’s(or target) register configuration space(Target’s Control Space).
CBB has multiple hierarchical sub-NOC's(Network-on-Chip) and stretches to
various master and slave partitions using different bridges like AXIP2P,AXI2APB.

This driver handles errors from master clusters with NOC(AON, SCE, RCE, BPMP,
CV) and CBB central NOC in case of failed transaction in a bridge within CBB.
Access issuing master is informed about error using SError or interrupts.
For access from CCPLEX master, SError is delivered to all cores in master.
For access by other masters, issuing master gets abort and CCPLEX receives
secure or nonsecure interrupt depending on error type.
 - secure_intr: SEC(firewall) & SLV errors.
 - nonsecure_intr: TMO & DEC errors.

The driver prints relevant debug information like Error Code, Error Description,
Master, Address, AXI ID, Cache, Protection, Security Group etc using NOC Error
Logger registers on receiving SError or interrupt. For APB slaves, it prints
additional information about exact error cause and AXI2APB bridge giving error.


Required properties for NOC's:
- compatible: Should be per NOC "nvidia,tegra194-CBB-NOC"
- reg: Physical base address and length of registers
- interrupts: irq numbers of secure and nonsecure interrupts for the NOC error

Example:
========
	cbb-noc@2300000 {
		compatible = "nvidia,tegra194-CBB-NOC";
		reg = <0x0 0x02300000 0x0 0x1000>;
		interrupts = <0 230 4>, <0 231 4>;
		status = "okay";
	};

	aon-noc@C600000 {
		compatible = "nvidia,tegra194-AON-NOC";
		reg = <0x0 0xC600000 0x0 0x1000>;
		interrupts = <0 260 4>, <0 172 4>;
		status = "okay";
	};

	bpmp-noc@D600000 {
		compatible = "nvidia,tegra194-BPMP-NOC";
		reg = <0x0 0xD600000 0x0 0x1000>;
		interrupts = <0 262 4>, <0 174 4>;
		status = "okay";
	};

	rce-noc@BE00000 {
		compatible = "nvidia,tegra194-RCE-NOC";
		reg = <0x0 0xBE00000 0x0 0x1000>;
		interrupts = <0 259 4>, <0 175 4>;
		status = "okay";
	};

	sce-noc@B600000 {
		compatible = "nvidia,tegra194-SCE-NOC";
		reg = <0x0 0xB600000 0x0 0x1000>;
		interrupts = <0 261 4>, <0 173 4>;
		status = "okay";
	};

	cv-noc@14040000 {
		compatible = "nvidia,tegra194-CV-NOC";
		reg = <0x0 0 0x14040000 0x0 0x1000>;
		interrupts = <0 238 4>, <0 239 4>;
		status = "okay";
	};

Required properties for AXI2APB bridge:
- compatible: Should be "nvidia,tegra194-AXI2APB-bridge"
- reg: Physical base address and length of registers for all bridges

Example:
========
	axi2apb@2390000 {
		compatible = "nvidia,tegra194-AXI2APB-bridge";
		reg = <0x0 0x02390000 0x0 0x1000>,
		    <0x0 0x023A0000 0x0 0x1000>,
		    <0x0 0x023B0000 0x0 0x1000>,
		    <0x0 0x023C0000 0x0 0x1000>,
		    <0x0 0x023D0000 0x0 0x1000>,
		    <0x0 0x023E0000 0x0 0x1000>;
		status = "disabled";
	};
```

## arch/arm64/boot/dts/nvidia/Documentation/devicetree/bindings/thermal/tegra-skin.txt
```
Tegra-skin driver binding
-------------------------
NVIDIA tegra skin driver estimates skin temperature of tegra devices. This
virtual sensor(s) is registered to Generic Thermal Framework and has the option
to expose estimated skin temperature value(s) at multiple points (hotspots) on
the device.

/tegra_skin_thermal
 Required properties:
	- compatible:
		- should be "nvidia,tegra-skin-thermal"
	- #thermal-sensor-cells: should be 1. See ./thermal.txt for details.
 Optional properties:
	- io-channels: iio channels that the driver is expected to poll
	- io-channel-names: channel names in the order of io-channels that the
		driver is expected to poll
	- skin-sensor@<N>:
		- See below for details
	- power_feature@<N>:
		- See below for details
	- hotspot@<N>:
		- See below for details


/tegra_skin_thermal/skin-sensor@<N>
 Required properties:
	- thermal-sensor
		- should match the thermal sensor id used in the thermal-sensors
		attribute in the thermal-zone definition.
		For Example, in thermal zone definition if
		thermal-sensors = <&{/tegra_skin_thermal} 2>;
		then thermal-sensor should be 2.
	- hotspot-list
		- comma separated phandle list to hotspot definition. The sensor
		would return the max temperature reported by each hotspot.
		See below for hotspot configuration.

/tegra_skin_thermal/hotspot@<N>
 Define the attributes of each hotspot
 Required properties
	- power-features-list: comma separated phandle, arguments list to
		 power feature definition. The number of arguments is defined by
		 #power-feature-cells of the respective power feature.
	- offset: offset of hotspot
	- rc_k: damping coefficient of hotspot
	- reference-sensor: reference sensor used by the hotspot estimator

/tegra_skin_thermal/power_feature@<N>
 Required properties
	- type: could be IIO_SUBSYSTEM, BACKLIGHT_BRIGHTNESS
	- rc_k: damping coefficient for the power_feature
	- resistance: thermal resitance of the power feature
	- #power-feature-cells: number of arguments for the power-feature in
				power-features-list

/tegra_skin_thermal/skin-sensor@<N> is registered as a Thermal Zone using the
thermal framework. See ./thermal.txt for more details.



Example:-

#include <dt-bindings/thermal/thermal.h>
#include <dt-bindings/thermal/tegra186-skin-thermal.h>
#include <dt-bindings/iio/meter/ina3221x.h>

/ {
	tegra_skin_thermal {
		compatible = "nvidia,tegra-skin-thermal";
		#thermal-sensor-cells = <1>;

		io-channels = <&ina3221x_40 INA3221_CHAN_INDEX(0, VOLTAGE, NORMAL)>,
				<&ina3221x_40 INA3221_CHAN_INDEX(0, CURRENT, NORMAL)>,
				<&ina3221x_41 INA3221_CHAN_INDEX(0, POWER, NORMAL)>;
		io-channel-names = "gpu-voltage", "gpu-current", "vddin-power";

		pf_backlight: power_feature@0 {
			#power-feature-cells = <1>;
			type = <BACKLIGHT_BRIGHTNESS>;
			rc_k = <1>;
			resistance = <1>;
		};

		pf_iio_ina3221: power_feature@1 {
			#power-feature-cells = <1>;
			type = <IIO_SUBSYSTEM>;
			rc_k = <1>;
			resistance = <1>;
		};

		hs0: hotspot@0 {
			power-features-list = <&pf_backlight &lp8557_backlight
								&pf_iio_ina3221 0
								&pf_iio_ina3221 1>;
			offset = <3>;
			rc_k = <1>;
			reference-sensor = <&Tboard_tegra>;
		};

		hs1: hotspot@1 {
			power-features-list = <&pf_backlight &lp8557_backlight>;
			offset = <3>;
			rc_k = <1>;
			reference-sensor = <&Tboard_tegra>;
		};

		hs2: hotspot@2 {
			power-features-list = <&pf_backlight &lp8557_backlight
								&pf_iio_ina3221 2>;
			offset = <3>;
			rc_k = <1>;
			reference-sensor = <&Tboard_tegra>;
		};

		skin-sensor@0 {
			thermal-sensor = <0>;
			hotspot-list = <&hs0 &hs1>;
		};

		skin-sensor@1 {
			thermal-sensor = <1>;
			hotspot-list = <&hs1>;
		};

		skin-sensor@2 {
			thermal-sensor = <2>;
			hotspot-list = <&hs2>;
		};
	};
};
```

## arch/arm64/boot/dts/nvidia/Documentation/devicetree/bindings/tty/serial/tegra-combined-uart.txt
```
Combined uart is a tegra-specific mechanism used to multiplex a single physical
UART between multiple pieces of software. Instead of having Linux access the
UART registers directly, this mechanism involves Linux writing debug output to
an HSP mailbox register. Debug input is similarly received from a different HSP
mailbox register.

The debug data is received by a different processor, which then collects the
debug outputs from multiple processors and multiplexes them over the actual
physical UART. Input data is also received by the same processor, which
forwards it to the correct destination.

The combined uart device tree node contains the necessary data for the driver
to operate correctly.

Required properties:
- compatible: Should be "nvidia,tegra186-combined-uart".
- reg: Must contain the base address of mailbox registers.
-- Reg0: Must contain the RX mailbox base address
-- Reg1: Must contain the TX mailbox base address
-- Reg2: Must contain the HSP base address that has the RX interrupt control
	register.
- interrupts: Must contain the RX interrupt number

Optional properties:
- console-port: Should be present if the Tegra FIQ debugger needs to use this
	combined uart node for debug I/O.
- combined-uart: Should be present if the Tegra FIQ debugger needs to use this
	combined uart node for debug I/O.
```

## arch/arm64/boot/dts/nvidia/Documentation/devicetree/bindings/watchdog/nvidia,tegra-wdt-t21x.txt
```
* NVIDIA Tegra Watchdog controller

Required properties:

- compatible: Should be "nvidia,tegra-wdt"
- reg: Should contain WDT and corresponding timer source
  registers location and length.

Optional properties:

- interrupts: interrupt number to the cpu
- nvidia,expiry-count: total expiry count of WDT (1 if not specified)
- nvidia,enable-on-init: Toggle switch for enable during init
- nvidia,heartbeat-init: default timeout in secs (120 secs if not specified)
- nvidia,timer-index: timer source index for WDT

Timer source index:

      There are three ways by which WDT timer source index can be specified
and timer source selection happens with below given priorty order (decending)
(a) Bootloader programs WDT and timer source
(b) "nvidia,timer-index" property in DT
(c) Timer source base address in DT (old method)

Method (a) is of highest priority, because bootloader can program the WDT timer
source and lock to prevent any further modification of timer source by kernel.
In order to calculate the timer source address in runtime in this case timer
base address is required and hence Timer base address should be provided in
timer resource property in DT.

Either timer base address or timer source address is expected in timer resource
property in DT for case (b).

Note: If method (c) is used it should correspond to the timer source index provided
in method (a) or (b) or make sure that method (a) or (b) is not in use.

Examples:

watchdog@60005100 {
	compatible = "nvidia,tegra-wdt";
	reg = <0x0 0x60005100 0x0 0x20		/* WDT0 registers */
		0x0 0x60005088 0x0 0x8>;	/* TMR0 registers */
	interrupts = <0 123 0x04>;
	nvidia,expiry-count = <4>;
	nvidia,timer-index = <7>;
	status = "disabled";
};
```

## arch/arm64/boot/dts/nvidia/drivers/ata/Kconfig
```kconfig
if ATA
config AHCI_TEGRA_DOWNSTREAM
	tristate "TEGRA AHCI SATA support"
	select ARCH_TEGRA_HAS_SATA
	help
	  This option enables support for TEGRA AHCI Serial ATA.

	  If unsure, say N.

config SATA_AHCI_TEGRA_SHIELD
    tristate "TEGRA (Shield) AHCI SATA support"
    select ARCH_TEGRA_HAS_SATA
    help
      This option enables support for TEGRA (Shield) AHCI Serial ATA.

      If unsure, say N.

config TEGRA_SATA_IDLE_POWERGATE
    bool "TEGRA (Shield) SATA idle power-gating"
    depends on SATA_AHCI_TEGRA_SHIELD && PM
    help
      This option enables power-gating during SATA idling.
      This option should not be enabled if sata clocks are in dvfs_table.

      If unsure, say N.

config TEGRA_AHCI_CONTEXT_RESTORE
       bool "TEGRA (Shield) Context save and Restore"
       depends on TEGRA_SATA_IDLE_POWERGATE
       default n
       help
         This option enables saving context and restoring it back during
         ELPG Entry and ELPG exit.

endif # ATA
```

## arch/arm64/boot/dts/nvidia/drivers/cpuidle/Kconfig.arm
```kconfig
#
# ARM CPU Idle drivers
#
config CPU_IDLE_TEGRA18X
	bool "CPU Idle Driver for NVIDIA Tegra18x SoCs"
	depends on ARCH_TEGRA_18x_SOC
	default y
	select CPU_IDLE_MULTIPLE_DRIVERS
	select DT_IDLE_STATES
	help
	  Support for entering different power states on NVIDIA Tegra18x
	  SoCs when CPUs become idle.

	  Select this to enable cpuidle on NVIDIA Tegra18x SoCs.

config CPU_IDLE_TEGRA19X
	tristate "CPU Idle Driver for NVIDIA Tegra19x SoCs"
	depends on ARCH_TEGRA_19x_SOC
	default y
	select CPU_IDLE_MULTIPLE_DRIVERS
	select DT_IDLE_STATES
	help
	  Support for entering different power states on NVIDIA Tegra19x
	  SoCs when CPUs become idle.
	  Select this to enable cpuidle on NVIDIA Tegra19x SoCs.
```
