## Documentation/devicetree/bindings/iio/temperature/amlogic,meson-tsensor.txt
```
* Amlogic Meson Temperature Sensor

Required properties:
- compatible:	depending on the SoC and the position of the sensor,
		this should be one of:
		- "amlogic,meson-g12a-cpu-tsensor" for the CPU G12A SoC sensor
		- "amlogic,meson-g12a-ddr-tsensor" for the DDR G12A SoC sensor
		followed by the common :
		- "amlogic,meson-g12a-tsensor" for G12A SoC family
- reg:		the physical base address and length of the registers
- interrupts:	the interrupt indicating end of sampling
- clocks:	phandle identifier for the reference clock of temperature sensor
- #io-channel-cells: must be 1, see ../iio-bindings.txt
- amlogic,ao-secure: phandle to the ao-secure syscon

Optional properties:
- amlogic,critical-temperature: temperature value in milli degrees Celsius
	to set automatic reboot on too high temperature

Example:
	cpu_temp: temperature-sensor@ff634800 {
		compatible = "amlogic,meson-g12a-cpu-tsensor",
			     "amlogic,meson-g12a-tsensor";
		reg = <0x0 0xff634800 0x0 0x50>;
		interrupts = <GIC_SPI 35 IRQ_TYPE_EDGE_RISING>;
		clocks = <&clkc CLKID_TS>;
		status = "okay";
		#io-channel-cells = <1>;
		amlogic,meson-ao-secure = <&sec_AO>;
		amlogic,critical-temperature = <115000>;
	};
```

## Documentation/devicetree/bindings/sound/amlogic,axg-fifo.yaml
```yaml
# SPDX-License-Identifier: GPL-2.0
%YAML 1.2
---
$id: http://devicetree.org/schemas/sound/amlogic,axg-fifo.yaml#
$schema: http://devicetree.org/meta-schemas/core.yaml#

title: Amlogic AXG Audio FIFO controllers

maintainers:
  - Jerome Brunet <jbrunet@baylibre.com>

properties:
  $nodename:
    pattern: "^audio-controller@.*"

  "#sound-dai-cells":
    const: 0

  compatible:
    oneOf:
      - items:
        - const:
            amlogic,axg-toddr
      - items:
        - const:
            amlogic,axg-frddr
      - items:
        - enum:
          - amlogic,g12a-toddr
          - amlogic,sm1-toddr
        - const:
            amlogic,axg-toddr
      - items:
        - enum:
          - amlogic,g12a-frddr
          - amlogic,sm1-frddr
        - const:
            amlogic,axg-frddr

  clocks:
    items:
      - description: Peripheral clock

  interrupts:
    maxItems: 1

  reg:
    maxItems: 1

  resets:
    minItems: 1
    items:
      - description: Memory ARB line
      - description: Dedicated device reset line

  reset-names:
    minItems: 1
    items:
      - const: arb
      - const: rst

  amlogic,fifo-depth:
    $ref: /schemas/types.yaml#/definitions/uint32
    description: Size of the controller's fifo in bytes

required:
  - "#sound-dai-cells"
  - compatible
  - interrupts
  - reg
  - clocks
  - resets
  - amlogic,fifo-depth

if:
  properties:
    compatible:
      contains:
        enum:
          - amlogic,g12a-toddr
          - amlogic,sm1-toddr
          - amlogic,g12a-frddr
          - amlogic,sm1-frddr
then:
  properties:
    resets:
      minItems: 2
    reset-names:
      minItems: 2
  required:
    - reset-names

examples:
  - |
    #include <dt-bindings/clock/axg-audio-clkc.h>
    #include <dt-bindings/interrupt-controller/irq.h>
    #include <dt-bindings/interrupt-controller/arm-gic.h>
    #include <dt-bindings/reset/amlogic,meson-axg-audio-arb.h>
    #include <dt-bindings/reset/amlogic,meson-g12a-audio-reset.h>

    frddr_a: audio-controller@1c0 {
        compatible = "amlogic,g12a-frddr", "amlogic,axg-frddr";
        reg = <0x0 0x1c0 0x0 0x1c>;
        #sound-dai-cells = <0>;
        interrupts = <GIC_SPI 88 IRQ_TYPE_EDGE_RISING>;
        clocks = <&clkc_audio AUD_CLKID_FRDDR_A>;
        resets = <&arb AXG_ARB_FRDDR_A>, <&clkc_audio AUD_RESET_FRDDR_A>;
        reset-names = "arb", "rst";
        amlogic,fifo-depth = <512>;
    };
```

## Documentation/devicetree/bindings/sound/amlogic,axg-pdm.yaml
```yaml
# SPDX-License-Identifier: GPL-2.0
%YAML 1.2
---
$id: http://devicetree.org/schemas/sound/amlogic,axg-pdm.yaml#
$schema: http://devicetree.org/meta-schemas/core.yaml#

title: Amlogic Audio AXG PDM input

maintainers:
  - Jerome Brunet <jbrunet@baylibre.com>

properties:
  $nodename:
    pattern: "^audio-controller@.*"

  "#sound-dai-cells":
    const: 0

  compatible:
    oneOf:
      - items:
        - enum:
          - amlogic,g12a-pdm
          - amlogic,sm1-pdm
        - const:
            amlogic,axg-pdm
      - items:
        - const:
            amlogic,axg-pdm

  clocks:
    items:
      - description: Peripheral clock
      - description: PDM digital clock
      - description: DSP system clock

  clock-names:
    items:
      - const: pclk
      - const: dclk
      - const: sysclk

  reg:
    maxItems: 1

  resets:
    maxItems: 1

required:
  - "#sound-dai-cells"
  - compatible
  - reg
  - clocks
  - clock-names

if:
  properties:
    compatible:
      contains:
        enum:
          - amlogic,g12a-pdm
          - amlogic,sm1-pdm
then:
  required:
    - resets

examples:
  - |
    #include <dt-bindings/clock/axg-audio-clkc.h>

    pdm: audio-controller@ff632000 {
        compatible = "amlogic,axg-pdm";
        reg = <0x0 0xff632000 0x0 0x34>;
        #sound-dai-cells = <0>;
        clocks = <&clkc_audio AUD_CLKID_PDM>,
                 <&clkc_audio AUD_CLKID_PDM_DCLK>,
                 <&clkc_audio AUD_CLKID_PDM_SYSCLK>;
        clock-names = "pclk", "dclk", "sysclk";
    };
```

## Documentation/devicetree/bindings/sound/amlogic,axg-spdifin.yaml
```yaml
# SPDX-License-Identifier: GPL-2.0
%YAML 1.2
---
$id: http://devicetree.org/schemas/sound/amlogic,axg-spdifin.yaml#
$schema: http://devicetree.org/meta-schemas/core.yaml#

title: Amlogic Audio AXG SPDIF Input

maintainers:
  - Jerome Brunet <jbrunet@baylibre.com>

properties:
  $nodename:
    pattern: "^audio-controller@.*"

  "#sound-dai-cells":
    const: 0

  compatible:
    oneOf:
      - items:
        - const:
            amlogic,axg-spdifin
      - items:
        - enum:
          - amlogic,g12a-spdifin
          - amlogic,sm1-spdifin
        - const:
            amlogic,axg-spdifin

  clocks:
    items:
      - description: Peripheral clock
      - description: SPDIF input reference clock

  clock-names:
    items:
      - const: pclk
      - const: refclk

  interrupts:
    maxItems: 1

  reg:
    maxItems: 1

  resets:
    maxItems: 1

required:
  - "#sound-dai-cells"
  - compatible
  - reg
  - interrupts
  - clocks
  - clock-names

if:
  properties:
    compatible:
      contains:
        enum:
          - amlogic,g12a-spdifin
          - amlogic,sm1-spdifin
then:
  required:
    - resets

examples:
  - |
    #include <dt-bindings/clock/axg-audio-clkc.h>
    #include <dt-bindings/interrupt-controller/irq.h>
    #include <dt-bindings/interrupt-controller/arm-gic.h>

    spdifin: audio-controller@400 {
    	compatible = "amlogic,axg-spdifin";
        reg = <0x0 0x400 0x0 0x30>;
        #sound-dai-cells = <0>;
        interrupts = <GIC_SPI 87 IRQ_TYPE_EDGE_RISING>;
        clocks = <&clkc_audio AUD_CLKID_SPDIFIN>,
                 <&clkc_audio AUD_CLKID_SPDIFIN_CLK>;
        clock-names = "pclk", "refclk";
    };
```

## Documentation/devicetree/bindings/sound/amlogic,axg-spdifout.yaml
```yaml
# SPDX-License-Identifier: GPL-2.0
%YAML 1.2
---
$id: http://devicetree.org/schemas/sound/amlogic,axg-spdifout.yaml#
$schema: http://devicetree.org/meta-schemas/core.yaml#

title: Amlogic Audio AXG SPDIF Output

maintainers:
  - Jerome Brunet <jbrunet@baylibre.com>

properties:
  $nodename:
    pattern: "^audio-controller@.*"

  "#sound-dai-cells":
    const: 0

  compatible:
    oneOf:
      - items:
        - const:
            amlogic,axg-spdifout
      - items:
        - enum:
          - amlogic,g12a-spdifout
          - amlogic,sm1-spdifout
        - const:
            amlogic,axg-spdifout

  clocks:
    items:
      - description: Peripheral clock
      - description: SPDIF output master clock

  clock-names:
    items:
      - const: pclk
      - const: mclk

  reg:
    maxItems: 1

  resets:
    items:
      - description: dedicated device reset line

required:
  - "#sound-dai-cells"
  - compatible
  - reg
  - clocks
  - clock-names

if:
  properties:
    compatible:
      contains:
        enum:
          - amlogic,g12a-spdifout
          - amlogic,sm1-spdifout
then:
  required:
    - resets

examples:
  - |
    #include <dt-bindings/clock/axg-audio-clkc.h>

    spdifout: audio-controller@480 {
    	compatible = "amlogic,axg-spdifout";
        reg = <0x0 0x480 0x0 0x50>;
        #sound-dai-cells = <0>;
        clocks = <&clkc_audio AUD_CLKID_SPDIFOUT>,
                 <&clkc_audio AUD_CLKID_SPDIFOUT_CLK>;
        clock-names = "pclk", "mclk";
    };
```

## Documentation/devicetree/bindings/sound/amlogic,axg-tdm-iface.yaml
```yaml
# SPDX-License-Identifier: GPL-2.0
%YAML 1.2
---
$id: http://devicetree.org/schemas/sound/amlogic,axg-tdm-iface.yaml#
$schema: http://devicetree.org/meta-schemas/core.yaml#

title: Amlogic Audio TDM Interfaces

maintainers:
  - Jerome Brunet <jbrunet@baylibre.com>

properties:
  $nodename:
    pattern: "^audio-controller-.*"

  "#sound-dai-cells":
    const: 0

  compatible:
    items:
      - const: 'amlogic,axg-tdm-iface'

  clocks:
    minItems: 2
    maxItems: 3
    items:
      - description: Bit clock
      - description: Sample clock
      - description: Master clock #optional

  clock-names:
    minItems: 2
    maxItems: 3
    items:
      - const: sclk
      - const: lrclk
      - const: mclk

required:
  - "#sound-dai-cells"
  - compatible
  - clocks
  - clock-names

examples:
  - |
    #include <dt-bindings/clock/axg-audio-clkc.h>

    tdmif_a: audio-controller-0 {
        compatible = "amlogic,axg-tdm-iface";
        #sound-dai-cells = <0>;
        clocks = <&clkc_audio AUD_CLKID_MST_A_SCLK>,
                 <&clkc_audio AUD_CLKID_MST_A_LRCLK>,
                 <&clkc_audio AUD_CLKID_MST_A_MCLK>;
        clock-names = "sclk", "lrclk", "mclk";
    };
```

## Documentation/devicetree/bindings/sound/amlogic,g12a-tohdmitx.yaml
```yaml
# SPDX-License-Identifier: GPL-2.0
%YAML 1.2
---
$id: http://devicetree.org/schemas/sound/amlogic,g12a-tohdmitx.yaml#
$schema: http://devicetree.org/meta-schemas/core.yaml#

title: Amlogic G12a HDMI Tx Control Glue

maintainers:
  - Jerome Brunet <jbrunet@baylibre.com>

properties:
  $nodename:
    pattern: "^audio-controller@.*"

  "#sound-dai-cells":
    const: 1

  compatible:
    oneOf:
      - items:
        - const:
            amlogic,g12a-tohdmitx
      - items:
        - enum:
          - amlogic,sm1-tohdmitx
        - const:
            amlogic,g12a-tohdmitx

  reg:
    maxItems: 1

  resets:
    maxItems: 1

required:
  - "#sound-dai-cells"
  - compatible
  - reg
  - resets

examples:
  - |
    #include <dt-bindings/reset/amlogic,meson-g12a-audio-reset.h>

    tohdmitx: audio-controller@744 {
    	compatible = "amlogic,g12a-tohdmitx";
        reg = <0x0 0x744 0x0 0x4>;
        #sound-dai-cells = <1>;
        resets = <&clkc_audio AUD_RESET_TOHDMITX>;
    };
```

## arch/arm64/boot/dts/nvidia/Documentation/devicetree/bindings/hwmon/generic-pwm-tachometer.txt
```
Device tree bindings for fan tach output connected to PWM controller with
PWM capture capability.

Required properties:
- compatible	: "generic-pwm-tachometer"
- pwms		: PWM handle. Please refer pwm.txt DT binding for more details.

Example:

	tegra_tachometer: tachometer@39c0000 {
		compatible = "nvidia,pwm-tegra194-tachometer";
		reg = <0x0 0x039c0000 0x0 0x10>;
		clocks = <&bpmp_clks TEGRA194_CLK_TACH>;
		clock-names = "tach";
		resets = <&bpmp_resets TEGRA194_RESET_TACH>;
		reset-names = "tach";
		pulse-per-rev = <2>;
		sampling-window = <2>;
	};

	generic_pwm_tachometer {
		compatible = "generic-pwm-tachometer";
		pwms = <&tegra_tachometer 0 1000000>;
	};
```

## arch/arm64/boot/dts/nvidia/Documentation/devicetree/bindings/iio/light/nvs_ltr659.txt
```
* LTR 558/659 ALS/proximity sensor

nvs_ drivers use the NVidia Sensor (NVS) framework.
See the nvs.txt documentation for NVS DT capabilities.
The nvs_ltr659 ALS/proximity sensor driver supports the LTR558 and LTR659
devices.
If the part is known and is populated, then it can be specified in the DT:
Example: ltr659@23.
By specifying a device this way, the driver will assume this specific device
is populated during system boot and will not verify its existence. If, however,
the device is unknown or may not be populated, then the label, ltrX5X,
(e.g. ltrX5X@23), must be used.  This tells the driver to find which device is
used.  If the device is not found, the driver will unload itself.  This also
requires that regulators be setup correctly for the probe function.

Required properties:
- compatible: Device or generic name.
	      Supported device names:
	      - liteon,ltrX5X
	      - liteon,ltr558als
	      - liteon,ltr659ps
  Note: If the part is known and is populated, then it can be specified:
	Example: compatible = "liteon,ltr659ps";
	When specifying a device this way, the driver will assume this specific
	device is populated during system boot and will not verify its
	existence.  If, however, the device is unknown or may not be populated,
	then the label, ltrX5X, (Example: compatible = "liteon,ltrX5X";),
	must be used.  This tells the driver to find which device is used.  If
	the device is not found, the driver will unload itself.  This requires
	regulators to be setup correctly for the probe function.
- reg: i2c address of the device. It is 0x23.

Optional properties:
- status: set to "ok" or "okay" for normal operation.  Set to anything else
	  to unload the driver without ever communicating with the device.
  Note: The "anything else" above is typically "disabled".
	Since the driver will unload without communicating with the device, the
	device will be left in its POR state.
- light_disable: Setting this property to <1> will disable the light sensor.
- proximity_disable: Setting this property to <1> will disable the proximity
                     sensor.
  Note: If the device supports both light and proximity, then to disable the
        entire device so that the driver unloads, all sensors must be disabled:
	light_disable = <1>;
	proximity_disable = <1>;
- vdd-supply: regulator supply for chip
- vled-supply: regulator supply for led anode.
  Note: These are required if the driver is to control the regulators.

Example:

	ltr659@23 {
		compatible = "liteon,ltr659";
		reg = <0x23>;
		vdd-supply = <&palmas_smps9>;
		vled-supply = <&palmas_smps8>;
	};
```
