## arch/arm64/boot/dts/nvidia/Documentation/devicetree/bindings/iio/tegra-aon-shub.txt
```
 * NVIDIA Tegra SPE/AON sensor hub with communication via the "IVC" IPC protocol.

The AON FW implements the sensor hub functionality and communicates with the
AP via the "IVC" protocol. The kernel driver that communicates with AON fw on
the sensor hub IVC channel uses the Nvidia Sensor (NVS) framework.
See the nvs.txt documentation for NVS DT capabilities.

== AON Sensor Hub top-level node ==

The AON Senor Hub is represented by the top-level node.

Required properties:
- compatible: Should be "nvidia,tegra186_aon_shub" for T18x.
- mboxes: Should have the respective mbox index to indicate the ivc channel id.
  Formatted as per standard rules for this property.

== AON Sensor Hub sub nodes ==

Each sub-node respresents sensor chip supported by the AON.
Required properties:
- i2c_info: I2C parameters namely controller id, clock rate and chips i2c
	    address on the bus. This property is defined as a u32 tuple
	    of the following form:
	    i2c_info = <0 100000 0x68>;
	    The tuple is described as follows:
	    < I2C_controller_ID I2C_Clock_Rate I2C_address_of_slave >
- chip_id:  Chip id of the sensor chip on the AON sensor hub.
- gpio:	    GPIO number of the GPIO connected to the sensor chip.

Optional Properties:
- aux_chip: Property holds the slave chip id and I2C addr parameters.
- aux_chip_name: Property holds the slave chip name.
- status: set to "ok" or "okay" for normal operation.  Set to anything else
	  to unload the driver without ever communicating with the device.
  Note: The "anything else" above is typically "disabled".
- sensorname_disable: Setting this property to <1> will disable the sensor.
- sensorname_matrix:  Orientation matrix for this device. Where sensorname is
		      substituted by the actual sensor name.
- sensorname_delay_us_min: Change the max supported sampling rate.
- sensorname_delay_us_max: Change the min supported sampling rate.

Possible example:

aon_shub {
	status = "okay";
	compatible = "nvidia,tegra186_aon_shub";
	mboxes = <&aon 5>;

	icm20628@68 {
		i2c_info = <1 100000 0x68>;
		chip_id = <1>;
		gpio = <TEGRA_AON_GPIO(V, 4)>;
		accelerometer_matrix = [00 01 00 01 00 00 00 00 ff];
		gyroscope_matrix = [00 01 00 01 00 00 00 00 ff];
	};

	ak8963c@0c {
		i2c_info = <1 100000 0x0c>;
		chip_id = <2>;
		gpio = <TEGRA_AON_GPIO(V, 5)>;
		magnetic_field_matrix = [00 01 00 01 00 00 00 00 ff];
	};
};
```

## arch/arm64/boot/dts/nvidia/Documentation/devicetree/bindings/input/gpio-timed-keys.txt
```
Device-Tree bindings for input/gpio_timed_keys.c keyboard driver

Required properties:
	- compatible = "gpio-timed-keys";

Optional properties:
	- autorepeat: Boolean, Enable auto repeat feature of Linux input
	  subsystem.

Each button (key) is represented as a sub-node of "gpio-keys":
Subnode properties:

	- gpios: OF device-tree gpio specification.
	- label: Descriptive name of the key.
	- linux,num_codes: Number of keycodes associated with the key
	- linux,press-times-secs: Times in seconds linked with different
				  keycodes
	- linux,key-codes: List of keycodes to be emitted with each detected
			   timed presses

Optional subnode-properties:
	- linux,input-type: Specify event type this button/key generates.
	  If not specified defaults to <1> == EV_KEY.
	- debounce-interval: Debouncing interval time in milliseconds.
	  If not specified defaults to 5.
	- gpio-key,wakeup: Boolean, button can wake-up the system.
	- gpio-key,name: String, Input device name for this key.

Example nodes:

	gpio_timed_keys {
			compatible = "gpio-timed-keys";
			#address-cells = <1>;
			#size-cells = <0>;
			power {
				label = "Power";
				gpios = <&gpio1 0 1>;
				linux,num_codes = <2>;
				linux,press-time-secs = < 1 6>;
				linux,key-codes = <KEY_DOWN KEY_ENTER>;
				gpio-key,wakeup;
			};
			...
```

## arch/arm64/boot/dts/nvidia/Documentation/devicetree/bindings/pci/nvidia,tegra19x-pcie-ep.txt
```
NVIDIA Tegra PCIe controller-End Point mode (Synopsys DesignWare Core based)

This PCIe controller working in end point mode is based on the Synopsis
Designware PCIe IP

Required properties:
- compatible: For Tegra19x, must contain "nvidia,tegra194-pcie-ep".
- reg: A list of physical base address and length for each set of controller
  registers. Must contain an entry for each entry in the reg-names property.
- reg-names: Must include the following entries:
  "appl": Controller's application logic registers
  "window1": First address space aperture window available for PCIe controller
  "config": configuration space region (either window1 or window2 can be used
            for mapping. But in this case, window1 is used)
  "atu_dma": iATU and DMA register (either window1 or window2 can be used
             for mapping. But in this case, window1 is used)
  "window2": Second address space aperture window available for PCIe controller
- interrupts: A list of interrupt outputs of the controller. Must contain an
  entry for each entry in the interrupt-names property.
- interrupt-names: Must include the following entries:
  "intr": The Tegra interrupt that is asserted for controller interrupts
- clocks: Must contain an entry for each entry in clock-names.
  See ../clocks/clock-bindings.txt for details.
- clock-names: Must include the following entries:
  - core_clk
- resets: Must contain an entry for each entry in reset-names.
  See ../reset/reset.txt for details.
- reset-names: Must include the following entries:
  - core_apb_rst
  - core_rst
- phys: Must contain a phandle to P2U PHY for each entry in phy-names.
- phy-names: Must include an entry for each active lane. Note that the number
  of entries does not have to (though usually will) be equal to the specified
  number of lanes in XBAR configuration. Entries are of the form
  "pcie-p2u-N": where N ranges from 0 to the value specified in xbar config
- nvidia,pex-rst-gpio: Specify GPIO for PCIe reset signal, see gpio binding
- vddio-pex-ctl-supply: Regulator supply for PCIe side band signals
- Controller dependent register offsets
  - nvidia,margin-port-cap: MARGIN_PORT_CAP_STATUS reg offset
      0x190 - C4
      0x194 - C0 and C5
  - nvidia,cfg-link-cap-l1sub: L1SUB_CAP_L1SUB reg offset
      0x1b0 - C4
      0x1c4 - C0 and C5
  - nvidia,event-cntr-ctrl: EVENT_COUNTER_CONTROL reg offset
      0x1c4 - C4
      0x1d8 - C0 and C5
  - nvidia,event-cntr-data: EVENT_COUNTER_DATA reg offset
      0x1c8 - C4
      0x1dc - C0 and C5
  - nvidia,margin-lane-cntrl: MARGIN_LANE_CNTRL_STATUS reg offset
      0x184 - C1, C2 and C3
      0x194 - C4
      0x198 - C0 and C5
- nvidia,device-id: Controller specific PCIe Device-ID
      0x1AD4 - C0
      0x1AD5 - C4
      0x1AD4 - C5
- nvidia,controller-id : Controller specific ID
      0x0 - C0
      0x4 - C4
      0x5 - C5
- num-lanes: Must contain an entry to represent number of lanes
  controller is given to get the link up

Optional properties:
- iommus: A reference to the IOMMU. See ../iommu/iommu.txt for details.
- dma-coherent: Indicates that the hardware IP block can ensure the coherency
  of the data transferred from/to the IP block. This can avoid the software
  cache flush/invalid actions, and improve the performance significantly.
- nvidia,max-speed: limits controllers max speed to this value.
    1 - Gen-1
    2 - Gen-2
    3 - Gen-3
    4 - Gen-4
- nvidia,disable-aspm-states : controls advertisement of ASPM states
    bit-0 to '1' : disables advertisement of ASPM-L0s
    bit-1 to '1' : disables advertisement of ASPM-L1. This also disables
                 advertisement of ASPM-L1.1 and ASPM-L1.2
    bit-2 to '1' : disables advertisement of ASPM-L1.1
    bit-3 to '1' : disables advertisement of ASPM-L1.2
- nvidia,update_fc_fixup : needs it to improve perf when a platform is designed
    in such a way that it satisfies at least one of the following conditions
    1. If C0/C4/C5 run at x1/x2 link widths (irrespective of speed and MPS)
    2. If C0/C4/C5 operate at their respective max link widths and
       a) speed is Gen-2 and MPS is 256B
       b) speed is >= Gen-3 with any MPS
- nvidia,bar0-size: Size of BAR-0 through which memory gets exposed to host
- "nvidia,tsa-config" : Add TSA configuration register address to configure MC
    with production settings for PCIe. Note:- this is applicable only for C5
- "nvidia,mods" : Add to indicate NVidia specific MODs configuration

Power supplies for Tegra194:
//TODO


Examples:
=========

Tegra194:
--------

SoC DTSI:

	pcie_c1_ep {
		compatible = "nvidia,tegra194-pcie-ep";
		reg = <0x00 0x14100000 0x0 0x00020000   /* appl registers (128K)      */
		       0x00 0x30000000 0x0 0x00040000   /* configuration space (256K) */
		       0x00 0x30040000 0x0 0x00040000>; /* iATU_DMA reg space (256K)  */
		reg-names = "appl", "config", "atu_dma";

		#address-cells = <3>;
		#size-cells = <2>;

		status = "disabled";

		clocks = <&bpmp_clks TEGRA194_CLK_PEX0_CORE_1>;
		clock-names = "core_clk";

		resets = <&bpmp_resets TEGRA194_RESET_PEX0_CORE_1_APB>,
			 <&bpmp_resets TEGRA194_RESET_PEX0_CORE_1>;
		reset-names = "core_apb_rst", "core_rst";

		interrupts = <0 45 0x04>;	/* controller interrupt */
		interrupt-names = "intr";

		iommus = <&smmu TEGRA_SID_PCIE1>;
		dma-coherent;
	};

Board DTS:

//TODO
```

## arch/arm64/boot/dts/nvidia/Documentation/devicetree/bindings/pinctrl/pinctrl-tegra194-pexclk-padctrl.txt
```
Binding document for T194 PCIE PEXCLK Single/differential end selection
======================================================================

This document defines the device-specific binding for the T194 PCIE
PEXCLK pad control for single or differential ends.

Required properties:
--------------------
- compatible: Must be "nvidia,tegra194-pexclk-padctl"
- reg: Should contain a list of base address and size pairs for:
  - first entry: The base address and size of PCIE_PEXCLK_PADCTRL0
  - second entry: The base address and size of PCIE_PEXCLK_PADCTRL0

Please refer to pinctrl-bindings.txt @Documentation/devicetree/bindings/pinctrl
for details of the common pinctrl bindings used by client devices, including
the meaning of the phrase "pin configuration node".

Optional Pinmux properties:
--------------------------
Following properties are required if default setting of pins are required
at boot.
- pinctrl-names: A pinctrl state named per <pinctrl-binding.txt>.
- pinctrl[0...n]: Properties to contain the phandle for pinctrl states per
		<pinctrl-binding.txt>.

The pin configurations are defined as child of the pinctrl states node. Each
sub-node have following properties:

Required properties:
------------------
- pins: List of pins. Valid values of pins properties are:
		pexclk.

Child nodes contain the pinmux configurations following the conventions from
the pinctrl-bindings.txt document. Typically a single, static configuration is
given and applied at boot time.

Optional properties:
-------------------
nvidia,pexclk-single-end: Integer, Enable/disable single end on PCIE pexclk
			  pads. The valid values are 0 or 1.
			  0: Disable single end, means differential.
			  1: Enable single end, means single end clocks.

Optional prod nodes:
-------------------
Prod configuration can be provided per the prod DT binding for
prod initialisation. Default prod name is "prod";

Example:
========
	pinctrl@3790000 {
		compatible = "nvidia,tegra194-pexclk-padctl";
		reg = <0x0 0x03790000 0x0 0x1000>,
		      <0x0 0x037a0000 0x0 0x1000>;
		pinctrl-names = "default";
		pinctrl-0 = <&pexclk_pads_default>;

		pexclk_pads_default: pexclk_pads_default {
			pexclk {
				pins = "pexclk";
				nvidia,pexclk-single-end = <1>;
			};
		};
	};

The above DT configuration will configure pexclk in single ended.

For dynamic switching, the client node need to pass the required
phandle. Following are changes needed in the pinctrl and client
DT node.
	pinctrl@3790000 {
		compatible = "nvidia,tegra194-pexclk-padctl";
		reg = <0x0 0x03790000 0x0 0x1000>,
		      <0x0 0x037a0000 0x0 0x1000>;

		pexclk_pads_single: pexclk_pads_single {
			pexclk {
				pins = "pexclk";
				nvidia,pexclk-single-end = <1>;
			};
		};

		pexclk_pads_diff: pexclk_pads_diff {
			pexclk {
				pins = "pexclk";
				nvidia,pexclk-single-end = <0>;
			};
		};
	};


	client-node {
		/* Other properties of client node */

		pinctrl-names = "single". "differential";
		pinctrl-0 = <&pexclk_pads_single>;
		pinctrl-1 = <&pexclk_pads_diff>;
	};


Example with prod:
=================
	pinctrl@3790000 {
		compatible = "nvidia,tegra194-pexclk-padctl";
		reg = <0x0 0x03790000 0x0 0x1000>,
		      <0x0 0x037a0000 0x0 0x1000>;

		prod-settings {
			prod {
				prod = <
					/* Prod entries */
					>;
			};
		};
	};
```

## arch/arm64/boot/dts/nvidia/Documentation/devicetree/bindings/platform/tegra/bridge-mca.txt
```
NVIDIA Tegra18x Bridge MCA driver
==================================

This document defines the device-specific binding for the Tegra18x bridge MCA driver.
The Bridge MCA driver adds support for AXI/APB bridge machine check hardware in T18x.
The driver reports relevant information like CPU, bus address, error status, type of bridge, etc in case of a Bridge MCA.

Required properties:

- compatible: Should be "nvidia,tegra186-AXI2APB-bridgei"
- reg: Physical base address and length of registers
- clocks: Specifies the needed clocks
- clock-names: Specifies the names of the needed clocks
- timeout: specify the bridge timeout in micro seconds (us)

Below is a sample bridge DT entry for configuring bridge timeout=500 usec
for axi2apb@2390000 bridge.

axi2apb@2390000 {
		compatible = "nvidia,tegra186-AXI2APB-bridge";
		reg = <0x0 0x02390000 0x0 0x1000>;
		clocks = <&tegra_car TEGRA186_CLK_AXI_CBB>;
		clock-names = "axi_cbb";
		timeout = <500>;
		status = "disabled";
};
```
