## arch/arm64/boot/dts/nvidia/drivers/crypto/Kconfig
```kconfig
if CRYPTO_HW

config TEGRA_CRYPTO_DEV
	tristate "Device node to access tegra aes hardware"
	depends on CRYPTO_DEV_TEGRA_ELLIPTIC_SE || CRYPTO_DEV_TEGRA_SE_USE_HOST1X_INTERFACE
	help
	  Dev node /dev/tegra-crypto in order to get access to tegra aes
	  hardware from user space

config CRYPTO_DEV_TEGRA_SE
	tristate "Tegra SE driver for crypto algorithms"
	select CRYPTO_AES
	help
	  This option allows you to have support of Security Engine for crypto acceleration.

config CRYPTO_DEV_TEGRA_ELLIPTIC_SE
	tristate "Tegra SE for Elliptic crypto algorithms"
	select CRYPTO_ECDH
	select CRYPTO_ECDSA
	help
	  This option allows you to have support of Security Engine
	  for Elliptic PKA1 and RNG1 Crypto Algorithms. PKA1 supports
	  Public Key Algorithms, RSA (upto 4K bits) and ECC (Elliptic
	  Curve Cryptography, upto 521 bits) features internally. RNG1
	  supports random number generation.

config CRYPTO_DEV_TEGRA_SE_USE_HOST1X_INTERFACE
	tristate "Use Host1x Interface for Tegra SE crypto algorithms"
	depends on ARCH_TEGRA_18x_SOC
	help
	  This allows you to use Host1x Memory Interface for Tegra SE Driver
	  Crypto algorithms.

config CRYPTO_DEV_TEGRA_VIRTUAL_SE_INTERFACE
        tristate "Virtual SE interface for Tegra SE crypto algorithms"
        depends on ARCH_TEGRA_18x_SOC && CRYPTO_DEV_TEGRA_SE
        help
          This allows you to use Virtual SE interface for Tegra Crypto algorithms.

endif
```

## arch/arm64/boot/dts/nvidia/drivers/devfreq/Kconfig
```kconfig
if PM_DEVFREQ

comment "NVIDIA DEVFREQ Governors"

config DEVFREQ_GOV_POD_SCALING
        tristate "Power On Demand Scaling"
        help
          Sets the frequency based on two properties:
          (1) The governor receives activity throughput hints that
          indicate whether scaling up or down is required
          (2) the load of the devices is estimated using busy times
          from device profile to determine if the frequency should
          be altered.

config DEVFREQ_GOV_POD_SCALING_HISTORY_BUFFER_SIZE_MAX
        int
        default 100

config DEVFREQ_GOV_WMARK_SIMPLE
        tristate "Simple Watermark"
        help
          Sets the frequency based on monitor watermark events.
          This governor returns the next frequency from frequency table
          based on type watermark event.

config DEVFREQ_GOV_WMARK_ACTIVE
        tristate "Active Watermark"
        help
          Sets the frequency based on monitor watermark events.
          This governor calculates relation between current load and
          target load. The next frequency is calculated by multiplying
          this relation with the current frequency.

          The watermark values are updated so that the watermarks are
          triggered when the above algorithm would change the frequency.

endif # PM_DEVFREQ
```

## arch/arm64/boot/dts/nvidia/drivers/extcon/Kconfig
```kconfig
if EXTCON

config EXTCON_DISP_STATE
	tristate "DISPLAY STATE EXTCON support"
	depends on TEGRA_DC
	default y
	help
	   Say Y here to enable display state cable detection with extcon support.
endif
```

## arch/arm64/boot/dts/nvidia/drivers/firmware/tegra/Kconfig
```kconfig
menu "Tegra BPMP Driver"

config NV_TEGRA_BPMP
	bool "Tegra BPMP driver (Downstream version)"
	default n
	select NV_TEGRA_IVC
	select TEGRA_HSP
	help
	  Manages firmware running on Tegra BPMP

	  This driver is a downstream version and there is a newer variant
	  available in modern kernels.

config BPMP_DEBUGFS_MOUNT_ON_BOOT
	bool "Mount the BPMP debug fs on boot"
	default y
	depends on DEBUG_FS && NV_TEGRA_BPMP
	help
	  Disable this if you don't want to mount the BPMP debug fs by default
	  on boot.

	  Note disabling this will save some boot time. BPMP debugfs still can
	  be mounted after the boot.

endmenu
```
