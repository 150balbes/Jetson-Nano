#include "gxbb_p200.dts"

/{
	le-dt-id = "gxbb_p200_2G_m8s+_k3_pro";
	memory@00000000 {
		linux,usable-memory = <0x0 0x1000000 0x0 0x7f000000>;
	};

	wifi {
		interrupt_pin = <&gpio	   GPIOX_11	   GPIO_ACTIVE_HIGH>;
		power_on_pin = <&gpio	   GPIOX_10	   GPIO_ACTIVE_HIGH>;
	};

	dwc2_a {
		/delete-property/ gpio-vbus-power;
		/delete-property/ gpios;
		port-id-mode = <0>; /** 0: hardware, 1: sw_host, 2: sw_slave*/
	};
};
