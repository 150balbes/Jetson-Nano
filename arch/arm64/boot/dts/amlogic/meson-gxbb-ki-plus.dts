// SPDX-License-Identifier: (GPL-3.0+ OR MIT)
/*
 * Author: afl1 <afl2001@gmail.com>
 */

#include "meson-gxbb-kii-pro.dts"
/ {
	model = "MeCool KI Plus";

	memory@0 {
		device_type = "memory";
		reg = <0x0 0x0 0x0 0x40000000>;
	};
};
