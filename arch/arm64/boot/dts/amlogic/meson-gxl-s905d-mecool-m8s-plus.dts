// SPDX-License-Identifier: (GPL-2.0+ OR MIT)

/*
 * Author: Christian Hewitt <christianshewitt@gmail.com>
 */

#include "meson-gxl-s905d-p231.dts"

/ {
        compatible = "mecool,kii-pro", "amlogic,s905d", "amlogic,meson-gxl";
	model = "MeCool M8S Plus";
};

&ir {
        linux,rc-map-name = "rc-mecool-m8s-plus";
};
