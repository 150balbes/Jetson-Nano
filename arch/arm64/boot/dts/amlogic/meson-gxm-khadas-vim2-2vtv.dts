// SPDX-License-Identifier: (GPL-3.0+ OR MIT)
/*
 * Author: afl1 <afl2001@gmail.com>
 */

#include "meson-gxm-khadas-vim2.dts"
/ {
	model = "Khadas VIM2 2x VTV";

	dvb {
		ts1 = "serial";
		dtv_demod1_i2c_adap_id = <0>;
		lock_led_gpio-gpios2 = <&gpio GPIODV_13 GPIO_ACTIVE_HIGH>;
	};
};
&i2c_A {
	clock-frequency = <300000>;
};


