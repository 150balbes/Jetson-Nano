// SPDX-License-Identifier: (GPL-2.0+ OR MIT)

/*
 * Author: Christian Hewitt <christianshewitt@gmail.com>
 */

#include "meson-gxm-q200.dts"

/ {
        compatible = "mecool,gxm-kiii-pro", "amlogic,s912",
		"amlogic,meson-gxm";
	model = "MeCool KIII Pro";

	memory@0 {
		device_type = "memory";
		reg = <0x0 0x0 0x0 0xC0000000>;
	};
};

&ir {
        linux,rc-map-name = "rc-mecool-kiii-pro";
};
