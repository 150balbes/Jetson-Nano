## arch/arm64/boot/dts/nvidia/drivers/gpu/drm/tegra_udrm/Kconfig
```kconfig
config DRM_TEGRA_UDRM
	tristate "DRM support for user mode DRM driver on NVIDIA Tegra Soc"
	depends on DRM && ARCH_TEGRA
	help
		This driver provides kernel support for user mode drm driver
		on NVIDIA Tegra SoC.

		To compile this driver as a module, choose M here: the module
		will be called tegra-udrm.
```

## arch/arm64/boot/dts/nvidia/drivers/i2c/busses/Kconfig
```kconfig
append_menu "I2C Hardware Bus support"

config I2C_TEGRA_VI
        tristate "NVIDIA Tegra internal VII2C controller"
        depends on ARCH_TEGRA
        default y
        select I2C_ALGOBIT
        help
          If you say yes to this option, support will be included for the
          I2C controller embedded in NVIDIA Tegra SOCs

config I2C_BPMP_TEGRA
        tristate "NVIDIA Tegra internal BPMP I2C controller (Downstream version)"
        depends on NV_TEGRA_BPMP
        default y
        select I2C_ALGO_BUSCLEAR
        select I2C_ALGOBIT
        help
          If you say yes to this option, support will be included for the
          I2C controller embedded in NVIDIA Tegra SOCs accessed via BPMP.
          This I2C driver is a 'virtual' I2C driver. The real driver is
          embedded in the BPMP firmware, and this driver merely communicates
          with that real driver.

	  This driver is a downstream version and there is a newer variant
	  available in modern kernels.

config I2C_TEGRA_CAMRTC
        bool "Tegra I2C Camera RTCPU driver"
        depends on TEGRA_CAMERA_RTCPU
        help
          If you say yes to this option, support will be included for the
          I2C controller embedded in NVIDIA Tegra SOCs accessed via Camera
          RTCPU processor. This I2C driver is a 'virtual' I2C driver
          compatible with I2C bus driver. The real driver is embedded in the
          Camera RTCPU firmware, and this driver merely communicates with
          that real driver.

config I2C_TEGRA_HV
        bool "Tegra I2C virtualization Support"
        depends on TEGRA_HV_MANAGER
        default y
        help
          Enables support for para-virtualized I2C client driver.
          Client driver is written to communicate with I2C server
          partition by using IVC (Inter VM Commuication) framework.
          IVC support is a prerequisite for this driver.

config I2C_TEGRA194_SLAVE
	tristate "NVIDIA Tegra194 internal I2C slave controller"
	select I2C_SLAVE
	help
	If you say yes to this option, support will be included for the
	I2C slave controller embedded in NVIDIA Tegra194 SOC.

	This driver supports FIFO mode for read/write transfers.

endmenu
```

## arch/arm64/boot/dts/nvidia/drivers/iio/generic/Kconfig
```kconfig
#
# nvs-led-test driver for Testing/Measurements
#

config NVS_LED_TEST
	tristate "LED test sensor device"
	depends on SYSFS && IIO && IIO_KFIFO_BUF && IIO_TRIGGER
	select NVS_IIO
	default n
	help
	  This driver adds a LED test NVS_IIO sensor that can be triggered via sysfs
	  This driver can be built as a module. The module will be called
	  nvs_led_test. It will trigger a specified gpio when triggered which should
	  be attached to an LED which will light up for a period of time.

config NVS_LED_TRACE_PRINTK
	bool "Enable trace_printk debugging"
	depends on FTRACE_PRINTK
```

## arch/arm64/boot/dts/nvidia/drivers/iio/imu/Kconfig
```kconfig
append_menu "Inertial measurement units"
source "drivers/iio/imu/nvi_mpu/Kconfig"
source "drivers/iio/imu/nvs_bmi/Kconfig"
source "drivers/iio/imu/tsfw_icm20628/Kconfig"
endmenu
```

## arch/arm64/boot/dts/nvidia/drivers/iio/imu/nvi_mpu/Kconfig
```kconfig
#
# nvi-mpu driver for Invensense MPU devices and combos
#

config NVI_MPU_IIO
	tristate "Invensense MPU devices"
	depends on I2C && SYSFS && IIO && !INV_MPU
	select NVS
	select NVS_IIO
	default n
	help
	  This driver supports the Invensense MPU devices.
	  This includes MPU6050/MPU65XX/MPU9X50
	  This driver can be built as a module. The module will be called
	  nvi-mpu.

config NVI_MPU_INPUT
	tristate "Invensense MPU devices"
	depends on I2C && SYSFS && INPUT && !INV_MPU
	select NVS
	select NVS_INPUT
	default n
	help
	  This driver supports the Invensense MPU devices.
	  This includes MPU6050/MPU65XX/MPU9X50
	  This driver can be built as a module. The module will be called
	  nvi-mpu.

config NVI_MPU_RELAY
	tristate "Invensense MPU devices"
	depends on I2C && SYSFS && !INV_MPU
	select NVS
	select NVS_RELAY
	default n
	help
	  This driver supports the Invensense MPU devices.
	  This includes MPU6050/MPU65XX/MPU9X50
	  This driver can be built as a module. The module will be called
	  nvi-mpu.
```

## arch/arm64/boot/dts/nvidia/drivers/iio/imu/tsfw_icm20628/Kconfig
```kconfig
config TSFW_ICM
	bool "Thunderstrike Accel/Gyro/Mag sensors"
	depends on HID_SHIELD_REMOTE
	help
	  Enable Accelerometer, Gyro, and Magnetometer sensors on controller.
```

## arch/arm64/boot/dts/nvidia/drivers/iio/proximity/Kconfig
```kconfig
menu "Proximity sensors"

#
# Proximity sensors
#

config NVS_IQS2X3
	tristate "Azoteq IQS253/IQS263 SAR proximity"
	depends on I2C && IIO_BUFFER && IIO_TRIGGERED_BUFFER && NVS_IIO && NVS_PROXIMITY
	help
	  Say Y here for Azoteq IQS253 and IQS263 SAR proximity support.

	  The driver uses the NVS (NVidia Sensor) IIO and proximity
	  framework.

endmenu
```

## arch/arm64/boot/dts/nvidia/drivers/input/Kconfig
```kconfig
config INPUT_CFBOOST
	tristate "Input event CPU frequency booster"
	depends on INPUT && CPU_FREQ
	help
	  Say Y here if you want to temporarily boost CPU frequency upon input
	  events.

	  To compile this driver as a module, choose M here: the
	  module will be called input-cfboost.
```

## arch/arm64/boot/dts/nvidia/drivers/leds/Kconfig
```kconfig
if NEW_LEDS

config LEDS_CY8C
        tristate "LED support for CY8C4014 I2C LED"
        depends on LEDS_CLASS
        depends on I2C
        help
          This option enables support for CY8C4014 based LED through I2C.
          Driver support brightness control and hardware-assisted blinking.

endif
```

## arch/arm64/boot/dts/nvidia/drivers/media/tuners/Kconfig
```kconfig
menu "Nvidia overlay Customize TV tuners"
        visible if !MEDIA_SUBDRV_AUTOSELECT || COMPILE_TEST
        depends on MEDIA_ANALOG_TV_SUPPORT || MEDIA_DIGITAL_TV_SUPPORT || MEDIA_RADIO_SUPPORT || MEDIA_SDR_SUPPORT
config MEDIA_TUNER_TDA18272
	tristate "NXP TDA18272 silicon tuner"
	depends on MEDIA_SUPPORT && I2C
	default m if !MEDIA_SUBDRV_AUTOSELECT
	help
	  A silicon tuner module. Say Y when you want to support this tuner.
endmenu
```

## arch/arm64/boot/dts/nvidia/drivers/mfd/Kconfig
```kconfig
if HAS_IOMEM

config MFD_TMPM32X_I2C
	tristate
	depends on I2C
	depends on OF
	select MFD_CORE

endif
```

## arch/arm64/boot/dts/nvidia/drivers/mtd/devices/Kconfig
```kconfig
config MTD_TEGRA_VIRT
	tristate "Support Tegra Virtual MTD devices"
	depends on MTD_OF_PARTS
	help
	  Adds support for Virtual MTD devices based on Tegra virtualization
	  framework.

	  This will cause virtual MTD device driver to be built to work with
	  physical MTD devices in the backend.
```

## arch/arm64/boot/dts/nvidia/drivers/net/Kconfig
```kconfig
#
# Network device configuration
#

config TEGRA_HV_NET
	tristate "Tegra Hypervisor Network"
	depends on TEGRA_HV_MANAGER
	help
	  Add support for emulating a network device on tegra hypervisor systems.

	  To compile this driver as a module, choose M here: the
	  module will be called tegra_hv_net.
```

## arch/arm64/boot/dts/nvidia/drivers/net/can/mttcan/ivc/Kconfig
```kconfig
config MTTCAN_IVC
	tristate "Bosch M_TTCAN IVC Devices"
	depends on ARCH_TEGRA_18x_SOC && CAN
	select STAGING
	help
	  Support for the Bosch M_TTCAN driver over IVC. The driver
	  is implemented in sensor processor running RTOS. CAN services
	  are made available to Linux though IVC. The Bosch MTTCAN
	  CAN controller has two independent CAN interfaces. These
	  intefaces supports CAN-FD and TT-CAN. This driver requires
	  SocketCAN support enabled in kernel.
```

## arch/arm64/boot/dts/nvidia/drivers/net/can/nvsec/Kconfig
```kconfig
config TEGRA_HV_SECCAN
	tristate "Tegra Hypervisor Security path CAN"
	depends on ARCH_TEGRA_18x_SOC && CAN
	select STAGING
	help
	 Add support for emulating a socketCAN device on tegra hypervisor systems.
	 To compile this driver as a module, choose M here: the
	 module will be called nvsec_hv_can.
```

## arch/arm64/boot/dts/nvidia/drivers/net/ethernet/Kconfig
```kconfig
#
# Ethernet LAN device configuration
#

if ETHERNET

source "drivers/net/ethernet/nvidia/Kconfig"
source "drivers/net/ethernet/realtek/Kconfig"

endif # ETHERNET
```

## arch/arm64/boot/dts/nvidia/drivers/nvpmodel/Kconfig
```kconfig
#
# Nvpmodel EMC CAP Configuration
#

menuconfig NVPMODEL_EMC
	tristate "NVPMODEL_EMC_CAP driver"
	default n
	help
	    This driver add an EMC bwmgr client and expose related cap Sysfs to
	    user space, this make the Nvpmodel to cap EMC BW through Sysfs
	    possible. The cap value is based on different Nvpmodel usecase.
	    The BW cap will effect on not only bwmgr client and also iso client.

	    If in doubt, say N.
```

## arch/arm64/boot/dts/nvidia/drivers/nvpps/Kconfig
```kconfig
config NVPPS
	tristate "Tegra NVPPS Support"
	depends on ARCH_TEGRA_19x_SOC
	help
	  This config enables the Tegra NVPPS driver. NVPPS is the PPS
	  source driver for the Tegra SOC.
```

## arch/arm64/boot/dts/nvidia/drivers/padctrl/Kconfig
```kconfig
if PADCTRL

config PADCTRL_GENERIC_TEGRA_IO_PAD
	bool "Generic Tegra IO Pad control driver"
	depends on ARCH_TEGRA
	help
	  This option enables Genric Tegra IO PAD padctrl driver

	  Tegra IO Pad padctrl driver which controls the IO pad
	  configuration for 1.2V, 1.8V and 3.3V.

endif
```

## arch/arm64/boot/dts/nvidia/drivers/pci/ep/Kconfig
```kconfig
#
# PCI Endpoint Support
#

menu "PCI Endpoint"

config PCIE_TEGRA_DW_EP
	tristate "NVIDIA Tegra DW based PCIe End-Point controller"
	depends on ARCH_TEGRA
	help
	 Say Y here if you want support for the next gen PCIe End-Point controller
	 which is based on Synopsys DesignWare IP suite found on next gen NVIDIA Tegra SoCs.

endmenu
```

## arch/arm64/boot/dts/nvidia/drivers/phy/tegra/Kconfig
```kconfig
#
# PHY
#

config TEGRA_P2U
	tristate "Nvidia Tegra P2U PHY Driver"
	depends on ARCH_TEGRA
	select GENERIC_PHY
	help
	  Enable this to support the P2U (PIPE to UPHY) that is part of Tegra 19x SOCs.
```

## arch/arm64/boot/dts/nvidia/drivers/pinctrl/Kconfig
```kconfig
append_menu "Pin controllers"

config PINCTRL_TEGRA186
	bool "NVIDIA Tegra186 Pinmux support"
	select PINCTRL_TEGRA
	default y if ARCH_TEGRA_18x_SOC
	help
	Support for the NVIDIA Tegra186 PINCTRL controller driver.

config PINCTRL_TEGRA186_PADCTL
	bool "NVIDIA Tegra186 XUSB PADCTL Driver"
	depends on ARCH_TEGRA_18x_SOC
	depends on MAILBOX
	select GENERIC_PHY
	select PINCONF
	select PINMUX

config PINCTRL_TEGRA186_DPAUX
	bool "NVIDIA Tegra186 DP AUX Pinctrl Driver"
        depends on ARCH_TEGRA_18x_SOC
        select PINCONF
        select PINMUX

config PINCTRL_TEGRA194
	bool "NVIDIA Tegra194 Pinmux support"
	select PINCTRL_TEGRA
	default y if ARCH_TEGRA_19x_SOC
	help
	Support for the NVIDIA Tegra194 PINCTRL controller driver.

config PINCTRL_TEGRA194_PEXCLK_PADCTL
	bool "NVIDIA Tegra194 PCIE PEXCLK PADCTL Driver"
	depends on ARCH_TEGRA_19x_SOC
	select PINCONF
	select PINMUX
	help
	  Support for the NVIDIA Tegra194 PCIE PEXCLK Padcontrol
	  configurations. This will provide the mechanism to dynamically
	  select the functionality between camera and PCIE.

endmenu
```

## arch/arm64/boot/dts/nvidia/drivers/power/reset/Kconfig
```kconfig
if POWER_RESET

config POWER_OFF_TMPM32X_I2C
	tristate "Toshiba MCU TMPM32x I2C power off driver"
	depends on I2C
	depends on OF
	select MFD_TMPM32X_I2C
	help
	  This driver supports an external power off trigger via
	  Toshiba MCU TMPM32x I2C.

endif
```

## arch/arm64/boot/dts/nvidia/drivers/ras/Kconfig
```kconfig
config ARM64_RAS
	tristate "ARM64 RAS Handler"
	depends on ARM64 && RAS
	default y
	help
	  This driver adds an interface for handling RAS Correctable
	  Errors per core, per core cluster and per CCPLEX.
```
