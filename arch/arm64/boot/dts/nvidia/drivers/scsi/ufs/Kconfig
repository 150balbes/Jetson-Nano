## nvidia/Documentation/devicetree/bindings/iio/gyro/nvs_a3g4250d.txt
```
* STM A3G4250D Gyro sensor

This driver uses the NVidia Sensor (NVS) framework.
See the nvs.txt documentation for NVS DT capabilities.
The nvs_a3g4250d.c sensor drivers supports the STM devices.

Required properties:
- compatible: Device or generic name.
	      Supported device names:
	      - stm,a3g4250d
  Note: If the part is known and is populated, then it can be specified:
	Example: compatible = "stm,ais328dq";
	When specifying a device this way, the driver will assume this specific
	device is populated during system boot and will not verify its
	existence. If the device is not found, the driver will unload itself.
	This requires regulators to be setup correctly for the probe function.
- reg: i2c address of the device. It should be 0x68.
- interrupt-parent:  GPIO number
- interrupts:  GPIO macro

Optional properties:
- status: set to "ok" or "okay" for normal operation.  Set to anything else
	  to unload the driver without ever communicating with the device.
  Note: The "anything else" above is typically "disabled".
	Since the driver will unload without communicating with the device, the
	device will be left in its POR state.
- gyroscope_disable: Setting this property to <1> will disable the gyroscope.
	gyroscope_disable = <1>;
- vdd-supply: regulator supply for the chip
- vlogic-supply: regulator supply for the chip
  Note: These are required if the driver is to control the regulators.
- gyro_matrix:  Orientation matrix for this device.
- gyro_delay_us_min: Change the max supported sampling rate.
- gyro_delay_us_max: Change the min supported sampling rate.
- stm_odr_override: Override the HW odr setting. This property is defined as
		    a list of tuples of the following form:
		    stm_odr_override = <
				20000	22222	0x20
				10000	11111	0x28
				2500	2778	0x30
				>;
		    where each tuple is described as follows:
			< Current_ODR override_ODR override_hw_ODR >
		    Current_ODR will be replaced by the override_ODR in the
		    stm_odr_tbl in the driver. The hw value will be replaced
		    by the override_hw_ODR.

Example:
	ais328dq@18 {
		compatible = "stm,ais328dq";
                reg = <0x68>;
                interrupt-parent = <&gpio>;
                interrupts = <TEGRA_GPIO(X, 2) 0x01>;
		gyro_matrix = [00 ff 00 ff 00 00 00 00 ff];
		gyro_delay_us_min = <2500>;
		stm_odr_override = <
				20000	22222	0x20
				10000	11111	0x28
				2500	2778	0x30
				>;
	};
```

## nvidia/Documentation/devicetree/bindings/iio/light/nvs_bh1730fvc.txt
```
* ROHM BH1730FVC ambient light sensor

nvs_ drivers use the NVidia Sensor (NVS) framework.
See the nvs.txt documentation for NVS DT capabilities.

Required properties:
- compatible: must be "rohm,bh1730fvc"
- reg: i2c address of the device. It should be 0x29.

Optional properties:
- status: set to "ok" or "okay" for normal operation.  Set to anything else
	  to unload the driver without ever communicating with the device.
  Note: The "anything else" above is typically "disabled".
	Since the driver will unload without communicating with the device, the
	device will be left in its POR state.
- vdd-supply: regulator supply for the chip vcc
- vid-supply: regulator supply for the chip dvi
  Note: This is required if the driver is to control the regulator.
- bh1730fvc-lux-coeff-size: array size of bh1730fvc-lux-coeff.
- bh1730fvc-lux-coeff: Lux calculation coefficient table. See the note.
- bh1730fvc-lux-resolution: See the note.
- bh1730fvc-lux-multiplier: See the note.
  Note: If lux coefficient data is not present, default calculation table is used.
        If present, lux calculation is done with following equation.
        Let following is set in dt:
            bh1730fvc-lux-coeff-size = <5>;
            bh1730fvc-lux-coeff =   < 500 5002 7502>,
                                    < 754 2250 2000>,
                                    <1029 1999 1667>,
                                    <1373  884  583>,
                                    <1879  309  165>;
            bh1730fvc-lux-resolution = <1000>;
            bh1730fvc-lux-multiplier = <360>;
        Then lux is calculated with this equation:
            if (data1 * 1000 / data0 < 500)
                 lux = 5002 * data0 - 7502 * data1
            else if (data1 * 1000 / data0 < 754)
                 lux = 2250 * data0 - 2000 * data1
            else if (data1 * 1000 / data0 < 1029)
                 lux = 1999 * data0 - 1667 * data1
            else if (data1 * 1000 / data0 < 1373)
                 lux = 884 * data0 - 583 * data1
            else if (data1 * 1000 / data0 < 1879)
                 lux = 309 * data0 - 165 * data1
            lux = lux * 360 / (gain * itime_us)

Example:
                bh1730fvc@29 {
                        compatible = "rohm,bh1730fvc";
                        reg = <0x29>;
                        bh1730fvc-lux-coeff-size = <5>;
                        bh1730fvc-lux-coeff =   < 500 5002 7502>,
                                                < 754 2250 2000>,
                                                <1029 1999 1667>,
                                                <1373  884  583>,
                                                <1879  309  165>;
                        bh1730fvc-lux-resolution = <1000>;
                        bh1730fvc-lux-multiplier = <360>;
                };
```

## nvidia/Documentation/devicetree/bindings/iio/light/nvs_cm3217.txt
```
* Capella CM3217 ambient light sensor

nvs_ drivers use the NVidia Sensor (NVS) framework.
See the nvs.txt documentation for NVS DT capabilities.

Required properties:
- compatible: must be "capella,cm3217"
- reg: i2c address of the device. It should be 0x10.

Optional properties:
- illuminance,integration-time: minimum sampling period in nano seconds.
  default: ""480000""
- illuminance,max-range: maximum range of this sensor's value in SI units.
  default: "78643.2"
- illuminance,resolution: conversion factor from sensor raw units to lux.
  default: "307"
- illuminance,power-consumed: rough estimate of this sensor's power consumption in mA.
  default: "1670"
- status: set to "ok" or "okay" for normal operation.  Set to anything else
	  to unload the driver without ever communicating with the device.
  Note: The "anything else" above is typically "disabled".
	Since the driver will unload without communicating with the device, the
	device will be left in its POR state.
	This device's POR comes up in an operational mode and will draw power.
	If it is desired to unload the driver leaving the device in a low power
	sleep state, then use the individual sensor disable mechanism below.
- light_disable: Setting this property to <1> will disable the device and
                 unload the driver.
- vdd-supply: regulator supply for the chip
  Note: This is required if the driver is to control the regulator.

Example:
	cm3217@10 {
		compatible = "capella,cm3217";
		reg = <0x10>;
		vdd-supply = <&palmas_smps9>;
		illuminance,integration-time = "480000";
		illuminance,max-range = "78643.2";
		illuminance,resolution = "7675";
		illuminance,power-consumed = "1670"; /* milli Watt */
	};
```

## nvidia/Documentation/devicetree/bindings/l3_cache/l3_cache.txt
```
l3 cache bindings for t19x
-----------------------------
This document defines l3 cache nodes and its properties for t19x soc.

Required properties:
- compatible: "nvidia,t19x-cache".
- l3-gpu-cpu-ways: Gpu CPU common ways
- l3-gpu-only-ways: Gpu only ways
- l3-total-ways: L3 total ways. Read only property.
- l3-size: Total L3 size in bytes. Read only property.


Example:
--------
	tegra-cache {
		compatible = "nvidia,t19x-cache";
		l3-gpu-cpu-ways = <8>;
		l3-gpu-only-ways = <4>;
		l3-total-ways = <16>;
		l3-size = <0x400000>; /* 4MB */
	};
```
