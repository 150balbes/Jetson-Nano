## arch/arm64/boot/dts/nvidia/drivers/video/tegra/nvmap/nv2/Kconfig
```kconfig
menuconfig TEGRA_NVMAP
	bool "Tegra GPU memory management driver (nvmap)"
	select ARM_DMA_USE_IOMMU if IOMMU_API
	select DMA_SHARED_BUFFER
	select CRYPTO_LZO
	default y
	help
	  Say Y here to include the memory management driver for the Tegra
	  GPU, multimedia and display subsystems

if TEGRA_NVMAP

config NVMAP_PAGE_POOLS
	bool "Use page pools to reduce allocation overhead"
	default y
	help
	  say Y here to reduce the alloction overhead, which is significant
	  for uncached, writecombine and inner cacheable memories as it
	  involves changing page attributes during every allocation per page
	  and flushing cache. Alloc time is reduced by allcoating the pages
	  ahead and keeping them aside. The reserved pages would be released
	  when system is low on memory and acquired back during release of
	  memory.

config NVMAP_PAGE_POOL_DEBUG
	bool "Debugging for page pools"
	depends on NVMAP_PAGE_POOLS
	help
	  Say Y here to include some debugging info in the page pools. This
	  adds a bit of unnecessary overhead so only enable this is you
	  suspect there is an issue with the nvmap page pools.

config NVMAP_PAGE_POOL_SIZE
	depends on NVMAP_PAGE_POOLS
	hex "Page pool size in pages"
	default 0x0

config NVMAP_COLOR_PAGES
	bool "Color pages allocated"
	default y
	help
	  Say Y here to enable page coloring.
	  Page coloring rearranges the pages allocated based on the color
	  of the page. It can improve memory access performance.
	  The coloring option enable can optionally overallocate a portion of
	  reqeusted allcoation size to improve the probabilty of better
	  page coloring. If unsure, say Y.

config NVMAP_CACHE_MAINT_BY_SET_WAYS
	bool "Enable cache maintenance by set/ways"
	help
	 Say Y here to reduce cache maintenance overhead by MVA.
	 This helps in reducing cache maintenance overhead in the systems,
	 where inner cache includes only L1. For the systems, where inner cache
	 includes L1 and L2, keep this option disabled.

config NVMAP_FD_START
	hex "FD number to start allocation from"
	default 0x400
	help
	  NvMap handles are represented with FD's in the user processes.
	  To avoid Linux FD usage limitations, NvMap allocates FD starting
	  from this number.

config NVMAP_DEFER_FD_RECYCLE
	bool "Defer FD recycle"
	help
	  Say Y here to enable deferred FD recycle.
	  A released nvmap handle would release memory and FD. This FD
	  can be reused immediately for subsequent nvmap allocation req in
	  the same process. Any buggy code in client process that continues to
	  use FD of released allocation would continue to use new allocation
	  and can lead to undesired consequences, which can be hard to debug.
	  Enabling this option would defer recycling FD for longer time and
	  allows debugging incorrect FD references by clients by returning errors
	  for the accesses that occur after handle/FD release.

config NVMAP_DEFER_FD_RECYCLE_MAX_FD
	hex "FD number to start free FD recycle"
	depends on NVMAP_DEFER_FD_RECYCLE
	default 0x8000
	help
	  Once last allocated FD reaches this number, allocation of subsequent
	  FD's start from NVMAP_START_FD.

endif
```

## arch/arm64/boot/dts/nvidia/security/Kconfig
```kconfig
#
# Security configuration
#

append_menu "Security options"

source security/tlk_driver/Kconfig

endmenu
```

## arch/arm64/boot/dts/nvidia/sound/soc/Kconfig
```kconfig
if SND_SOC

source "sound/soc/tegra-alt/Kconfig"
source "sound/soc/tegra-virt-alt/Kconfig"

endif
```

## drivers/amlogic/amlnf/Kconfig
```kconfig
#
# Amlogic NAND device configuration
#

menu "Meson NAND Device Support(For NEXT GEN NAND DRIV)"

config AML_NEXT_GEN_NAND
	bool "Meson NAND flash device(Next gen driver)"
	default n
	help
	  Support for NAND flash on Amlogic Meson platforms for Next gen driver

config AML_NFTL_NEW
	tristate "Meson NAND flash new nftl"
	default m
	help
	  Support for NAND flash on Amlogic Meson platforms for Next nftl
	  
config AML_NAND_KEY
	bool "Meson key data store in nand device(dev/nand_key) support"
	depends on AML_NEXT_GEN_NAND
	default n
	help
	  Support   key variable store in NAND device

config SECURE_NAND
	bool "Meson secure data store in nand device support"
	depends on AML_NEXT_GEN_NAND
	default n
	help
	  Support  secure storage in NAND device

endmenu
        
```

## drivers/amlogic/amvecm/Kconfig
```kconfig
#
# AMLOGIC amvecm devices configuration
#

comment "Amlogic VECM Drivers"

menu "Amlogic amvecm Driver"

config AM_VECM
	boolean "Amlogic amvecm driver"
	depends on AM_VOUT
	default n
	help
	  Amlogic amvecm module init

endmenu
```

## drivers/amlogic/pwm/Kconfig
```kconfig
# Amlogic PWM

config MESON_PWM

    tristate "Amlogic PWM support"
    default n
    select PWM
    help
      Say yes here to build support for Generic PWM framework
      driver for AMLOGIC.

      To compile this driver as a module, choose M here: the
      module will be called pwm-meson.

config MESON_PWM_CTRL
    tristate "Amlogic PWM Control driver"
    depends on MESON_PWM
    help
      Say yes here to build support for PWM control to
      Hardkernel devices.

      To compile this driver as a module, choose M here: the
      module will be called pwm-ctrl.
```

## drivers/amlogic/wifi/Kconfig
```kconfig
comment "Amlogic Wifi Driver"

menuconfig AM_WIFI
	boolean "WiFi support"
	default n
	help
		select y to support wifi

if AM_WIFI
config BCMDHD_USE_STATIC_BUF
	boolean "broadcom wifi static buff support"
	depends on AM_WIFI
	default n

config AM_WIFI_DUMMY
	tristate "Amlogic SDIO WiFi turn on and rescan module"
	depends on AM_WIFI
	default m

source "drivers/amlogic/wifi/rtl8189ES/Kconfig"
source "drivers/amlogic/wifi/rtl8189FS/Kconfig"
source "drivers/amlogic/wifi/rtl8192EU/Kconfig"
source "drivers/amlogic/wifi/rtl8192ES/Kconfig"
source "drivers/amlogic/wifi/rtl8723AU/Kconfig"
source "drivers/amlogic/wifi/rtl8723BS/Kconfig"
source "drivers/amlogic/wifi/rtl8811AU/Kconfig"
source "drivers/amlogic/wifi/rtl8812AU/Kconfig"
source "drivers/amlogic/wifi/rtl8xxx_CU/Kconfig"
source "drivers/amlogic/wifi/rtl8xxx_DU/Kconfig"
source "drivers/amlogic/wifi/rtl8xxx_EU/Kconfig"
source "drivers/amlogic/wifi/rtl8822BU/Kconfig"
source "drivers/amlogic/wifi/bcmdhd/Kconfig"

endif # AM_WIFI
```

## drivers/amlogic/wifi/rtl8192ES/Kconfig
```kconfig
config RTL8192ES
	tristate "Realtek 8192E SDIO WiFi"
	depends on SDIO
	---help---
	  Help message of RTL8192ES
```

## drivers/amlogic/wifi/rtl8xxx_DU/Kconfig
```kconfig
config RTL8192DU
	tristate "Realtek 8192D USB WiFi"
	depends on USB
	select WIRELESS_EXT
	select WEXT_PRIV
	---help---
	  Help message of RTL8192DU
```

## drivers/gpu/drm/lima/Kconfig
```kconfig
# SPDX-License-Identifier: GPL-2.0 OR MIT
# Copyright 2017-2018 Qiang Yu <yuq825@gmail.com>

config DRM_LIMA
       tristate "LIMA (DRM support for ARM Mali 400/450 GPU)"
       depends on DRM
       select DRM_SCHED
       help
         DRM driver for ARM Mali 400/450 GPUs.
```

## drivers/media/platform/meson/dvb/Kconfig
```kconfig
#
# Meson dvb driver configuration
#

menu "Meson dvb drivers"

config MESON_DVB
	tristate "Meson dvb drivers"
	default n
	select DVB_CORE
	help
		Select to enable Meson dvb drivers.
endmenu
```

## nvidia/Documentation/devicetree/bindings/arm/arm64_ras.txt
```
* ARMv8.2 RAS Driver
==============================

RAS are three aspects of the dependability of a system:
Reliability: continuity of correct service
Availability: readiness for correct service
Serviceability: ability to undergo modifications and repairs

ARMv8.2 provides RAS extensions to achieve the above features in a system.

arm64_ras driver allows you to handle Correctable errors using
Fault Handling Interrupt (or FHI).

The driver provides an API for CPU sepcific RAS drivers to
register callbacks in case of FHI. When FHI occurs, the FHI
ISR goes through the list of registered callbacks and executes
them.

Required Properties:

- compatible : Should be "arm,armv8.2-ras"
- interrupts : Represents the Fault Handling Interrupt

Example:
=========

	arm64_ras: arm64_ras {
		compatible = "arm,armv8.2ras";
		interrupts = <0 400 0x04>;
		status = "disabled";
	};
```

## nvidia/Documentation/devicetree/bindings/cpufreq/tegra_cpufreq_t18x.txt
```
* Device tree binding for Nvidia Tegra18x cpufreq driver for EDVD device
--------------------------------------------

This document defines the device-specific binding for the Tegra18x cpufreq
driver. It should not contain bindings for generic tegra cpufreq driver
which are common across all the tegra cpufreq platform driver.

The Tegra18x cpufreq driver adjusts CPU frequency by writing voltage and
freq hint in EDVD per core volt freq request registers. It calculates per
core cpufreq by reading per core cycle counters. Cycles are measured by
reading EDVD per core clock count registers and divided by ref clock counter.
The ressult is multiplied by ref clock.

Tegra18x cpufreq driver considers these EDVD registers as device to measure
and adjust cpu freq. There is one instance of EDVD for the Denver cluster
and one for the A57 cluster.

Required properties:
- compatible: should be "nvidia,tegra18x-cpufreq".
- reg: an array of four 64-bit unsigned integers.
       the base address and size for Denver EDVD aperture and the base
       address and size for the A57 EDVD aperture.

- status: "okay" or "disabled" to enable/disable the node.

Optional properties:
- freq_table_step_size:
  Cpu frequency table step size. If not provided, default value 4.

  For example, if list of original available frequencies(in KHz) are:
  345600 384000 422400 460800 499200 537600 576000 614400 652800 691200
  729600 768000 806400 844800 883200 921600 960000 998400 1036800 1075200
  1113600 1152000 1190400 1228800 1267200 1305600 1344000 1382400 1420800
  1459200 1497600 1536000 1574400 1612800 1651200 1689600 1728000 1766400
  1804800 1843200

  Setting freq_table_step_size to 1 will include all these frequencies in
  cpufreq table as available frequencies.

  Setting freq_table_step_size to 2 will skip alternative entries and will
  include remaining entries in cpufreq table as available frequencies.
  With freq_table_step_size as 2, cpufreq table available frequencies will be:
  345600 422400 499200 576000 652800 729600 806400 883200 960000 1036800
  1113600 1190400 1267200 1344000 1420800 1497600 1574400 1651200 1728000
  1804800 1843200

  Similarly, freq_table_step_size of value 3 will skip every 2nd and 3rd entries
  in groups of 3 entries consecutively.

- nvidia,enable-autocc3: Enable auto_cc3.
  Auto cc3 is the idle state where freq request is not considered for the cpus
  in WFI/WFE. It has per cluster, <cluster_no enable/disable> entries to enable
  / disable per cluster cc3.
  It assumes that 0th index of the array as entry for 0th(M_CLUSTER)
  cluster. It should be set as <cluster_no and enable/disable> way.
  Therfore 1nd index is considered as enable/disable value for
  0th cluster. Like that 2nd index will have entry for 1st(B_cluster)
  cluster 3rd index will have enable/disable value for 1st cluster.
  Assumptions -
  clusters values -
     0 - M_CLUSTER
     1 - B_CLUSTER
   Disable/Enable
     0 - Disable
     1 - Enable

  * Need to fill all the clusters state.
  * If a cluster is disabled its cc3 freq will be Don't care.

- nvidia,autocc3-freq: autocc3 cluster freq.
  If a cluster goes in idle, cc3 freq will be requested for the cluster.
  It has per cluster values to request per cluster cc3 freq.
  It takes values as <cluster_no freq_in_khz>. It assumes 0th index of
  the array has entry of 0th(M_CLUSTER) cluster, 1st index as 0th cluster
  cc3 freq, 2nd index as 1st(B_CLUSTER) cluster and 3rd index as 1st
  cluster cc3 freq.

  Assumptions -
  clusters values -
     0 - M_CLUSTER
     1 - B_CLUSTER
  freq_in_khz values -
     0 - Fmin@Vmin
     freq_khz - cc3 freq for the cluster

  * Need to fill all the clusters state.
  * If a cluster is disabled its cc3 freq will be Don't care.
Example 1:
----------
       cpufreq@e070000 {
               compatible = "nvidia,tegra18x-cpufreq";
               reg = <0x0 0x0e070000 0x0 0x1000>, /* M/Denver cluster */
                     <0x0 0x0e060000 0x0 0x1000>; /* B/ARM cluster */
               status = "disabled";
       };

Example 2:
----------
       cpufreq@e070000 {
               compatible = "nvidia,tegra18x-cpufreq";
               reg = <0x0 0x0e070000 0x0 0x1000>, /* M/Denver cluster */
                     <0x0 0x0e060000 0x0 0x1000>; /* B/ARM cluster */
               freq_table_step_size = /bits/ 16 <1>;
       };

Example 3: cpufreq and auto-cc3 enabled, freq = Fmax@Vmin for each cluster
----------
       cpufreq@e070000 {
               compatible = "nvidia,tegra18x-cpufreq";
               reg = <0x0 0x0e070000 0x0 0x1000>, /* M/Denver cluster */
                     <0x0 0x0e060000 0x0 0x1000>; /* B/ARM cluster */
               status = "okay";
               nvidia,enable-autocc3 = <0 1>, /* M_CLUSTER Enable*/
                      <1 1>; /* B_CLUSTER Enable*/
               nvidia,autocc3-freq = <0 0>, /* M_CLUSTER Fmin@vmin*/
                      <1 0>; /* B_CLUSTER Fmin@vmin*/
       };

Example 4: cpufreq and auto-cc3 enabled, cc3_freq for both cluster
----------
       cpufreq@e070000 {
               compatible = "nvidia,tegra18x-cpufreq";
               reg = <0x0 0x0e070000 0x0 0x1000>, /* M/Denver cluster */
                     <0x0 0x0e060000 0x0 0x1000>; /* B/ARM cluster */
               status = "okay";
               nvidia,enable-autocc3 = <0 0>, /* M_CLUSTER Disable*/
                      <1 1>; /* B_CLUSTER Enable*/
               nvidia,autocc3-freq = <0 0>, /* M_CLUSTER Fmin@vmin*/
                      <1 0>; /* B_CLUSTER Fmin@vmin*/
       };

Example 5: cpufreq and auto-cc3 enabled, cc3_freq for M cluster
           auto-cc3 is disabled for B cluster
----------
       cpufreq@e070000 {
               compatible = "nvidia,tegra18x-cpufreq";
               reg = <0x0 0x0e070000 0x0 0x1000>, /* M/Denver cluster */
                     <0x0 0x0e060000 0x0 0x1000>; /* B/ARM cluster */
               status = "okay";
               nvidia,enable-autocc3 = <0 0>, /* M_CLUSTER Enable*/
                      <1 0>; /* B_CLUSTER Disable*/
       };

Example 6: cpufreq and auto-cc3 enabled, freq = Fmax@Vmin for M cluster
           auto-cc3 is disabled for B cluster
----------
       cpufreq@e070000 {
               compatible = "nvidia,tegra18x-cpufreq";
               reg = <0x0 0x0e070000 0x0 0x1000>, /* M/Denver cluster */
                     <0x0 0x0e060000 0x0 0x1000>; /* B/ARM cluster */
               status = "okay";
               nvidia,enable-autocc3 = <0 1>, /* M_CLUSTER Enable*/
                      <1 1>; /* B_CLUSTER Enable*/
               nvidia,autocc3-freq = <0 512000>, /* M_CLUSTER 512Mhz*/
                      <1 644000>; /* B_CLUSTER 644 Mhz*/
       };
```

## nvidia/Documentation/devicetree/bindings/iio/generic/nvs_led_test.txt
```
Binding for NVS LED Test driver

Required Properties:
 - compatible: "nvidia,nvs-led-test"
 - out-gpios: GPIO which is used to light up an attached LED. This will be
              driven high when the driver fires off a sensor event. The
              GPIO will remain high for a time interval = the value written
              to the on_ms sysfs entry.

Optional Properties:
 - enable-gpio: GPIO which is required to be enabled in order for the
                attached LED to toggle as expected.

Example:

nvs-led-test {
	compatible = "nvidia,nvs-led-test";
	out-gpios = <&tegra_main_gpio TEGRA_MAIN_GPIO(D, 3) 0>;
	status = "okay";
};
```
