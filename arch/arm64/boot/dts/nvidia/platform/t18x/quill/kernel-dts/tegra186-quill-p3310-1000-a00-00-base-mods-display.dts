/*
 * tegra186-quill-p3310-1000-a00-00-base-mods-display.dts Quill A00 Board
 *
 * Device tree file that enables MODS-specific display config for
 * Quill Product.
 *
 * Copyright (c) 2016, NVIDIA CORPORATION.  All rights reserved.
 *
 * This program is free software; you can redistribute it and/or modify
 * it under the terms of the GNU General Public License as published by
 * the Free Software Foundation; version 2 of the License.
 *
 * This program is distributed in the hope that it will be useful, but WITHOUT
 * ANY WARRANTY; without even the implied warranty of MERCHANTABILITY or
 * FITNESS FOR A PARTICULAR PURPOSE.  See the GNU General Public License for
 * more details.
 */

#include "tegra186-quill-p3310-1000-a00-00-base.dts"
#include <t18x-common-platforms/mods-display.dtsi>

/ {
	nvidia,dtsfilename = __FILE__;
};
