/*
 * Top level DTS file for CVM:P2888-0001 and CVB:P2822-0000 with MAX-N thermal profile.
 *
 * Copyright (c) 2018-2019, NVIDIA CORPORATION.  All rights reserved.
 *
 * This program is free software; you can redistribute it and/or modify
 * it under the terms of the GNU General Public License as published by
 * the Free Software Foundation; version 2 of the License.
 *
 * This program is distributed in the hope that it will be useful, but WITHOUT
 * ANY WARRANTY; without even the implied warranty of MERCHANTABILITY or
 * FITNESS FOR A PARTICULAR PURPOSE.  See the GNU General Public License for
 * more details.
 */

#include "tegra194-p2888-0001-p2822-0000.dts"
#include "t19x-common-platforms/tegra194-thermal-maxn.dtsi"
