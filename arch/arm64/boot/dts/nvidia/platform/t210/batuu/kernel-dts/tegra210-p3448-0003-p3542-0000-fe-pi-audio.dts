// SPDX-License-Identifier: GPL-2.0-only
/*
 * Device-tree overlay for FE-PI Audio V1 and Z V2 with board
 * tegra210-p3448-0003-p3542-0000.
 *
 * Copyright (c) 2020 NVIDIA CORPORATION. All rights reserved.
 *
 */

/dts-v1/;
/plugin/;

#include <dt-common/jetson/tegra210-p3448-0003-p3542-0000.h>
#include <overlays/jetson-fe-pi-audio.dts>
