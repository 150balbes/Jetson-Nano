// SPDX-License-Identifier: GPL-2.0-only
/*
 * Device-tree overlay for tegra210-p3448-0003-p3542-0000 40-pin
 * Expansion Header.
 *
 * Copyright (c) 2020 NVIDIA CORPORATION. All rights reserved.
 *
 */

/dts-v1/;
/plugin/;

#include <dt-common/jetson/tegra210-p3448-0003-p3542-0000.h>
#include "../../porg/kernel-dts/tegra210-p3448-0000-p3449-0000-hdr40.dtsi"
