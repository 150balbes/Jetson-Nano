// SPDX-License-Identifier: GPL-2.0-only
/*
 * Device-tree overlay for Adafruit I2S MEMS Microphone Breakout
 * (SPH0645LM4H) with board tegra210-jetson-tx1-p2597-2180-a01-devkit.
 *
 * Copyright (c) 2019 NVIDIA CORPORATION. All rights reserved.
 *
 */

/dts-v1/;
/plugin/;

#include <dt-common/jetson/tegra210-jetson-tx1-p2597-2180-a01-devkit.h>
#include <overlays/jetson-adafruit-sph0645lm4h.dts>
