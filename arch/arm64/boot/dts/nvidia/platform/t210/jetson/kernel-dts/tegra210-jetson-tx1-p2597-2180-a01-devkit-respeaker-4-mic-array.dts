// SPDX-License-Identifier: GPL-2.0-only
/*
 * Device-tree overlay for ReSpeaker 4 Mic Array with board
 * tegra210-jetson-tx1-p2597-2180-a01-devkit.
 *
 * Copyright (c) 2020 NVIDIA CORPORATION. All rights reserved.
 *
 */

/dts-v1/;
/plugin/;

#include <dt-common/jetson/tegra210-jetson-tx1-p2597-2180-a01-devkit.h>
#include <overlays/jetson-respeaker-4-mic-array.dts>
