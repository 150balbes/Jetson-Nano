// SPDX-License-Identifier: GPL-2.0-only
/*
 * Device-tree overlay for tegra210-p3448-0000-p3449-0000-a01 40-pin
 * Expansion Header.
 *
 * Copyright (c) 2019-2020 NVIDIA CORPORATION. All rights reserved.
 *
 */

/dts-v1/;
/plugin/;

#include <dt-common/jetson/tegra210-p3448-0000-p3449-0000-a01.h>
#include "tegra210-p3448-0000-p3449-0000-hdr40.dtsi"
