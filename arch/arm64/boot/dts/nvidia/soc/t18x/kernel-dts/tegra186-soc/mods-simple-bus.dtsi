/*
 * Copyright (c) 2017, NVIDIA CORPORATION.  All rights reserved.
 *
 * This program is free software; you can redistribute it and/or modify
 * it under the terms of the GNU General Public License as published by
 * the Free Software Foundation; version 2 of the License.
 *
 * This program is distributed in the hope that it will be useful, but WITHOUT
 * ANY WARRANTY; without even the implied warranty of MERCHANTABILITY or
 * FITNESS FOR A PARTICULAR PURPOSE.  See the GNU General Public License for
 * more details.
 */

#include <dt-bindings/clock/tegra186-clock.h>
#include <dt-bindings/reset/tegra186-reset.h>

/ {
	mods-simple-bus {
			compatible = "simple-bus";
			device_type = "mods-simple-bus";
			#address-cells = <1>;
			#size-cells = <0>;

			mods-clocks {
				compatible = "nvidia,mods-clocks";
				status = "disabled";
				clocks = <&tegra_car TEGRA186_CLK_OSC>,
					 <&tegra_car TEGRA186_CLK_CLK_M>,
					 <&tegra_car TEGRA186_CLK_CLK_32K>,
					 <&tegra_car TEGRA186_CLK_PLL_REF>,
					 <&tegra_car TEGRA186_CLK_UARTA>,
					 <&tegra_car TEGRA186_CLK_UARTB>,
					 <&tegra_car TEGRA186_CLK_UARTC>,
					 <&tegra_car TEGRA186_CLK_UARTD>,
					 <&tegra_car TEGRA186_CLK_UARTE>,
					 <&tegra_car TEGRA186_CLK_UARTF>,
					 <&tegra_car TEGRA186_CLK_UARTG>,
					 <&tegra_car TEGRA186_CLK_AHUB>,
					 <&tegra_car TEGRA186_CLK_APB2APE>,
					 <&tegra_car TEGRA186_CLK_APE>,
					 <&tegra_car TEGRA186_CLK_I2S1>,
					 <&tegra_car TEGRA186_CLK_I2S2>,
					 <&tegra_car TEGRA186_CLK_I2S3>,
					 <&tegra_car TEGRA186_CLK_I2S4>,
					 <&tegra_car TEGRA186_CLK_I2S5>,
					 <&tegra_car TEGRA186_CLK_I2S6>,
					 <&tegra_car TEGRA186_CLK_DMIC1>,
					 <&tegra_car TEGRA186_CLK_DMIC2>,
					 <&tegra_car TEGRA186_CLK_DMIC3>,
					 <&tegra_car TEGRA186_CLK_DMIC4>,
					 <&tegra_car TEGRA186_CLK_DMIC5>,
					 <&tegra_car TEGRA186_CLK_SPDIF_IN>,
					 <&tegra_car TEGRA186_CLK_SPDIF_OUT>,
					 <&tegra_car TEGRA186_CLK_DSPK1>,
					 <&tegra_car TEGRA186_CLK_DSPK2>,
					 <&tegra_car TEGRA186_CLK_IQC1>,
					 <&tegra_car TEGRA186_CLK_IQC2>,
					 <&tegra_car TEGRA186_CLK_AUD_MCLK>,
					 <&tegra_car TEGRA186_CLK_NVCSI>,
					 <&tegra_car TEGRA186_CLK_VI>,
					 <&tegra_car TEGRA186_CLK_ISP>,
					 <&tegra_car TEGRA186_CLK_EXTPERIPH1>,
					 <&tegra_car TEGRA186_CLK_EXTPERIPH2>,
					 <&tegra_car TEGRA186_CLK_EXTPERIPH3>,
					 <&tegra_car TEGRA186_CLK_EXTPERIPH4>,
					 <&tegra_car TEGRA186_CLK_SATA>,
					 <&tegra_car TEGRA186_CLK_SATA_OOB>,
					 <&tegra_car TEGRA186_CLK_SATA_IOBIST>,
					 <&tegra_car TEGRA186_CLK_QSPI>,
					 <&tegra_car TEGRA186_CLK_SPI1>,
					 <&tegra_car TEGRA186_CLK_SPI2>,
					 <&tegra_car TEGRA186_CLK_SPI3>,
					 <&tegra_car TEGRA186_CLK_SPI4>,
					 <&tegra_car TEGRA186_CLK_I2C1>,
					 <&tegra_car TEGRA186_CLK_I2C2>,
					 <&tegra_car TEGRA186_CLK_I2C3>,
					 <&tegra_car TEGRA186_CLK_I2C4>,
					 <&tegra_car TEGRA186_CLK_I2C5>,
					 <&tegra_car TEGRA186_CLK_I2C6>,
					 <&tegra_car TEGRA186_CLK_I2C7>,
					 <&tegra_car TEGRA186_CLK_I2C8>,
					 <&tegra_car TEGRA186_CLK_I2C9>,
					 <&tegra_car TEGRA186_CLK_I2C10>,
					 <&tegra_car TEGRA186_CLK_I2C12>,
					 <&tegra_car TEGRA186_CLK_I2C13>,
					 <&tegra_car TEGRA186_CLK_I2C14>,
					 <&tegra_car TEGRA186_CLK_SDMMC1>,
					 <&tegra_car TEGRA186_CLK_SDMMC2>,
					 <&tegra_car TEGRA186_CLK_SDMMC3>,
					 <&tegra_car TEGRA186_CLK_SDMMC4>,
					 <&tegra_car TEGRA186_CLK_SDMMC_LEGACY_TM>,
					 <&tegra_car TEGRA186_CLK_XUSB>,
					 <&tegra_car TEGRA186_CLK_XUSB_DEV>,
					 <&tegra_car TEGRA186_CLK_XUSB_HOST>,
					 <&tegra_car TEGRA186_CLK_XUSB_SS>,
					 <&tegra_car TEGRA186_CLK_XUSB_CORE_SS>,
					 <&tegra_car TEGRA186_CLK_XUSB_CORE_DEV>,
					 <&tegra_car TEGRA186_CLK_XUSB_FALCON>,
					 <&tegra_car TEGRA186_CLK_XUSB_FS>,
					 <&tegra_car TEGRA186_CLK_AXI_CBB>,
					 <&tegra_car TEGRA186_CLK_PWM1>,
					 <&tegra_car TEGRA186_CLK_PWM2>,
					 <&tegra_car TEGRA186_CLK_PWM3>,
					 <&tegra_car TEGRA186_CLK_PWM4>,
					 <&tegra_car TEGRA186_CLK_PWM5>,
					 <&tegra_car TEGRA186_CLK_PWM6>,
					 <&tegra_car TEGRA186_CLK_PWM7>,
					 <&tegra_car TEGRA186_CLK_PWM8>,
					 <&tegra_car TEGRA186_CLK_EMC>,
					 <&tegra_car TEGRA186_CLK_NVDISPLAY_P0>,
					 <&tegra_car TEGRA186_CLK_NVDISPLAY_P1>,
					 <&tegra_car TEGRA186_CLK_NVDISPLAY_P2>,
					 <&tegra_car TEGRA186_CLK_UFSHC>,
					 <&tegra_car TEGRA186_CLK_UFSDEV_REF>,
					 <&tegra_car TEGRA186_CLK_MPHY_L0_RX_SYMB>,
					 <&tegra_car TEGRA186_CLK_MPHY_L0_RX_LS_BIT>,
					 <&tegra_car TEGRA186_CLK_MPHY_L0_TX_SYMB>,
					 <&tegra_car TEGRA186_CLK_MPHY_L0_TX_LS_3XBIT>,
					 <&tegra_car TEGRA186_CLK_MPHY_L0_RX_ANA>,
					 <&tegra_car TEGRA186_CLK_MPHY_L1_RX_ANA>,
					 <&tegra_car TEGRA186_CLK_MPHY_IOBIST>,
					 <&tegra_car TEGRA186_CLK_MPHY_TX_1MHZ_REF>,
					 <&tegra_car TEGRA186_CLK_MPHY_CORE_PLL_FIXED>,
					 <&tegra_car TEGRA186_CLK_UPHY_PLL0_PWRSEQ>,
					 <&tegra_car TEGRA186_CLK_UPHY_PLL1_PWRSEQ>,
					 <&tegra_car TEGRA186_CLK_PEX_SATA_USB_RX_BYP>,
					 <&tegra_car TEGRA186_CLK_PEX_USB_PAD0_MGMT>,
					 <&tegra_car TEGRA186_CLK_PEX_USB_PAD1_MGMT>,
					 <&tegra_car TEGRA186_CLK_TACH>,
					 <&tegra_car TEGRA186_CLK_PLLP_OUT0>,
					 <&tegra_car TEGRA186_CLK_PLLP_OUT5>,
					 <&tegra_car TEGRA186_CLK_PLLP>,
					 <&tegra_car TEGRA186_CLK_PLLP_DIV8>,
					 <&tegra_car TEGRA186_CLK_PLLA>,
					 <&tegra_car TEGRA186_CLK_PLLA1>,
					 <&tegra_car TEGRA186_CLK_PLL_A_OUT0>,
					 <&tegra_car TEGRA186_CLK_PLL_A_OUT1>,
					 <&tegra_car TEGRA186_CLK_PLLC>,
					 <&tegra_car TEGRA186_CLK_PLLC_OUT_ISP>,
					 <&tegra_car TEGRA186_CLK_PLLC_OUT_VE>,
					 <&tegra_car TEGRA186_CLK_PLLC_OUT_AON>,
					 <&tegra_car TEGRA186_CLK_PLLC2>,
					 <&tegra_car TEGRA186_CLK_PLLC3>,
					 <&tegra_car TEGRA186_CLK_PLLC4_VCO>,
					 <&tegra_car TEGRA186_CLK_PLLC4_OUT>,
					 <&tegra_car TEGRA186_CLK_PLLC4_OUT0>,
					 <&tegra_car TEGRA186_CLK_PLLC4_OUT1>,
					 <&tegra_car TEGRA186_CLK_PLLC4_OUT2>,
					 <&tegra_car TEGRA186_CLK_PLLC4_OUT_MUX>,
					 <&tegra_car TEGRA186_CLK_PLLD>,
					 <&tegra_car TEGRA186_CLK_PLLD_OUT1>,
					 <&tegra_car TEGRA186_CLK_PLLD2>,
					 <&tegra_car TEGRA186_CLK_PLLD3>,
					 <&tegra_car TEGRA186_CLK_PLLDP>,
					 <&tegra_car TEGRA186_CLK_PLLE>,
					 <&tegra_car TEGRA186_CLK_PLLREFE_OUT>,
					 <&tegra_car TEGRA186_CLK_PLLREFE_PLL_REF>,
					 <&tegra_car TEGRA186_CLK_PLLREFE_OUT_GATED>,
					 <&tegra_car TEGRA186_CLK_PLLREFE_OUT1>,
					 <&tegra_car TEGRA186_CLK_PLLREFE_VCO>,
					 <&tegra_car TEGRA186_CLK_PLLU>,
					 <&tegra_car TEGRA186_CLK_PLL_U_48M>,
					 <&tegra_car TEGRA186_CLK_PLL_U_480M>;
				clock-names = "osc",
					"clk_m",
					"clk_32k",
					"pll_ref",
					"uarta",
					"uartb",
					"uartc",
					"uartd",
					"uarte",
					"uartf",
					"uartg",
					"ahub",
					"apb2ape",
					"ape",
					"i2s1",
					"i2s2",
					"i2s3",
					"i2s4",
					"i2s5",
					"i2s6",
					"dmic1",
					"dmic2",
					"dmic3",
					"dmic4",
					"dmic5",
					"spdif_in",
					"spdif_out",
					"dspk1",
					"dspk2",
					"iqc1",
					"iqc2",
					"aud_mclk",
					"nvcsi",
					"vi",
					"isp",
					"extperiph1",
					"extperiph2",
					"extperiph3",
					"extperiph4",
					"sata",
					"sata_oob",
					"sata_iobist",
					"qspi",
					"spi1",
					"spi2",
					"spi3",
					"spi4",
					"i2c1",
					"i2c2",
					"i2c3",
					"i2c4",
					"i2c5",
					"i2c6",
					"i2c7",
					"i2c8",
					"i2c9",
					"i2c10",
					"i2c12",
					"i2c13",
					"i2c14",
					"sdmmc1",
					"sdmmc2",
					"sdmmc3",
					"sdmmc4",
					"sdmmc_legacy_tm",
					"xusb",
					"xusb_dev",
					"xusb_host",
					"xusb_ss",
					"xusb_core_ss",
					"xusb_core_dev",
					"xusb_falcon",
					"xusb_fs",
					"axi_cbb",
					"pwm1",
					"pwm2",
					"pwm3",
					"pwm4",
					"pwm5",
					"pwm6",
					"pwm7",
					"pwm8",
					"emc",
					"nvdisplay_p0",
					"nvdisplay_p1",
					"nvdisplay_p2",
					"ufshc",
					"ufsdev_ref",
					"mphy_l0_rx_symb",
					"mphy_l0_rx_ls_bit",
					"mphy_l0_tx_symb",
					"mphy_l0_tx_ls_3xbit",
					"mphy_l0_rx_ana",
					"mphy_l1_rx_ana",
					"mphy_iobist",
					"mphy_tx_1mhz_ref",
					"mphy_core_pll_fixed",
					"uphy_pll0_pwrseq",
					"uphy_pll1_pwrseq",
					"pex_sata_usb_rx_byp",
					"pex_usb_pad0_mgmt",
					"pex_usb_pad1_mgmt",
					"tach",
					"pllp_out0",
					"pllp_out5",
					"pllp",
					"pllp_div8",
					"plla",
					"plla1",
					"pll_a_out0",
					"pll_a_out1",
					"pllc",
					"pllc_out_isp",
					"pllc_out_ve",
					"pllc_out_aon",
					"pllc2",
					"pllc3",
					"pllc4_vco",
					"pllc4_out",
					"pllc4_out0",
					"pllc4_out1",
					"pllc4_out2",
					"pllc4_out_mux",
					"pll_d",
					"pll_d_out1",
					"pll_d2",
					"pll_d3",
					"pll_dp",
					"plle",
					"pllrefe_out",
					"pllrefe_pll_ref",
					"pllrefe_out_gated",
					"pllrefe_out1",
					"pllrefe_vco",
					"pllu",
					"pllu_48M",
					"pllu_480M";
				resets = <&tegra_car TEGRA186_RESET_UARTA>,
					 <&tegra_car TEGRA186_RESET_UARTB>,
					 <&tegra_car TEGRA186_RESET_UARTC>,
					 <&tegra_car TEGRA186_RESET_UARTD>,
					 <&tegra_car TEGRA186_RESET_UARTE>,
					 <&tegra_car TEGRA186_RESET_UARTF>,
					 <&tegra_car TEGRA186_RESET_UARTG>,
					 <&tegra_car TEGRA186_RESET_APE>,
					 <&tegra_car TEGRA186_RESET_DMIC5>,
					 <&tegra_car TEGRA186_RESET_AUD_MCLK>,
					 <&tegra_car TEGRA186_RESET_NVCSI>,
					 <&tegra_car TEGRA186_RESET_VI>,
					 <&tegra_car TEGRA186_RESET_ISP>,
					 <&tegra_car TEGRA186_RESET_EXTPERIPH1>,
					 <&tegra_car TEGRA186_RESET_EXTPERIPH2>,
					 <&tegra_car TEGRA186_RESET_EXTPERIPH3>,
					 <&tegra_car TEGRA186_RESET_EXTPERIPH4>,
					 <&tegra_car TEGRA186_RESET_SATA>,
					 <&tegra_car TEGRA186_RESET_QSPI>,
					 <&tegra_car TEGRA186_RESET_SPI1>,
					 <&tegra_car TEGRA186_RESET_SPI2>,
					 <&tegra_car TEGRA186_RESET_SPI3>,
					 <&tegra_car TEGRA186_RESET_SPI4>,
					 <&tegra_car TEGRA186_RESET_I2C1>,
					 <&tegra_car TEGRA186_RESET_I2C2>,
					 <&tegra_car TEGRA186_RESET_I2C3>,
					 <&tegra_car TEGRA186_RESET_I2C4>,
					 <&tegra_car TEGRA186_RESET_I2C5>,
					 <&tegra_car TEGRA186_RESET_I2C6>,
					 <&tegra_car TEGRA186_RESET_I2C7>,
					 <&tegra_car TEGRA186_RESET_I2C8>,
					 <&tegra_car TEGRA186_RESET_I2C9>,
					 <&tegra_car TEGRA186_RESET_I2C10>,
					 <&tegra_car TEGRA186_RESET_I2C12>,
					 <&tegra_car TEGRA186_RESET_I2C13>,
					 <&tegra_car TEGRA186_RESET_I2C14>,
					 <&tegra_car TEGRA186_RESET_SDMMC1>,
					 <&tegra_car TEGRA186_RESET_SDMMC2>,
					 <&tegra_car TEGRA186_RESET_SDMMC3>,
					 <&tegra_car TEGRA186_RESET_SDMMC4>,
					 <&tegra_car TEGRA186_RESET_XUSB_DEV>,
					 <&tegra_car TEGRA186_RESET_XUSB_HOST>,
					 <&tegra_car TEGRA186_RESET_XUSB_SS>,
					 <&tegra_car TEGRA186_RESET_AXI_CBB>,
					 <&tegra_car TEGRA186_RESET_PWM1>,
					 <&tegra_car TEGRA186_RESET_PWM2>,
					 <&tegra_car TEGRA186_RESET_PWM3>,
					 <&tegra_car TEGRA186_RESET_PWM4>,
					 <&tegra_car TEGRA186_RESET_PWM5>,
					 <&tegra_car TEGRA186_RESET_PWM6>,
					 <&tegra_car TEGRA186_RESET_PWM7>,
					 <&tegra_car TEGRA186_RESET_PWM8>,
					 <&tegra_car TEGRA186_RESET_UFSHC>,
					 <&tegra_car TEGRA186_RESET_MPHY_IOBIST>,
					 <&tegra_car TEGRA186_RESET_TACH>;
				reset-names = "uarta",
				 	      "uartb",
					      "uartc",
					      "uartd",
					      "uarte",
					      "uartf",
					      "uartg",
					      "ape",
					      "dmic5",
					      "aud_mclk",
					      "nvcsi",
					      "vi",
					      "isp",
					      "extperiph1",
					      "extperiph2",
					      "extperiph3",
					      "extperiph4",
					      "sata",
					      "qspi",
					      "spi1",
					      "spi2",
					      "spi3",
					      "spi4",
					      "i2c1",
					      "i2c2",
					      "i2c3",
					      "i2c4",
					      "i2c5",
					      "i2c6",
					      "i2c7",
					      "i2c8",
					      "i2c9",
					      "i2c10",
					      "i2c12",
					      "i2c13",
					      "i2c14",
					      "sdmmc1",
					      "sdmmc2",
					      "sdmmc3",
					      "sdmmc4",
					      "xusb_dev",
					      "xusb_host",
					      "xusb_ss",
					      "axi_cbb",
					      "pwm1",
					      "pwm2",
					      "pwm3",
					      "pwm4",
					      "pwm5",
					      "pwm6",
					      "pwm7",
					      "pwm8",
					      "ufshc",
					      "mphy_iobist",
					      "tach";
		};
 	};
 };
