/*
 * Copyright (c) 2017, NVIDIA CORPORATION.  All rights reserved.
 *
 * This program is free software; you can redistribute it and/or modify
 * it under the terms of the GNU General Public License as published by
 * the Free Software Foundation; version 2 of the License.
 *
 * This program is distributed in the hope that it will be useful, but WITHOUT
 * ANY WARRANTY; without even the implied warranty of MERCHANTABILITY or
 * FITNESS FOR A PARTICULAR PURPOSE.  See the GNU General Public License for
 * more details.
 */

#include <dt-bindings/clock/tegra210-car.h>
#include <dt-bindings/reset/tegra210-car.h>

/ {
	mods-simple-bus {
			compatible = "simple-bus";
			device_type = "mods-simple-bus";
			#address-cells = <1>;
			#size-cells = <0>;

			mods-clocks {
					compatible = "nvidia,mods-clocks";
					status = "disabled";
					clocks = <&tegra_car TEGRA210_CLK_ISPB>,
						 <&tegra_car TEGRA210_CLK_RTC>,
						 <&tegra_car TEGRA210_CLK_TIMER>,
						 <&tegra_car TEGRA210_CLK_UARTA>,
						 <&tegra_car TEGRA210_CLK_GPIO>,
						 <&tegra_car TEGRA210_CLK_SDMMC2>,
						 <&tegra_car TEGRA210_CLK_I2S1>,
						 <&tegra_car TEGRA210_CLK_I2C1>,
						 <&tegra_car TEGRA210_CLK_SDMMC1>,
						 <&tegra_car TEGRA210_CLK_SDMMC4>,
						 <&tegra_car TEGRA210_CLK_PWM>,
						 <&tegra_car TEGRA210_CLK_I2S2>,
						 <&tegra_car TEGRA210_CLK_VI>,
						 <&tegra_car TEGRA210_CLK_USBD>,
						 <&tegra_car TEGRA210_CLK_ISPA>,
						 <&tegra_car TEGRA210_CLK_DISP2>,
						 <&tegra_car TEGRA210_CLK_DISP1>,
						 <&tegra_car TEGRA210_CLK_HOST1X>,
						 <&tegra_car TEGRA210_CLK_I2S0>,
						 <&tegra_car TEGRA210_CLK_MC>,
						 <&tegra_car TEGRA210_CLK_AHBDMA>,
						 <&tegra_car TEGRA210_CLK_APBDMA>,
						 <&tegra_car TEGRA210_CLK_PMC>,
						 <&tegra_car TEGRA210_CLK_KFUSE>,
						 <&tegra_car TEGRA210_CLK_SBC1>,
						 <&tegra_car TEGRA210_CLK_SBC2>,
						 <&tegra_car TEGRA210_CLK_SBC3>,
						 <&tegra_car TEGRA210_CLK_I2C5>,
						 <&tegra_car TEGRA210_CLK_DSIA>,
						 <&tegra_car TEGRA210_CLK_CSI>,
						 <&tegra_car TEGRA210_CLK_I2C2>,
						 <&tegra_car TEGRA210_CLK_UARTC>,
						 <&tegra_car TEGRA210_CLK_MIPI_CAL>,
						 <&tegra_car TEGRA210_CLK_EMC>,
						 <&tegra_car TEGRA210_CLK_USB2>,
						 <&tegra_car TEGRA210_CLK_BSEV>,
						 <&tegra_car TEGRA210_CLK_UARTD>,
						 <&tegra_car TEGRA210_CLK_I2C3>,
						 <&tegra_car TEGRA210_CLK_SBC4>,
						 <&tegra_car TEGRA210_CLK_SDMMC3>,
						 <&tegra_car TEGRA210_CLK_PCIE>,
						 <&tegra_car TEGRA210_CLK_OWR>,
						 <&tegra_car TEGRA210_CLK_AFI>,
						 <&tegra_car TEGRA210_CLK_CSITE>,
						 <&tegra_car TEGRA210_CLK_LA>,
						 <&tegra_car TEGRA210_CLK_SOC_THERM>,
						 <&tegra_car TEGRA210_CLK_DTV>,
						 <&tegra_car TEGRA210_CLK_I2CSLOW>,
						 <&tegra_car TEGRA210_CLK_DSIB>,
						 <&tegra_car TEGRA210_CLK_TSEC>,
						 <&tegra_car TEGRA210_CLK_XUSB_HOST>,
						 <&tegra_car TEGRA210_CLK_CSUS>,
						 <&tegra_car TEGRA210_CLK_MSELECT>,
						 <&tegra_car TEGRA210_CLK_TSENSOR>,
						 <&tegra_car TEGRA210_CLK_I2S3>,
						 <&tegra_car TEGRA210_CLK_I2S4>,
						 <&tegra_car TEGRA210_CLK_I2C4>,
						 <&tegra_car TEGRA210_CLK_D_AUDIO>,
						 <&tegra_car TEGRA210_CLK_APB2APE>,
						 <&tegra_car TEGRA210_CLK_HDA2CODEC_2X>,
						 <&tegra_car TEGRA210_CLK_SPDIF_2X>,
						 <&tegra_car TEGRA210_CLK_ACTMON>,
						 <&tegra_car TEGRA210_CLK_EXTERN1>,
						 <&tegra_car TEGRA210_CLK_EXTERN2>,
						 <&tegra_car TEGRA210_CLK_EXTERN3>,
						 <&tegra_car TEGRA210_CLK_SATA_OOB>,
						 <&tegra_car TEGRA210_CLK_SATA>,
						 <&tegra_car TEGRA210_CLK_HDA>,
						 <&tegra_car TEGRA210_CLK_SE>,
						 <&tegra_car TEGRA210_CLK_HDA2HDMI>,
						 <&tegra_car TEGRA210_CLK_SATA_COLD>,
						 <&tegra_car TEGRA210_CLK_CEC>,
						 <&tegra_car TEGRA210_CLK_XUSB_GATE>,
						 <&tegra_car TEGRA210_CLK_CILAB>,
						 <&tegra_car TEGRA210_CLK_CILCD>,
						 <&tegra_car TEGRA210_CLK_CILE>,
						 <&tegra_car TEGRA210_CLK_DSIALP>,
						 <&tegra_car TEGRA210_CLK_DSIBLP>,
						 <&tegra_car TEGRA210_CLK_ENTROPY>,
						 <&tegra_car TEGRA210_CLK_DP2>,
						 <&tegra_car TEGRA210_CLK_XUSB_SS>,
						 <&tegra_car TEGRA210_CLK_DMIC1>,
						 <&tegra_car TEGRA210_CLK_DMIC2>,
						 <&tegra_car TEGRA210_CLK_I2C6>,
						 <&tegra_car TEGRA210_CLK_MC_CAPA>,
						 <&tegra_car TEGRA210_CLK_MC_CBPA>,
						 <&tegra_car TEGRA210_CLK_VIM2_CLK>,
						 <&tegra_car TEGRA210_CLK_MIPIBIF>,
						 <&tegra_car TEGRA210_CLK_CLK72MHZ>,
						 <&tegra_car TEGRA210_CLK_VIC03>,
						 <&tegra_car TEGRA210_CLK_DPAUX>,
						 <&tegra_car TEGRA210_CLK_SOR0>,
						 <&tegra_car TEGRA210_CLK_SOR1>,
						 <&tegra_car TEGRA210_CLK_GPU>,
						 <&tegra_car TEGRA210_CLK_DBGAPB>,
						 <&tegra_car TEGRA210_CLK_PLL_P_OUT_ADSP>,
						 <&tegra_car TEGRA210_CLK_PLL_G_REF>,
						 <&tegra_car TEGRA210_CLK_SDMMC_LEGACY>,
						 <&tegra_car TEGRA210_CLK_NVDEC>,
						 <&tegra_car TEGRA210_CLK_NVJPG>,
						 <&tegra_car TEGRA210_CLK_DMIC3>,
						 <&tegra_car TEGRA210_CLK_APE>,
						 <&tegra_car TEGRA210_CLK_ADSP>,
						 <&tegra_car TEGRA210_CLK_MC_CDPA>,
						 <&tegra_car TEGRA210_CLK_MC_CCPA>,
						 <&tegra_car TEGRA210_CLK_MAUD>,
						 <&tegra_car TEGRA210_CLK_TSECB>,
						 <&tegra_car TEGRA210_CLK_DPAUX1>,
						 <&tegra_car TEGRA210_CLK_VI_I2C>,
						 <&tegra_car TEGRA210_CLK_HSIC_TRK>,
						 <&tegra_car TEGRA210_CLK_USB2_TRK>,
						 <&tegra_car TEGRA210_CLK_QSPI>,
						 <&tegra_car TEGRA210_CLK_UARTAPE>,
						 <&tegra_car TEGRA210_CLK_ADSP_NEON>,
						 <&tegra_car TEGRA210_CLK_NVENC>,
						 <&tegra_car TEGRA210_CLK_IQC2>,
						 <&tegra_car TEGRA210_CLK_IQC1>,
						 <&tegra_car TEGRA210_CLK_SOR_SAFE>,
						 <&tegra_car TEGRA210_CLK_PLL_P_OUT_CPU>,
						 <&tegra_car TEGRA210_CLK_UARTB>,
						 <&tegra_car TEGRA210_CLK_VFIR>,
						 <&tegra_car TEGRA210_CLK_SPDIF_IN>,
						 <&tegra_car TEGRA210_CLK_SPDIF_OUT>,
						 <&tegra_car TEGRA210_CLK_VI_SENSOR>,
						 <&tegra_car TEGRA210_CLK_FUSE>,
						 <&tegra_car TEGRA210_CLK_FUSE_BURN>,
						 <&tegra_car TEGRA210_CLK_CLK_32K>,
						 <&tegra_car TEGRA210_CLK_CLK_M>,
						 <&tegra_car TEGRA210_CLK_CLK_M_DIV2>,
						 <&tegra_car TEGRA210_CLK_CLK_M_DIV4>,
						 <&tegra_car TEGRA210_CLK_PLL_REF>,
						 <&tegra_car TEGRA210_CLK_PLL_C>,
						 <&tegra_car TEGRA210_CLK_PLL_C_OUT1>,
						 <&tegra_car TEGRA210_CLK_PLL_C2>,
						 <&tegra_car TEGRA210_CLK_PLL_C3>,
						 <&tegra_car TEGRA210_CLK_PLL_M>,
						 <&tegra_car TEGRA210_CLK_PLL_M_OUT1>,
						 <&tegra_car TEGRA210_CLK_PLL_P>,
						 <&tegra_car TEGRA210_CLK_PLL_P_OUT1>,
						 <&tegra_car TEGRA210_CLK_PLL_P_OUT2>,
						 <&tegra_car TEGRA210_CLK_PLL_P_OUT3>,
						 <&tegra_car TEGRA210_CLK_PLL_P_OUT4>,
						 <&tegra_car TEGRA210_CLK_PLL_A>,
						 <&tegra_car TEGRA210_CLK_PLL_A_OUT0>,
						 <&tegra_car TEGRA210_CLK_PLL_D>,
						 <&tegra_car TEGRA210_CLK_PLL_D_OUT0>,
						 <&tegra_car TEGRA210_CLK_PLL_D2>,
						 <&tegra_car TEGRA210_CLK_PLL_D2_OUT0>,
						 <&tegra_car TEGRA210_CLK_PLL_U>,
						 <&tegra_car TEGRA210_CLK_PLL_U_480M>,
						 <&tegra_car TEGRA210_CLK_PLL_U_60M>,
						 <&tegra_car TEGRA210_CLK_PLL_U_48M>,
						 <&tegra_car TEGRA210_CLK_PLL_X>,
						 <&tegra_car TEGRA210_CLK_PLL_X_OUT0>,
						 <&tegra_car TEGRA210_CLK_PLL_RE_VCO>,
						 <&tegra_car TEGRA210_CLK_PLL_RE_OUT>,
						 <&tegra_car TEGRA210_CLK_PLL_E>,
						 <&tegra_car TEGRA210_CLK_SPDIF_IN_SYNC>,
						 <&tegra_car TEGRA210_CLK_I2S0_SYNC>,
						 <&tegra_car TEGRA210_CLK_I2S1_SYNC>,
						 <&tegra_car TEGRA210_CLK_I2S2_SYNC>,
						 <&tegra_car TEGRA210_CLK_I2S3_SYNC>,
						 <&tegra_car TEGRA210_CLK_I2S4_SYNC>,
						 <&tegra_car TEGRA210_CLK_VIMCLK_SYNC>,
						 <&tegra_car TEGRA210_CLK_AUDIO0>,
						 <&tegra_car TEGRA210_CLK_AUDIO1>,
						 <&tegra_car TEGRA210_CLK_AUDIO2>,
						 <&tegra_car TEGRA210_CLK_AUDIO3>,
						 <&tegra_car TEGRA210_CLK_AUDIO4>,
						 <&tegra_car TEGRA210_CLK_SPDIF>,
						 <&tegra_car TEGRA210_CLK_CLK_OUT_1>,
						 <&tegra_car TEGRA210_CLK_CLK_OUT_2>,
						 <&tegra_car TEGRA210_CLK_CLK_OUT_3>,
						 <&tegra_car TEGRA210_CLK_BLINK>,
						 <&tegra_car TEGRA210_CLK_QSPI_OUT>,
						 <&tegra_car TEGRA210_CLK_XUSB_HOST_SRC>,
						 <&tegra_car TEGRA210_CLK_XUSB_FALCON_SRC>,
						 <&tegra_car TEGRA210_CLK_XUSB_FS_SRC>,
						 <&tegra_car TEGRA210_CLK_XUSB_SS_SRC>,
						 <&tegra_car TEGRA210_CLK_XUSB_DEV_SRC>,
						 <&tegra_car TEGRA210_CLK_XUSB_DEV>,
						 <&tegra_car TEGRA210_CLK_XUSB_HS_SRC>,
						 <&tegra_car TEGRA210_CLK_SCLK>,
						 <&tegra_car TEGRA210_CLK_HCLK>,
						 <&tegra_car TEGRA210_CLK_PCLK>,
						 <&tegra_car TEGRA210_CLK_CCLK_G>,
						 <&tegra_car TEGRA210_CLK_CCLK_LP>,
						 <&tegra_car TEGRA210_CLK_DFLL_REF>,
						 <&tegra_car TEGRA210_CLK_DFLL_SOC>,
						 <&tegra_car TEGRA210_CLK_VI_SENSOR2>,
						 <&tegra_car TEGRA210_CLK_PLL_P_OUT5>,
						 <&tegra_car TEGRA210_CLK_CML0>,
						 <&tegra_car TEGRA210_CLK_CML1>,
						 <&tegra_car TEGRA210_CLK_PLL_C4>,
						 <&tegra_car TEGRA210_CLK_PLL_DP>,
						 <&tegra_car TEGRA210_CLK_PLL_E_MUX>,
						 <&tegra_car TEGRA210_CLK_PLL_MB>,
						 <&tegra_car TEGRA210_CLK_PLL_A1>,
						 <&tegra_car TEGRA210_CLK_PLL_D_DSI_OUT>,
						 <&tegra_car TEGRA210_CLK_PLL_C4_OUT0>,
						 <&tegra_car TEGRA210_CLK_PLL_C4_OUT1>,
						 <&tegra_car TEGRA210_CLK_PLL_C4_OUT2>,
						 <&tegra_car TEGRA210_CLK_PLL_C4_OUT3>,
						 <&tegra_car TEGRA210_CLK_PLL_U_OUT>,
						 <&tegra_car TEGRA210_CLK_PLL_U_OUT1>,
						 <&tegra_car TEGRA210_CLK_PLL_U_OUT2>,
						 <&tegra_car TEGRA210_CLK_USB2_HSIC_TRK>,
						 <&tegra_car TEGRA210_CLK_PLL_P_OUT_HSIO>,
						 <&tegra_car TEGRA210_CLK_PLL_P_OUT_XUSB>,
						 <&tegra_car TEGRA210_CLK_XUSB_SSP_SRC>,
						 <&tegra_car TEGRA210_CLK_PLL_RE_OUT1>,
						 <&tegra_car TEGRA210_CLK_PLL_MB_UD>,
						 <&tegra_car TEGRA210_CLK_PLL_P_UD>,
						 <&tegra_car TEGRA210_CLK_ISP>,
						 <&tegra_car TEGRA210_CLK_PLL_A_OUT_ADSP>,
						 <&tegra_car TEGRA210_CLK_PLL_A_OUT0_OUT_ADSP>,
						 <&tegra_car TEGRA210_CLK_AUDIO0_MUX>,
						 <&tegra_car TEGRA210_CLK_AUDIO1_MUX>,
						 <&tegra_car TEGRA210_CLK_AUDIO2_MUX>,
						 <&tegra_car TEGRA210_CLK_AUDIO3_MUX>,
						 <&tegra_car TEGRA210_CLK_AUDIO4_MUX>,
						 <&tegra_car TEGRA210_CLK_SPDIF_MUX>,
						 <&tegra_car TEGRA210_CLK_CLK_OUT_1_MUX>,
						 <&tegra_car TEGRA210_CLK_CLK_OUT_2_MUX>,
						 <&tegra_car TEGRA210_CLK_CLK_OUT_3_MUX>,
						 <&tegra_car TEGRA210_CLK_DSIA_MUX>,
						 <&tegra_car TEGRA210_CLK_DSIB_MUX>,
						 <&tegra_car TEGRA210_CLK_SOR0_LVDS>,
						 <&tegra_car TEGRA210_CLK_XUSB_SS_DIV2>,
						 <&tegra_car TEGRA210_CLK_PLL_M_UD>,
						 <&tegra_car TEGRA210_CLK_PLL_C_UD>,
						 <&tegra_car TEGRA210_CLK_SCLK_MUX>,
						 <&tegra_car TEGRA210_CLK_SOR1_BRICK>,
						 <&tegra_car TEGRA210_CLK_SOR1_MUX>,
						 <&tegra_car TEGRA210_CLK_PD2VI>,
						 <&tegra_car TEGRA210_CLK_VI_OUTPUT>,
						 <&tegra_car TEGRA210_CLK_ACLK>,
						 <&tegra_car TEGRA210_CLK_SCLK_SKIPPER>,
						 <&tegra_car TEGRA210_CLK_DISP1_SLCG_OVR>,
						 <&tegra_car TEGRA210_CLK_DISP2_SLCG_OVR>,
						 <&tegra_car TEGRA210_CLK_VI_SLCG_OVR>,
						 <&tegra_car TEGRA210_CLK_ISPA_SLCG_OVR>,
						 <&tegra_car TEGRA210_CLK_ISPB_SLCG_OVR>,
						 <&tegra_car TEGRA210_CLK_NVDEC_SLCG_OVR>,
						 <&tegra_car TEGRA210_CLK_NVENC_SLCG_OVR>,
						 <&tegra_car TEGRA210_CLK_NVJPG_SLCG_OVR>,
						 <&tegra_car TEGRA210_CLK_VIC03_SLCG_OVR>,
						 <&tegra_car TEGRA210_CLK_XUSB_DEV_SLCG_OVR>,
						 <&tegra_car TEGRA210_CLK_XUSB_HOST_SLCG_OVR>,
						 <&tegra_car TEGRA210_CLK_D_AUDIO_SLCG_OVR>,
						 <&tegra_car TEGRA210_CLK_APE_SLCG_OVR>,
						 <&tegra_car TEGRA210_CLK_SATA_SLCG_OVR>,
						 <&tegra_car TEGRA210_CLK_SATA_SLCG_OVR_IPFS>,
						 <&tegra_car TEGRA210_CLK_SATA_SLCG_OVR_FPCI>,
						 <&tegra_car TEGRA210_CLK_DMIC1_SYNC_CLK>,
						 <&tegra_car TEGRA210_CLK_DMIC1_SYNC_CLK_MUX>,
						 <&tegra_car TEGRA210_CLK_DMIC2_SYNC_CLK>,
						 <&tegra_car TEGRA210_CLK_DMIC2_SYNC_CLK_MUX>,
						 <&tegra_car TEGRA210_CLK_DMIC3_SYNC_CLK>,
						 <&tegra_car TEGRA210_CLK_DMIC3_SYNC_CLK_MUX>,
						 <&tegra_car TEGRA210_CLK_ACLK_SLCG_OVR>,
						 <&tegra_car TEGRA210_CLK_C2BUS>,
						 <&tegra_car TEGRA210_CLK_C3BUS>,
						 <&tegra_car TEGRA210_CLK_VIC03_CBUS>,
						 <&tegra_car TEGRA210_CLK_NVJPG_CBUS>,
						 <&tegra_car TEGRA210_CLK_SE_CBUS>,
						 <&tegra_car TEGRA210_CLK_TSECB_CBUS>,
						 <&tegra_car TEGRA210_CLK_CAP_C2BUS>,
						 <&tegra_car TEGRA210_CLK_CAP_VCORE_C2BUS>,
						 <&tegra_car TEGRA210_CLK_CAP_THROTTLE_C2BUS>,
						 <&tegra_car TEGRA210_CLK_FLOOR_C2BUS>,
						 <&tegra_car TEGRA210_CLK_OVERRIDE_C2BUS>,
						 <&tegra_car TEGRA210_CLK_EDP_C2BUS>,
						 <&tegra_car TEGRA210_CLK_NVENC_CBUS>,
						 <&tegra_car TEGRA210_CLK_NVDEC_CBUS>,
						 <&tegra_car TEGRA210_CLK_VIC_FLOOR_CBUS>,
						 <&tegra_car TEGRA210_CLK_CAP_C3BUS>,
						 <&tegra_car TEGRA210_CLK_CAP_VCORE_C3BUS>,
						 <&tegra_car TEGRA210_CLK_CAP_THROTTLE_C3BUS>,
						 <&tegra_car TEGRA210_CLK_FLOOR_C3BUS>,
						 <&tegra_car TEGRA210_CLK_OVERRIDE_C3BUS>,
						 <&tegra_car TEGRA210_CLK_VI_CBUS>,
						 <&tegra_car TEGRA210_CLK_ISP_CBUS>,
						 <&tegra_car TEGRA210_CLK_OVERRIDE_CBUS>,
						 <&tegra_car TEGRA210_CLK_CAP_VCORE_CBUS>,
						 <&tegra_car TEGRA210_CLK_VIA_VI_CBUS>,
						 <&tegra_car TEGRA210_CLK_VIB_VI_CBUS>,
						 <&tegra_car TEGRA210_CLK_ISPA_ISP_CBUS>,
						 <&tegra_car TEGRA210_CLK_ISPB_ISP_CBUS>,
						 <&tegra_car TEGRA210_CLK_SBUS>,
						 <&tegra_car TEGRA210_CLK_AVP_SCLK>,
						 <&tegra_car TEGRA210_CLK_BSEA_SCLK>,
						 <&tegra_car TEGRA210_CLK_USBD_SCLK>,
						 <&tegra_car TEGRA210_CLK_USB1_SCLK>,
						 <&tegra_car TEGRA210_CLK_USB2_SCLK>,
						 <&tegra_car TEGRA210_CLK_USB3_SCLK>,
						 <&tegra_car TEGRA210_CLK_WAKE_SCLK>,
						 <&tegra_car TEGRA210_CLK_CAMERA_SCLK>,
						 <&tegra_car TEGRA210_CLK_MON_AVP>,
						 <&tegra_car TEGRA210_CLK_CAP_SCLK>,
						 <&tegra_car TEGRA210_CLK_CAP_VCORE_SCLK>,
						 <&tegra_car TEGRA210_CLK_CAP_THROTTLE_SCLK>,
						 <&tegra_car TEGRA210_CLK_FLOOR_SCLK>,
						 <&tegra_car TEGRA210_CLK_OVERRIDE_SCLK>,
						 <&tegra_car TEGRA210_CLK_SBC1_SCLK>,
						 <&tegra_car TEGRA210_CLK_SBC2_SCLK>,
						 <&tegra_car TEGRA210_CLK_SBC3_SCLK>,
						 <&tegra_car TEGRA210_CLK_SBC4_SCLK>,
						 <&tegra_car TEGRA210_CLK_QSPI_SCLK>,
						 <&tegra_car TEGRA210_CLK_BOOT_APB_SCLK>,
						 <&tegra_car TEGRA210_CLK_EMC_MASTER>,
						 <&tegra_car TEGRA210_CLK_AVP_EMC>,
						 <&tegra_car TEGRA210_CLK_CPU_EMC>,
						 <&tegra_car TEGRA210_CLK_DISP1_EMC>,
						 <&tegra_car TEGRA210_CLK_DISP2_EMC>,
						 <&tegra_car TEGRA210_CLK_DISP1_LA_EMC>,
						 <&tegra_car TEGRA210_CLK_DISP2_LA_EMC>,
						 <&tegra_car TEGRA210_CLK_USBD_EMC>,
						 <&tegra_car TEGRA210_CLK_USB1_EMC>,
						 <&tegra_car TEGRA210_CLK_USB2_EMC>,
						 <&tegra_car TEGRA210_CLK_USB3_EMC>,
						 <&tegra_car TEGRA210_CLK_SDMMC3_EMC>,
						 <&tegra_car TEGRA210_CLK_SDMMC4_EMC>,
						 <&tegra_car TEGRA210_CLK_MON_EMC>,
						 <&tegra_car TEGRA210_CLK_CAP_EMC>,
						 <&tegra_car TEGRA210_CLK_CAP_VCORE_EMC>,
						 <&tegra_car TEGRA210_CLK_CAP_THROTTLE_EMC>,
						 <&tegra_car TEGRA210_CLK_GR3D_EMC>,
						 <&tegra_car TEGRA210_CLK_NVENC_EMC>,
						 <&tegra_car TEGRA210_CLK_NVJPG_EMC>,
						 <&tegra_car TEGRA210_CLK_NVDEC_EMC>,
						 <&tegra_car TEGRA210_CLK_TSEC_EMC>,
						 <&tegra_car TEGRA210_CLK_TSECB_EMC>,
						 <&tegra_car TEGRA210_CLK_CAMERA_EMC>,
						 <&tegra_car TEGRA210_CLK_VIA_EMC>,
						 <&tegra_car TEGRA210_CLK_VIB_EMC>,
						 <&tegra_car TEGRA210_CLK_ISPA_EMC>,
						 <&tegra_car TEGRA210_CLK_ISPB_EMC>,
						 <&tegra_car TEGRA210_CLK_ISO_EMC>,
						 <&tegra_car TEGRA210_CLK_FLOOR_EMC>,
						 <&tegra_car TEGRA210_CLK_OVERRIDE_EMC>,
						 <&tegra_car TEGRA210_CLK_EDP_EMC>,
						 <&tegra_car TEGRA210_CLK_VIC_EMC>,
						 <&tegra_car TEGRA210_CLK_VIC_SHARED_EMC>,
						 <&tegra_car TEGRA210_CLK_APE_EMC>,
						 <&tegra_car TEGRA210_CLK_PCIE_EMC>,
						 <&tegra_car TEGRA210_CLK_XUSB_EMC>,
						 <&tegra_car TEGRA210_CLK_GBUS>,
						 <&tegra_car TEGRA210_CLK_GM20B_GBUS>,
						 <&tegra_car TEGRA210_CLK_CAP_GBUS>,
						 <&tegra_car TEGRA210_CLK_EDP_GBUS>,
						 <&tegra_car TEGRA210_CLK_CAP_VGPU_GBUS>,
						 <&tegra_car TEGRA210_CLK_CAP_THROTTLE_GBUS>,
						 <&tegra_car TEGRA210_CLK_CAP_PROFILE_GBUS>,
						 <&tegra_car TEGRA210_CLK_OVERRIDE_GBUS>,
						 <&tegra_car TEGRA210_CLK_FLOOR_GBUS>,
						 <&tegra_car TEGRA210_CLK_FLOOR_PROFILE_GBUS>,
						 <&tegra_car TEGRA210_CLK_HOST1X_MASTER>,
						 <&tegra_car TEGRA210_CLK_NV_HOST1X>,
						 <&tegra_car TEGRA210_CLK_VI_HOST1X>,
						 <&tegra_car TEGRA210_CLK_VII2C_HOST1X>,
						 <&tegra_car TEGRA210_CLK_CAP_HOST1X>,
						 <&tegra_car TEGRA210_CLK_CAP_VCORE_HOST1X>,
						 <&tegra_car TEGRA210_CLK_FLOOR_HOST1X>,
						 <&tegra_car TEGRA210_CLK_OVERRIDE_HOST1X>,
						 <&tegra_car TEGRA210_CLK_MSELECT_MASTER>,
						 <&tegra_car TEGRA210_CLK_CPU_MSELECT>,
						 <&tegra_car TEGRA210_CLK_PCIE_MSELECT>,
						 <&tegra_car TEGRA210_CLK_CAP_VCORE_MSELECT>,
						 <&tegra_car TEGRA210_CLK_OVERRIDE_MSELECT>,
						 <&tegra_car TEGRA210_CLK_APE_MASTER>,
						 <&tegra_car TEGRA210_CLK_ADMA_APE>,
						 <&tegra_car TEGRA210_CLK_ADSP_APE>,
						 <&tegra_car TEGRA210_CLK_XBAR_APE>,
						 <&tegra_car TEGRA210_CLK_CAP_VCORE_APE>,
						 <&tegra_car TEGRA210_CLK_OVERRIDE_APE>,
						 <&tegra_car TEGRA210_CLK_ABUS>,
						 <&tegra_car TEGRA210_CLK_ADSP_CPU_ABUS>,
						 <&tegra_car TEGRA210_CLK_CAP_VCORE_ABUS>,
						 <&tegra_car TEGRA210_CLK_OVERRIDE_ABUS>,
						 <&tegra_car TEGRA210_CLK_VCM_SCLK>,
						 <&tegra_car TEGRA210_CLK_VCM_AHB_SCLK>,
						 <&tegra_car TEGRA210_CLK_VCM_APB_SCLK>,
						 <&tegra_car TEGRA210_CLK_AHB_SCLK>,
						 <&tegra_car TEGRA210_CLK_APB_SCLK>,
						 <&tegra_car TEGRA210_CLK_SDMMC4_AHB_SCLK>,
						 <&tegra_car TEGRA210_CLK_BATTERY_EMC>,
						 <&tegra_car TEGRA210_CLK_CBUS>;
					clock-names = "ispb",
						      "rtc",
						      "timer",
						      "uarta",
						      "gpio",
						      "sdmmc2",
						      "i2s1",
						      "i2c1",
						      "sdmmc1",
						      "sdmmc4",
						      "pwm",
						      "i2s2",
						      "vi",
						      "usbd",
						      "ispa",
						      "disp2",
						      "disp1",
						      "host1x",
						      "i2s0",
						      "mc",
						      "ahbdma",
						      "apbdma",
						      "pmc",
						      "kfuse",
						      "sbc1",
						      "sbc2",
						      "sbc3",
						      "i2c5",
						      "dsia",
						      "csi",
						      "i2c2",
						      "uartc",
						      "mipi_cal",
						      "emc",
						      "usb2",
						      "bsev",
						      "uartd",
						      "i2c3",
						      "sbc4",
						      "sdmmc3",
						      "pcie",
						      "owr",
						      "afi",
						      "csite",
						      "la",
						      "soc_therm",
						      "dtv",
						      "i2cslow",
						      "dsib",
						      "tsec",
						      "xusb_host",
						      "csus",
						      "mselect",
						      "tsensor",
						      "i2s3",
						      "i2s4",
						      "i2c4",
						      "d_audio",
						      "apb2ape",
						      "hda2codec_2x",
						      "spdif_2x",
						      "actmon",
						      "extern1",
						      "extern2",
						      "extern3",
						      "sata_oob",
						      "sata",
						      "hda",
						      "se",
						      "hda2hdmi",
						      "sata_cold",
						      "cec",
						      "xusb_gate",
						      "cilab",
						      "cilcd",
						      "cile",
						      "dsialp",
						      "dsiblp",
						      "entropy",
						      "dp2",
						      "xusb_ss",
						      "dmic1",
						      "dmic2",
						      "i2c6",
						      "mc_capa",
						      "mc_cbpa",
						      "vim2_clk",
						      "mipibif",
						      "clk72mhz",
						      "vic03",
						      "dpaux",
						      "sor0",
						      "sor1",
						      "gpu",
						      "dbgapb",
						      "pll_p_out_adsp",
						      "pll_g_ref",
						      "sdmmc_legacy",
						      "nvdec",
						      "nvjpg",
						      "dmic3",
						      "ape",
						      "adsp",
						      "mc_cdpa",
						      "mc_ccpa",
						      "maud",
						      "tsecb",
						      "dpaux1",
						      "vi_i2c",
						      "hsic_trk",
						      "usb2_trk",
						      "qspi",
						      "uartape",
						      "adsp_neon",
						      "nvenc",
						      "iqc2",
						      "iqc1",
						      "sor_safe",
						      "pll_p_out_cpu",
						      "uartb",
						      "vfir",
						      "spdif_in",
						      "spdif_out",
						      "vi_sensor",
						      "fuse",
						      "fuse_burn",
						      "clk_32k",
						      "clk_m",
						      "clk_m_div2",
						      "clk_m_div4",
						      "pll_ref",
						      "pll_c",
						      "pll_c_out1",
						      "pll_c2",
						      "pll_c3",
						      "pll_m",
						      "pll_m_out1",
						      "pll_p",
						      "pll_p_out1",
						      "pll_p_out2",
						      "pll_p_out3",
						      "pll_p_out4",
						      "pll_a",
						      "pll_a_out0",
						      "pll_d",
						      "pll_d_out0",
						      "pll_d2",
						      "pll_d2_out0",
						      "pll_u",
						      "pll_u_480m",
						      "pll_u_60m",
						      "pll_u_48m",
						      "pll_x",
						      "pll_x_out0",
						      "pll_re_vco",
						      "pll_re_out",
						      "pll_e",
						      "spdif_in_sync",
						      "i2s0_sync",
						      "i2s1_sync",
						      "i2s2_sync",
						      "i2s3_sync",
						      "i2s4_sync",
						      "vimclk_sync",
						      "audio0",
						      "audio1",
						      "audio2",
						      "audio3",
						      "audio4",
						      "spdif",
						      "clk_out_1",
						      "clk_out_2",
						      "clk_out_3",
						      "blink",
						      "qspi_out",
						      "xusb_host_src",
						      "xusb_falcon_src",
						      "xusb_fs_src",
						      "xusb_ss_src",
						      "xusb_dev_src",
						      "xusb_dev",
						      "xusb_hs_src",
						      "sclk",
						      "hclk",
						      "pclk",
						      "cclk_g",
						      "cclk_lp",
						      "dfll_ref",
						      "dfll_soc",
						      "vi_sensor2",
						      "pll_p_out5",
						      "cml0",
						      "cml1",
						      "pll_c4",
						      "pll_dp",
						      "pll_e_mux",
						      "pll_mb",
						      "pll_a1",
						      "pll_d_dsi_out",
						      "pll_c4_out0",
						      "pll_c4_out1",
						      "pll_c4_out2",
						      "pll_c4_out3",
						      "pll_u_out",
						      "pll_u_out1",
						      "pll_u_out2",
						      "usb2_hsic_trk",
						      "pll_p_out_hsio",
						      "pll_p_out_xusb",
						      "xusb_ssp_src",
						      "pll_re_out1",
						      "pll_mb_ud",
						      "pll_p_ud",
						      "isp",
						      "pll_a_out_adsp",
						      "pll_a_out0_out_adsp",
						      "audio0_mux",
						      "audio1_mux",
						      "audio2_mux",
						      "audio3_mux",
						      "audio4_mux",
						      "spdif_mux",
						      "clk_out_1_mux",
						      "clk_out_2_mux",
						      "clk_out_3_mux",
						      "dsia_mux",
						      "dsib_mux",
						      "sor0_lvds",
						      "xusb_ss_div2",
						      "pll_m_ud",
						      "pll_c_ud",
						      "sclk_mux",
						      "sor1_brick",
						      "sor1_mux",
						      "pd2vi",
						      "vi_output",
						      "aclk",
						      "sclk_skipper",
						      "disp1_slcg_ovr",
						      "disp2_slcg_ovr",
						      "vi_slcg_ovr",
						      "ispa_slcg_ovr",
						      "ispb_slcg_ovr",
						      "nvdec_slcg_ovr",
						      "nvenc_slcg_ovr",
						      "nvjpg_slcg_ovr",
						      "vic03_slcg_ovr",
						      "xusb_dev_slcg_ovr",
						      "xusb_host_slcg_ovr",
						      "d_audio_slcg_ovr",
						      "ape_slcg_ovr",
						      "sata_slcg_ovr",
						      "sata_slcg_ovr_ipfs",
						      "sata_slcg_ovr_fpci",
						      "dmic1_sync_clk",
						      "dmic1_sync_clk_mux",
						      "dmic2_sync_clk",
						      "dmic2_sync_clk_mux",
						      "dmic3_sync_clk",
						      "dmic3_sync_clk_mux",
						      "aclk_slcg_ovr",
						      "c2bus",
						      "c3bus",
						      "vic03_cbus",
						      "nvjpg_cbus",
						      "se_cbus",
						      "tsecb_cbus",
						      "cap_c2bus",
						      "cap_vcore_c2bus",
						      "cap_throttle_c2bus",
						      "floor_c2bus",
						      "override_c2bus",
						      "edp_c2bus",
						      "nvenc_cbus",
						      "nvdec_cbus",
						      "vic_floor_cbus",
						      "cap_c3bus",
						      "cap_vcore_c3bus",
						      "cap_throttle_c3bus",
						      "floor_c3bus",
						      "override_c3bus",
						      "vi_cbus",
						      "isp_cbus",
						      "override_cbus",
						      "cap_vcore_cbus",
						      "via_vi_cbus",
						      "vib_vi_cbus",
						      "ispa_isp_cbus",
						      "ispb_isp_cbus",
						      "sbus",
						      "avp_sclk",
						      "bsea_sclk",
						      "usbd_sclk",
						      "usb1_sclk",
						      "usb2_sclk",
						      "usb3_sclk",
						      "wake_sclk",
						      "camera_sclk",
						      "mon_avp",
						      "cap_sclk",
						      "cap_vcore_sclk",
						      "cap_throttle_sclk",
						      "floor_sclk",
						      "override_sclk",
						      "sbc1_sclk",
						      "sbc2_sclk",
						      "sbc3_sclk",
						      "sbc4_sclk",
						      "qspi_sclk",
						      "boot_apb_sclk",
						      "emc_master",
						      "avp_emc",
						      "cpu_emc",
						      "disp1_emc",
						      "disp2_emc",
						      "disp1_la_emc",
						      "disp2_la_emc",
						      "usbd_emc",
						      "usb1_emc",
						      "usb2_emc",
						      "usb3_emc",
						      "sdmmc3_emc",
						      "sdmmc4_emc",
						      "mon_emc",
						      "cap_emc",
						      "cap_vcore_emc",
						      "cap_throttle_emc",
						      "gr3d_emc",
						      "nvenc_emc",
						      "nvjpg_emc",
						      "nvdec_emc",
						      "tsec_emc",
						      "tsecb_emc",
						      "camera_emc",
						      "via_emc",
						      "vib_emc",
						      "ispa_emc",
						      "ispb_emc",
						      "iso_emc",
						      "floor_emc",
						      "override_emc",
						      "edp_emc",
						      "vic_emc",
						      "vic_shared_emc",
						      "ape_emc",
						      "pcie_emc",
						      "xusb_emc",
						      "gbus",
						      "gm20b_gbus",
						      "cap_gbus",
						      "edp_gbus",
						      "cap_vgpu_gbus",
						      "cap_throttle_gbus",
						      "cap_profile_gbus",
						      "override_gbus",
						      "floor_gbus",
						      "floor_profile_gbus",
						      "host1x_master",
						      "nv_host1x",
						      "vi_host1x",
						      "vii2c_host1x",
						      "cap_host1x",
						      "cap_vcore_host1x",
						      "floor_host1x",
						      "override_host1x",
						      "mselect_master",
						      "cpu_mselect",
						      "pcie_mselect",
						      "cap_vcore_mselect",
						      "override_mselect",
						      "ape_master",
						      "adma_ape",
						      "adsp_ape",
						      "xbar_ape",
						      "cap_vcore_ape",
						      "override_ape",
						      "abus",
						      "adsp_cpu_abus",
						      "cap_vcore_abus",
						      "override_abus",
						      "vcm_sclk",
						      "vcm_ahb_sclk",
						      "vcm_apb_sclk",
						      "ahb_sclk",
						      "apb_sclk",
						      "sdmmc4_ahb_sclk",
						      "battery_emc",
						      "cbus";
					resets = <&tegra_car TEGRA210_CLK_ISPB>,
						 <&tegra_car TEGRA210_CLK_RTC>,
						 <&tegra_car TEGRA210_CLK_TIMER>,
						 <&tegra_car TEGRA210_CLK_UARTA>,
						 <&tegra_car TEGRA210_CLK_GPIO>,
						 <&tegra_car TEGRA210_CLK_SDMMC2>,
						 <&tegra_car TEGRA210_CLK_I2S1>,
						 <&tegra_car TEGRA210_CLK_I2C1>,
						 <&tegra_car TEGRA210_CLK_SDMMC1>,
						 <&tegra_car TEGRA210_CLK_SDMMC4>,
						 <&tegra_car TEGRA210_CLK_PWM>,
						 <&tegra_car TEGRA210_CLK_I2S2>,
						 <&tegra_car TEGRA210_CLK_VI>,
						 <&tegra_car TEGRA210_CLK_USBD>,
						 <&tegra_car TEGRA210_CLK_ISPA>,
						 <&tegra_car TEGRA210_CLK_DISP2>,
						 <&tegra_car TEGRA210_CLK_DISP1>,
						 <&tegra_car TEGRA210_CLK_HOST1X>,
						 <&tegra_car TEGRA210_CLK_I2S0>,
						 <&tegra_car TEGRA210_CLK_MC>,
						 <&tegra_car TEGRA210_CLK_AHBDMA>,
						 <&tegra_car TEGRA210_CLK_APBDMA>,
						 <&tegra_car TEGRA210_CLK_PMC>,
						 <&tegra_car TEGRA210_CLK_KFUSE>,
						 <&tegra_car TEGRA210_CLK_SBC1>,
						 <&tegra_car TEGRA210_CLK_SBC2>,
						 <&tegra_car TEGRA210_CLK_SBC3>,
						 <&tegra_car TEGRA210_CLK_I2C5>,
						 <&tegra_car TEGRA210_CLK_DSIA>,
						 <&tegra_car TEGRA210_CLK_CSI>,
						 <&tegra_car TEGRA210_CLK_I2C2>,
						 <&tegra_car TEGRA210_CLK_UARTC>,
						 <&tegra_car TEGRA210_CLK_MIPI_CAL>,
						 <&tegra_car TEGRA210_CLK_EMC>,
						 <&tegra_car TEGRA210_CLK_USB2>,
						 <&tegra_car TEGRA210_CLK_BSEV>,
						 <&tegra_car TEGRA210_CLK_UARTD>,
						 <&tegra_car TEGRA210_CLK_I2C3>,
						 <&tegra_car TEGRA210_CLK_SBC4>,
						 <&tegra_car TEGRA210_CLK_SDMMC3>,
						 <&tegra_car TEGRA210_CLK_PCIE>,
						 <&tegra_car TEGRA210_CLK_OWR>,
						 <&tegra_car TEGRA210_CLK_AFI>,
						 <&tegra_car TEGRA210_CLK_CSITE>,
						 <&tegra_car TEGRA210_CLK_LA>,
						 <&tegra_car TEGRA210_CLK_SOC_THERM>,
						 <&tegra_car TEGRA210_CLK_DTV>,
						 <&tegra_car TEGRA210_CLK_I2CSLOW>,
						 <&tegra_car TEGRA210_CLK_DSIB>,
						 <&tegra_car TEGRA210_CLK_TSEC>,
						 <&tegra_car TEGRA210_CLK_XUSB_HOST>,
						 <&tegra_car TEGRA210_CLK_CSUS>,
						 <&tegra_car TEGRA210_CLK_MSELECT>,
						 <&tegra_car TEGRA210_CLK_TSENSOR>,
						 <&tegra_car TEGRA210_CLK_I2S3>,
						 <&tegra_car TEGRA210_CLK_I2S4>,
						 <&tegra_car TEGRA210_CLK_I2C4>,
						 <&tegra_car TEGRA210_CLK_D_AUDIO>,
						 <&tegra_car TEGRA210_CLK_APB2APE>,
						 <&tegra_car TEGRA210_CLK_HDA2CODEC_2X>,
						 <&tegra_car TEGRA210_CLK_SPDIF_2X>,
						 <&tegra_car TEGRA210_CLK_ACTMON>,
						 <&tegra_car TEGRA210_CLK_EXTERN1>,
						 <&tegra_car TEGRA210_CLK_EXTERN2>,
						 <&tegra_car TEGRA210_CLK_EXTERN3>,
						 <&tegra_car TEGRA210_CLK_SATA_OOB>,
						 <&tegra_car TEGRA210_CLK_SATA>,
						 <&tegra_car TEGRA210_CLK_HDA>,
						 <&tegra_car TEGRA210_CLK_SE>,
						 <&tegra_car TEGRA210_CLK_HDA2HDMI>,
						 <&tegra_car TEGRA210_CLK_SATA_COLD>,
						 <&tegra_car TEGRA210_CLK_CEC>,
						 <&tegra_car TEGRA210_CLK_XUSB_GATE>,
						 <&tegra_car TEGRA210_CLK_CILAB>,
						 <&tegra_car TEGRA210_CLK_CILCD>,
						 <&tegra_car TEGRA210_CLK_CILE>,
						 <&tegra_car TEGRA210_CLK_DSIALP>,
						 <&tegra_car TEGRA210_CLK_DSIBLP>,
						 <&tegra_car TEGRA210_CLK_ENTROPY>,
						 <&tegra_car TEGRA210_CLK_DP2>,
						 <&tegra_car TEGRA210_CLK_XUSB_SS>,
						 <&tegra_car TEGRA210_CLK_DMIC1>,
						 <&tegra_car TEGRA210_CLK_DMIC2>,
						 <&tegra_car TEGRA210_CLK_I2C6>,
						 <&tegra_car TEGRA210_CLK_MC_CAPA>,
						 <&tegra_car TEGRA210_CLK_MC_CBPA>,
						 <&tegra_car TEGRA210_CLK_VIM2_CLK>,
						 <&tegra_car TEGRA210_CLK_MIPIBIF>,
						 <&tegra_car TEGRA210_CLK_CLK72MHZ>,
						 <&tegra_car TEGRA210_CLK_VIC03>,
						 <&tegra_car TEGRA210_CLK_DPAUX>,
						 <&tegra_car TEGRA210_CLK_SOR0>,
						 <&tegra_car TEGRA210_CLK_SOR1>,
						 <&tegra_car TEGRA210_CLK_GPU>,
						 <&tegra_car TEGRA210_CLK_DBGAPB>,
						 <&tegra_car TEGRA210_CLK_PLL_P_OUT_ADSP>,
						 <&tegra_car TEGRA210_CLK_PLL_G_REF>,
						 <&tegra_car TEGRA210_CLK_SDMMC_LEGACY>,
						 <&tegra_car TEGRA210_CLK_NVDEC>,
						 <&tegra_car TEGRA210_CLK_NVJPG>,
						 <&tegra_car TEGRA210_CLK_DMIC3>,
						 <&tegra_car TEGRA210_CLK_APE>,
						 <&tegra_car TEGRA210_CLK_ADSP>,
						 <&tegra_car TEGRA210_CLK_MC_CDPA>,
						 <&tegra_car TEGRA210_CLK_MC_CCPA>,
						 <&tegra_car TEGRA210_CLK_MAUD>,
						 <&tegra_car TEGRA210_CLK_TSECB>,
						 <&tegra_car TEGRA210_CLK_DPAUX1>,
						 <&tegra_car TEGRA210_CLK_VI_I2C>,
						 <&tegra_car TEGRA210_CLK_HSIC_TRK>,
						 <&tegra_car TEGRA210_CLK_USB2_TRK>,
						 <&tegra_car TEGRA210_CLK_QSPI>,
						 <&tegra_car TEGRA210_CLK_UARTAPE>,
						 <&tegra_car TEGRA210_CLK_ADSP_NEON>,
						 <&tegra_car TEGRA210_CLK_NVENC>,
						 <&tegra_car TEGRA210_CLK_IQC2>,
						 <&tegra_car TEGRA210_CLK_IQC1>,
						 <&tegra_car TEGRA210_CLK_SOR_SAFE>,
						 <&tegra_car TEGRA210_CLK_PLL_P_OUT_CPU>,
                                                 /* hardcoded controller id to 7 for UARTB */
						 <&tegra_car 7>,
						 <&tegra_car TEGRA210_CLK_VFIR>,
						 <&tegra_car TEGRA210_CLK_SPDIF_IN>,
						 <&tegra_car TEGRA210_CLK_SPDIF_OUT>,
						 <&tegra_car TEGRA210_CLK_VI_SENSOR>,
						 <&tegra_car TEGRA210_CLK_FUSE>,
						 <&tegra_car TEGRA210_CLK_FUSE_BURN>,
						 <&tegra_car TEGRA210_CLK_CLK_32K>,
						 <&tegra_car TEGRA210_CLK_CLK_M>,
						 <&tegra_car TEGRA210_CLK_CLK_M_DIV2>,
						 <&tegra_car TEGRA210_CLK_CLK_M_DIV4>,
						 <&tegra_car TEGRA210_CLK_PLL_REF>,
						 <&tegra_car TEGRA210_CLK_PLL_C>,
						 <&tegra_car TEGRA210_CLK_PLL_C_OUT1>,
						 <&tegra_car TEGRA210_CLK_PLL_C2>,
						 <&tegra_car TEGRA210_CLK_PLL_C3>,
						 <&tegra_car TEGRA210_CLK_PLL_M>,
						 <&tegra_car TEGRA210_CLK_PLL_M_OUT1>,
						 <&tegra_car TEGRA210_CLK_PLL_P>,
						 <&tegra_car TEGRA210_CLK_PLL_P_OUT1>,
						 <&tegra_car TEGRA210_CLK_PLL_P_OUT2>,
						 <&tegra_car TEGRA210_CLK_PLL_P_OUT3>,
						 <&tegra_car TEGRA210_CLK_PLL_P_OUT4>,
						 <&tegra_car TEGRA210_CLK_PLL_A>,
						 <&tegra_car TEGRA210_CLK_PLL_A_OUT0>,
						 <&tegra_car TEGRA210_CLK_PLL_D>,
						 <&tegra_car TEGRA210_CLK_PLL_D_OUT0>,
						 <&tegra_car TEGRA210_CLK_PLL_D2>,
						 <&tegra_car TEGRA210_CLK_PLL_D2_OUT0>,
						 <&tegra_car TEGRA210_CLK_PLL_U>,
						 <&tegra_car TEGRA210_CLK_PLL_U_480M>,
						 <&tegra_car TEGRA210_CLK_PLL_U_60M>,
						 <&tegra_car TEGRA210_CLK_PLL_U_48M>,
						 <&tegra_car TEGRA210_CLK_PLL_X>,
						 <&tegra_car TEGRA210_CLK_PLL_X_OUT0>,
						 <&tegra_car TEGRA210_CLK_PLL_RE_VCO>,
						 <&tegra_car TEGRA210_CLK_PLL_RE_OUT>,
						 <&tegra_car TEGRA210_CLK_PLL_E>,
						 <&tegra_car TEGRA210_CLK_SPDIF_IN_SYNC>,
						 <&tegra_car TEGRA210_CLK_I2S0_SYNC>,
						 <&tegra_car TEGRA210_CLK_I2S1_SYNC>,
						 <&tegra_car TEGRA210_CLK_I2S2_SYNC>,
						 <&tegra_car TEGRA210_CLK_I2S3_SYNC>,
						 <&tegra_car TEGRA210_CLK_I2S4_SYNC>,
						 <&tegra_car TEGRA210_CLK_VIMCLK_SYNC>,
						 <&tegra_car TEGRA210_CLK_AUDIO0>,
						 <&tegra_car TEGRA210_CLK_AUDIO1>,
						 <&tegra_car TEGRA210_CLK_AUDIO2>,
						 <&tegra_car TEGRA210_CLK_AUDIO3>,
						 <&tegra_car TEGRA210_CLK_AUDIO4>,
						 <&tegra_car TEGRA210_CLK_SPDIF>,
						 <&tegra_car TEGRA210_CLK_CLK_OUT_1>,
						 <&tegra_car TEGRA210_CLK_CLK_OUT_2>,
						 <&tegra_car TEGRA210_CLK_CLK_OUT_3>,
						 <&tegra_car TEGRA210_CLK_BLINK>,
						 <&tegra_car TEGRA210_CLK_QSPI_OUT>,
						 <&tegra_car TEGRA210_CLK_XUSB_HOST_SRC>,
						 <&tegra_car TEGRA210_CLK_XUSB_FALCON_SRC>,
						 <&tegra_car TEGRA210_CLK_XUSB_FS_SRC>,
						 <&tegra_car TEGRA210_CLK_XUSB_SS_SRC>,
						 <&tegra_car TEGRA210_CLK_XUSB_DEV_SRC>,
						 <&tegra_car TEGRA210_RST_XUSB_DEV>,
						 <&tegra_car TEGRA210_CLK_XUSB_HS_SRC>,
						 <&tegra_car TEGRA210_CLK_SCLK>,
						 <&tegra_car TEGRA210_CLK_HCLK>,
						 <&tegra_car TEGRA210_CLK_PCLK>,
						 <&tegra_car TEGRA210_CLK_CCLK_G>,
						 <&tegra_car TEGRA210_CLK_CCLK_LP>,
						 <&tegra_car TEGRA210_CLK_DFLL_REF>,
						 <&tegra_car TEGRA210_CLK_DFLL_SOC>,
						 <&tegra_car TEGRA210_CLK_VI_SENSOR2>,
						 <&tegra_car TEGRA210_CLK_PLL_P_OUT5>,
						 <&tegra_car TEGRA210_CLK_CML0>,
						 <&tegra_car TEGRA210_CLK_CML1>,
						 <&tegra_car TEGRA210_CLK_PLL_C4>,
						 <&tegra_car TEGRA210_CLK_PLL_DP>,
						 <&tegra_car TEGRA210_CLK_PLL_E_MUX>,
						 <&tegra_car TEGRA210_CLK_PLL_MB>,
						 <&tegra_car TEGRA210_CLK_PLL_A1>,
						 <&tegra_car TEGRA210_CLK_PLL_D_DSI_OUT>,
						 <&tegra_car TEGRA210_CLK_PLL_C4_OUT0>,
						 <&tegra_car TEGRA210_CLK_PLL_C4_OUT1>,
						 <&tegra_car TEGRA210_CLK_PLL_C4_OUT2>,
						 <&tegra_car TEGRA210_CLK_PLL_C4_OUT3>,
						 <&tegra_car TEGRA210_CLK_PLL_U_OUT>,
						 <&tegra_car TEGRA210_CLK_PLL_U_OUT1>,
						 <&tegra_car TEGRA210_CLK_PLL_U_OUT2>,
						 <&tegra_car TEGRA210_CLK_USB2_HSIC_TRK>,
						 <&tegra_car TEGRA210_CLK_PLL_P_OUT_HSIO>,
						 <&tegra_car TEGRA210_CLK_PLL_P_OUT_XUSB>,
						 <&tegra_car TEGRA210_CLK_XUSB_SSP_SRC>,
						 <&tegra_car TEGRA210_CLK_PLL_RE_OUT1>,
						 <&tegra_car TEGRA210_CLK_PLL_MB_UD>,
						 <&tegra_car TEGRA210_CLK_PLL_P_UD>,
						 <&tegra_car TEGRA210_CLK_ISP>,
						 <&tegra_car TEGRA210_CLK_PLL_A_OUT_ADSP>,
						 <&tegra_car TEGRA210_CLK_PLL_A_OUT0_OUT_ADSP>,
						 <&tegra_car TEGRA210_CLK_AUDIO0_MUX>,
						 <&tegra_car TEGRA210_CLK_AUDIO1_MUX>,
						 <&tegra_car TEGRA210_CLK_AUDIO2_MUX>,
						 <&tegra_car TEGRA210_CLK_AUDIO3_MUX>,
						 <&tegra_car TEGRA210_CLK_AUDIO4_MUX>,
						 <&tegra_car TEGRA210_CLK_SPDIF_MUX>,
						 <&tegra_car TEGRA210_CLK_CLK_OUT_1_MUX>,
						 <&tegra_car TEGRA210_CLK_CLK_OUT_2_MUX>,
						 <&tegra_car TEGRA210_CLK_CLK_OUT_3_MUX>,
						 <&tegra_car TEGRA210_CLK_DSIA_MUX>,
						 <&tegra_car TEGRA210_CLK_DSIB_MUX>,
						 <&tegra_car TEGRA210_CLK_SOR0_LVDS>,
						 <&tegra_car TEGRA210_CLK_XUSB_SS_DIV2>,
						 <&tegra_car TEGRA210_CLK_PLL_M_UD>,
						 <&tegra_car TEGRA210_CLK_PLL_C_UD>,
						 <&tegra_car TEGRA210_CLK_SCLK_MUX>,
						 <&tegra_car TEGRA210_CLK_SOR1_BRICK>,
						 <&tegra_car TEGRA210_CLK_SOR1_MUX>,
						 <&tegra_car TEGRA210_CLK_PD2VI>,
						 <&tegra_car TEGRA210_CLK_VI_OUTPUT>,
						 <&tegra_car TEGRA210_CLK_ACLK>,
						 <&tegra_car TEGRA210_CLK_SCLK_SKIPPER>,
						 <&tegra_car TEGRA210_CLK_DISP1_SLCG_OVR>,
						 <&tegra_car TEGRA210_CLK_DISP2_SLCG_OVR>,
						 <&tegra_car TEGRA210_CLK_VI_SLCG_OVR>,
						 <&tegra_car TEGRA210_CLK_ISPA_SLCG_OVR>,
						 <&tegra_car TEGRA210_CLK_ISPB_SLCG_OVR>,
						 <&tegra_car TEGRA210_CLK_NVDEC_SLCG_OVR>,
						 <&tegra_car TEGRA210_CLK_NVENC_SLCG_OVR>,
						 <&tegra_car TEGRA210_CLK_NVJPG_SLCG_OVR>,
						 <&tegra_car TEGRA210_CLK_VIC03_SLCG_OVR>,
						 <&tegra_car TEGRA210_CLK_XUSB_DEV_SLCG_OVR>,
						 <&tegra_car TEGRA210_CLK_XUSB_HOST_SLCG_OVR>,
						 <&tegra_car TEGRA210_CLK_D_AUDIO_SLCG_OVR>,
						 <&tegra_car TEGRA210_CLK_APE_SLCG_OVR>,
						 <&tegra_car TEGRA210_CLK_SATA_SLCG_OVR>,
						 <&tegra_car TEGRA210_CLK_SATA_SLCG_OVR_IPFS>,
						 <&tegra_car TEGRA210_CLK_SATA_SLCG_OVR_FPCI>,
						 <&tegra_car TEGRA210_CLK_DMIC1_SYNC_CLK>,
						 <&tegra_car TEGRA210_CLK_DMIC1_SYNC_CLK_MUX>,
						 <&tegra_car TEGRA210_CLK_DMIC2_SYNC_CLK>,
						 <&tegra_car TEGRA210_CLK_DMIC2_SYNC_CLK_MUX>,
						 <&tegra_car TEGRA210_CLK_DMIC3_SYNC_CLK>,
						 <&tegra_car TEGRA210_CLK_DMIC3_SYNC_CLK_MUX>,
						 <&tegra_car TEGRA210_CLK_ACLK_SLCG_OVR>,
						 <&tegra_car TEGRA210_CLK_C2BUS>,
						 <&tegra_car TEGRA210_CLK_C3BUS>,
						 <&tegra_car TEGRA210_CLK_VIC03_CBUS>,
						 <&tegra_car TEGRA210_CLK_NVJPG_CBUS>,
						 <&tegra_car TEGRA210_CLK_SE_CBUS>,
						 <&tegra_car TEGRA210_CLK_TSECB_CBUS>,
						 <&tegra_car TEGRA210_CLK_CAP_C2BUS>,
						 <&tegra_car TEGRA210_CLK_CAP_VCORE_C2BUS>,
						 <&tegra_car TEGRA210_CLK_CAP_THROTTLE_C2BUS>,
						 <&tegra_car TEGRA210_CLK_FLOOR_C2BUS>,
						 <&tegra_car TEGRA210_CLK_OVERRIDE_C2BUS>,
						 <&tegra_car TEGRA210_CLK_EDP_C2BUS>,
						 <&tegra_car TEGRA210_CLK_NVENC_CBUS>,
						 <&tegra_car TEGRA210_CLK_NVDEC_CBUS>,
						 <&tegra_car TEGRA210_CLK_VIC_FLOOR_CBUS>,
						 <&tegra_car TEGRA210_CLK_CAP_C3BUS>,
						 <&tegra_car TEGRA210_CLK_CAP_VCORE_C3BUS>,
						 <&tegra_car TEGRA210_CLK_CAP_THROTTLE_C3BUS>,
						 <&tegra_car TEGRA210_CLK_FLOOR_C3BUS>,
						 <&tegra_car TEGRA210_CLK_OVERRIDE_C3BUS>,
						 <&tegra_car TEGRA210_CLK_VI_CBUS>,
						 <&tegra_car TEGRA210_CLK_ISP_CBUS>,
						 <&tegra_car TEGRA210_CLK_OVERRIDE_CBUS>,
						 <&tegra_car TEGRA210_CLK_CAP_VCORE_CBUS>,
						 <&tegra_car TEGRA210_CLK_VIA_VI_CBUS>,
						 <&tegra_car TEGRA210_CLK_VIB_VI_CBUS>,
						 <&tegra_car TEGRA210_CLK_ISPA_ISP_CBUS>,
						 <&tegra_car TEGRA210_CLK_ISPB_ISP_CBUS>,
						 <&tegra_car TEGRA210_CLK_SBUS>,
						 <&tegra_car TEGRA210_CLK_AVP_SCLK>,
						 <&tegra_car TEGRA210_CLK_BSEA_SCLK>,
						 <&tegra_car TEGRA210_CLK_USBD_SCLK>,
						 <&tegra_car TEGRA210_CLK_USB1_SCLK>,
						 <&tegra_car TEGRA210_CLK_USB2_SCLK>,
						 <&tegra_car TEGRA210_CLK_USB3_SCLK>,
						 <&tegra_car TEGRA210_CLK_WAKE_SCLK>,
						 <&tegra_car TEGRA210_CLK_CAMERA_SCLK>,
						 <&tegra_car TEGRA210_CLK_MON_AVP>,
						 <&tegra_car TEGRA210_CLK_CAP_SCLK>,
						 <&tegra_car TEGRA210_CLK_CAP_VCORE_SCLK>,
						 <&tegra_car TEGRA210_CLK_CAP_THROTTLE_SCLK>,
						 <&tegra_car TEGRA210_CLK_FLOOR_SCLK>,
						 <&tegra_car TEGRA210_CLK_OVERRIDE_SCLK>,
						 <&tegra_car TEGRA210_CLK_SBC1_SCLK>,
						 <&tegra_car TEGRA210_CLK_SBC2_SCLK>,
						 <&tegra_car TEGRA210_CLK_SBC3_SCLK>,
						 <&tegra_car TEGRA210_CLK_SBC4_SCLK>,
						 <&tegra_car TEGRA210_CLK_QSPI_SCLK>,
						 <&tegra_car TEGRA210_CLK_BOOT_APB_SCLK>,
						 <&tegra_car TEGRA210_CLK_EMC_MASTER>,
						 <&tegra_car TEGRA210_CLK_AVP_EMC>,
						 <&tegra_car TEGRA210_CLK_CPU_EMC>,
						 <&tegra_car TEGRA210_CLK_DISP1_EMC>,
						 <&tegra_car TEGRA210_CLK_DISP2_EMC>,
						 <&tegra_car TEGRA210_CLK_DISP1_LA_EMC>,
						 <&tegra_car TEGRA210_CLK_DISP2_LA_EMC>,
						 <&tegra_car TEGRA210_CLK_USBD_EMC>,
						 <&tegra_car TEGRA210_CLK_USB1_EMC>,
						 <&tegra_car TEGRA210_CLK_USB2_EMC>,
						 <&tegra_car TEGRA210_CLK_USB3_EMC>,
						 <&tegra_car TEGRA210_CLK_SDMMC3_EMC>,
						 <&tegra_car TEGRA210_CLK_SDMMC4_EMC>,
						 <&tegra_car TEGRA210_CLK_MON_EMC>,
						 <&tegra_car TEGRA210_CLK_CAP_EMC>,
						 <&tegra_car TEGRA210_CLK_CAP_VCORE_EMC>,
						 <&tegra_car TEGRA210_CLK_CAP_THROTTLE_EMC>,
						 <&tegra_car TEGRA210_CLK_GR3D_EMC>,
						 <&tegra_car TEGRA210_CLK_NVENC_EMC>,
						 <&tegra_car TEGRA210_CLK_NVJPG_EMC>,
						 <&tegra_car TEGRA210_CLK_NVDEC_EMC>,
						 <&tegra_car TEGRA210_CLK_TSEC_EMC>,
						 <&tegra_car TEGRA210_CLK_TSECB_EMC>,
						 <&tegra_car TEGRA210_CLK_CAMERA_EMC>,
						 <&tegra_car TEGRA210_CLK_VIA_EMC>,
						 <&tegra_car TEGRA210_CLK_VIB_EMC>,
						 <&tegra_car TEGRA210_CLK_ISPA_EMC>,
						 <&tegra_car TEGRA210_CLK_ISPB_EMC>,
						 <&tegra_car TEGRA210_CLK_ISO_EMC>,
						 <&tegra_car TEGRA210_CLK_FLOOR_EMC>,
						 <&tegra_car TEGRA210_CLK_OVERRIDE_EMC>,
						 <&tegra_car TEGRA210_CLK_EDP_EMC>,
						 <&tegra_car TEGRA210_CLK_VIC_EMC>,
						 <&tegra_car TEGRA210_CLK_VIC_SHARED_EMC>,
						 <&tegra_car TEGRA210_CLK_APE_EMC>,
						 <&tegra_car TEGRA210_CLK_PCIE_EMC>,
						 <&tegra_car TEGRA210_CLK_XUSB_EMC>,
						 <&tegra_car TEGRA210_CLK_GBUS>,
						 <&tegra_car TEGRA210_CLK_GM20B_GBUS>,
						 <&tegra_car TEGRA210_CLK_CAP_GBUS>,
						 <&tegra_car TEGRA210_CLK_EDP_GBUS>,
						 <&tegra_car TEGRA210_CLK_CAP_VGPU_GBUS>,
						 <&tegra_car TEGRA210_CLK_CAP_THROTTLE_GBUS>,
						 <&tegra_car TEGRA210_CLK_CAP_PROFILE_GBUS>,
						 <&tegra_car TEGRA210_CLK_OVERRIDE_GBUS>,
						 <&tegra_car TEGRA210_CLK_FLOOR_GBUS>,
						 <&tegra_car TEGRA210_CLK_FLOOR_PROFILE_GBUS>,
						 <&tegra_car TEGRA210_CLK_HOST1X_MASTER>,
						 <&tegra_car TEGRA210_CLK_NV_HOST1X>,
						 <&tegra_car TEGRA210_CLK_VI_HOST1X>,
						 <&tegra_car TEGRA210_CLK_VII2C_HOST1X>,
						 <&tegra_car TEGRA210_CLK_CAP_HOST1X>,
						 <&tegra_car TEGRA210_CLK_CAP_VCORE_HOST1X>,
						 <&tegra_car TEGRA210_CLK_FLOOR_HOST1X>,
						 <&tegra_car TEGRA210_CLK_OVERRIDE_HOST1X>,
						 <&tegra_car TEGRA210_CLK_MSELECT_MASTER>,
						 <&tegra_car TEGRA210_CLK_CPU_MSELECT>,
						 <&tegra_car TEGRA210_CLK_PCIE_MSELECT>,
						 <&tegra_car TEGRA210_CLK_CAP_VCORE_MSELECT>,
						 <&tegra_car TEGRA210_CLK_OVERRIDE_MSELECT>,
						 <&tegra_car TEGRA210_CLK_APE_MASTER>,
						 <&tegra_car TEGRA210_CLK_ADMA_APE>,
						 <&tegra_car TEGRA210_CLK_ADSP_APE>,
						 <&tegra_car TEGRA210_CLK_XBAR_APE>,
						 <&tegra_car TEGRA210_CLK_CAP_VCORE_APE>,
						 <&tegra_car TEGRA210_CLK_OVERRIDE_APE>,
						 <&tegra_car TEGRA210_CLK_ABUS>,
						 <&tegra_car TEGRA210_CLK_ADSP_CPU_ABUS>,
						 <&tegra_car TEGRA210_CLK_CAP_VCORE_ABUS>,
						 <&tegra_car TEGRA210_CLK_OVERRIDE_ABUS>,
						 <&tegra_car TEGRA210_CLK_VCM_SCLK>,
						 <&tegra_car TEGRA210_CLK_VCM_AHB_SCLK>,
						 <&tegra_car TEGRA210_CLK_VCM_APB_SCLK>,
						 <&tegra_car TEGRA210_CLK_AHB_SCLK>,
						 <&tegra_car TEGRA210_CLK_APB_SCLK>,
						 <&tegra_car TEGRA210_CLK_SDMMC4_AHB_SCLK>,
						 <&tegra_car TEGRA210_CLK_BATTERY_EMC>,
						 <&tegra_car TEGRA210_CLK_CBUS>;
					reset-names = "ispb",
						      "rtc",
						      "timer",
						      "uarta",
						      "gpio",
						      "sdmmc2",
						      "i2s1",
						      "i2c1",
						      "sdmmc1",
						      "sdmmc4",
						      "pwm",
						      "i2s2",
						      "vi",
						      "usbd",
						      "ispa",
						      "disp2",
						      "disp1",
						      "host1x",
						      "i2s0",
						      "mc",
						      "ahbdma",
						      "apbdma",
						      "pmc",
						      "kfuse",
						      "sbc1",
						      "sbc2",
						      "sbc3",
						      "i2c5",
						      "dsia",
						      "csi",
						      "i2c2",
						      "uartc",
						      "mipi_cal",
						      "emc",
						      "usb2",
						      "bsev",
						      "uartd",
						      "i2c3",
						      "sbc4",
						      "sdmmc3",
						      "pcie",
						      "owr",
						      "afi",
						      "csite",
						      "la",
						      "soc_therm",
						      "dtv",
						      "i2cslow",
						      "dsib",
						      "tsec",
						      "xusb_host",
						      "csus",
						      "mselect",
						      "tsensor",
						      "i2s3",
						      "i2s4",
						      "i2c4",
						      "d_audio",
						      "apb2ape",
						      "hda2codec_2x",
						      "spdif_2x",
						      "actmon",
						      "extern1",
						      "extern2",
						      "extern3",
						      "sata_oob",
						      "sata",
						      "hda",
						      "se",
						      "hda2hdmi",
						      "sata_cold",
						      "cec",
						      "xusb_gate",
						      "cilab",
						      "cilcd",
						      "cile",
						      "dsialp",
						      "dsiblp",
						      "entropy",
						      "dp2",
						      "xusb_ss",
						      "dmic1",
						      "dmic2",
						      "i2c6",
						      "mc_capa",
						      "mc_cbpa",
						      "vim2_clk",
						      "mipibif",
						      "clk72mhz",
						      "vic03",
						      "dpaux",
						      "sor0",
						      "sor1",
						      "gpu",
						      "dbgapb",
						      "pll_p_out_adsp",
						      "pll_g_ref",
						      "sdmmc_legacy",
						      "nvdec",
						      "nvjpg",
						      "dmic3",
						      "ape",
						      "adsp",
						      "mc_cdpa",
						      "mc_ccpa",
						      "maud",
						      "tsecb",
						      "dpaux1",
						      "vi_i2c",
						      "hsic_trk",
						      "usb2_trk",
						      "qspi",
						      "uartape",
						      "adsp_neon",
						      "nvenc",
						      "iqc2",
						      "iqc1",
						      "sor_safe",
						      "pll_p_out_cpu",
						      "uartb",
						      "vfir",
						      "spdif_in",
						      "spdif_out",
						      "vi_sensor",
						      "fuse",
						      "fuse_burn",
						      "clk_32k",
						      "clk_m",
						      "clk_m_div2",
						      "clk_m_div4",
						      "pll_ref",
						      "pll_c",
						      "pll_c_out1",
						      "pll_c2",
						      "pll_c3",
						      "pll_m",
						      "pll_m_out1",
						      "pll_p",
						      "pll_p_out1",
						      "pll_p_out2",
						      "pll_p_out3",
						      "pll_p_out4",
						      "pll_a",
						      "pll_a_out0",
						      "pll_d",
						      "pll_d_out0",
						      "pll_d2",
						      "pll_d2_out0",
						      "pll_u",
						      "pll_u_480m",
						      "pll_u_60m",
						      "pll_u_48m",
						      "pll_x",
						      "pll_x_out0",
						      "pll_re_vco",
						      "pll_re_out",
						      "pll_e",
						      "spdif_in_sync",
						      "i2s0_sync",
						      "i2s1_sync",
						      "i2s2_sync",
						      "i2s3_sync",
						      "i2s4_sync",
						      "vimclk_sync",
						      "audio0",
						      "audio1",
						      "audio2",
						      "audio3",
						      "audio4",
						      "spdif",
						      "clk_out_1",
						      "clk_out_2",
						      "clk_out_3",
						      "blink",
						      "qspi_out",
						      "xusb_host_src",
						      "xusb_falcon_src",
						      "xusb_fs_src",
						      "xusb_ss_src",
						      "xusb_dev_src",
						      "xusb_dev",
						      "xusb_hs_src",
						      "sclk",
						      "hclk",
						      "pclk",
						      "cclk_g",
						      "cclk_lp",
						      "dfll_ref",
						      "dfll_soc",
						      "vi_sensor2",
						      "pll_p_out5",
						      "cml0",
						      "cml1",
						      "pll_c4",
						      "pll_dp",
						      "pll_e_mux",
						      "pll_mb",
						      "pll_a1",
						      "pll_d_dsi_out",
						      "pll_c4_out0",
						      "pll_c4_out1",
						      "pll_c4_out2",
						      "pll_c4_out3",
						      "pll_u_out",
						      "pll_u_out1",
						      "pll_u_out2",
						      "usb2_hsic_trk",
						      "pll_p_out_hsio",
						      "pll_p_out_xusb",
						      "xusb_ssp_src",
						      "pll_re_out1",
						      "pll_p_ud",
						      "isp",
						      "pll_a_out_adsp",
						      "pll_a_out0_out_adsp",
						      "audio0_mux",
						      "audio1_mux",
						      "audio2_mux",
						      "audio3_mux",
						      "audio4_mux",
						      "spdif_mux",
						      "clk_out_1_mux",
						      "clk_out_2_mux",
						      "clk_out_3_mux",
						      "dsia_mux",
						      "dsib_mux",
						      "sor0_lvds",
						      "xusb_ss_div2",
						      "pll_m_ud",
						      "pll_c_ud",
						      "sclk_mux",
						      "sor1_brick",
						      "sor1_mux",
						      "pd2vi",
						      "vi_output",
						      "aclk",
						      "sclk_skipper",
						      "disp1_slcg_ovr",
						      "disp2_slcg_ovr",
						      "vi_slcg_ovr",
						      "ispa_slcg_ovr",
						      "ispb_slcg_ovr",
						      "nvdec_slcg_ovr",
						      "nvenc_slcg_ovr",
						      "nvjpg_slcg_ovr",
						      "vic03_slcg_ovr",
						      "xusb_dev_slcg_ovr",
						      "xusb_host_slcg_ovr",
						      "d_audio_slcg_ovr",
						      "ape_slcg_ovr",
						      "sata_slcg_ovr",
						      "sata_slcg_ovr_ipfs",
						      "sata_slcg_ovr_fpci",
						      "dmic1_sync_clk",
						      "dmic1_sync_clk_mux",
						      "dmic2_sync_clk",
						      "dmic2_sync_clk_mux",
						      "dmic3_sync_clk",
						      "dmic3_sync_clk_mux",
						      "aclk_slcg_ovr",
						      "c2bus",
						      "c3bus",
						      "vic03_cbus",
						      "nvjpg_cbus",
						      "se_cbus",
						      "tsecb_cbus",
						      "cap_c2bus",
						      "cap_vcore_c2bus",
						      "cap_throttle_c2bus",
						      "floor_c2bus",
						      "override_c2bus",
						      "edp_c2bus",
						      "nvenc_cbus",
						      "nvdec_cbus",
						      "vic_floor_cbus",
						      "cap_c3bus",
						      "cap_vcore_c3bus",
						      "cap_throttle_c3bus",
						      "floor_c3bus",
						      "override_c3bus",
						      "vi_cbus",
						      "isp_cbus",
						      "override_cbus",
						      "cap_vcore_cbus",
						      "via_vi_cbus",
						      "vib_vi_cbus",
						      "ispa_isp_cbus",
						      "ispb_isp_cbus",
						      "sbus",
						      "avp_sclk",
						      "bsea_sclk",
						      "usbd_sclk",
						      "usb1_sclk",
						      "usb2_sclk",
						      "usb3_sclk",
						      "wake_sclk",
						      "camera_sclk",
						      "mon_avp",
						      "cap_sclk",
						      "cap_vcore_sclk",
						      "cap_throttle_sclk",
						      "floor_sclk",
						      "override_sclk",
						      "sbc1_sclk",
						      "sbc2_sclk",
						      "sbc3_sclk",
						      "sbc4_sclk",
						      "qspi_sclk",
						      "boot_apb_sclk",
						      "emc_master",
						      "avp_emc",
						      "cpu_emc",
						      "disp1_emc",
						      "disp2_emc",
						      "disp1_la_emc",
						      "disp2_la_emc",
						      "usbd_emc",
						      "usb1_emc",
						      "usb2_emc",
						      "usb3_emc",
						      "sdmmc3_emc",
						      "sdmmc4_emc",
						      "mon_emc",
						      "cap_emc",
						      "cap_vcore_emc",
						      "cap_throttle_emc",
						      "gr3d_emc",
						      "nvenc_emc",
						      "nvjpg_emc",
						      "nvdec_emc",
						      "tsec_emc",
						      "tsecb_emc",
						      "camera_emc",
						      "via_emc",
						      "vib_emc",
						      "ispa_emc",
						      "ispb_emc",
						      "iso_emc",
						      "floor_emc",
						      "override_emc",
						      "edp_emc",
						      "vic_emc",
						      "vic_shared_emc",
						      "ape_emc",
						      "pcie_emc",
						      "xusb_emc",
						      "gbus",
						      "gm20b_gbus",
						      "cap_gbus",
						      "edp_gbus",
						      "cap_vgpu_gbus",
						      "cap_throttle_gbus",
						      "cap_profile_gbus",
						      "override_gbus",
						      "floor_gbus",
						      "floor_profile_gbus",
						      "host1x_master",
						      "nv_host1x",
						      "vi_host1x",
						      "vii2c_host1x",
						      "cap_host1x",
						      "cap_vcore_host1x",
						      "floor_host1x",
						      "override_host1x",
						      "mselect_master",
						      "cpu_mselect",
						      "pcie_mselect",
						      "cap_vcore_mselect",
						      "override_mselect",
						      "ape_master",
						      "adma_ape",
						      "adsp_ape",
						      "xbar_ape",
						      "cap_vcore_ape",
						      "override_ape",
						      "abus",
						      "adsp_cpu_abus",
						      "cap_vcore_abus",
						      "override_abus",
						      "vcm_sclk",
						      "vcm_ahb_sclk",
						      "vcm_apb_sclk",
						      "ahb_sclk",
						      "apb_sclk",
						      "sdmmc4_ahb_sclk",
						      "battery_emc",
                                                      "cbus";
		};
 	};
 };
