/*
 * tegra210-soc-actmon.dtsi: Tegra210 soc dtsi file for central actmon instances
 *
 * Copyright (c) 2017-2018, NVIDIA CORPORATION.  All rights reserved.
 *
 * This program is free software; you can redistribute it and/or modify
 * it under the terms of the GNU General Public License as published by
 * the Free Software Foundation; version 2 of the License.
 *
 * This program is distributed in the hope that it will be useful, but WITHOUT
 * ANY WARRANTY; without even the implied warranty of MERCHANTABILITY or
 * FITNESS FOR A PARTICULAR PURPOSE.  See the GNU General Public License for
 * more details.
 */

/ {
	actmon@6000c800 {
		status = "disabled";
		#address-cells = <2>;
		#size-cells = <2>;
		/* tegra210 central actmon */
		compatible = "nvidia,tegra210-cactmon";
		reg = <0x0 0x6000c800 0x0 0x400>; /* ACTMON_BASE */
		interrupts = <0 45 IRQ_TYPE_LEVEL_HIGH>;
		clocks = <&tegra_car TEGRA210_CLK_ACTMON>;
		clock-names = "actmon";
		resets = <&tegra_car TEGRA210_CLK_ACTMON>;
		reset-names = "actmon";
		nvidia,sample_period = /bits/ 8 <20>;

		mc_all {	/* MC_ALL actmon device */
			#address-cells = <1>;
			#size-cells = <0>;
			nvidia,con_id = "mc_all";
			nvidia,dev_id = "actmon";
			nvidia,reg_offs = <0x1c0>;
			nvidia,irq_mask = <0x4000000>;
			/* EMC_PLLP_FREQ + 2000 */
			nvidia,suspend_freq = <206000>;
			nvidia,boost_freq_step = <16000>;
			nvidia,boost_up_coef = <200>;
			nvidia,boost_down_coef = <50>;
			nvidia,boost_up_threshold = <60>;
			nvidia,boost_down_threshold = <40>;
			nvidia,up_wmark_window = /bits/ 8 <1>;
			nvidia,down_wmark_window = /bits/ 8 <3>;
			nvidia,avg_window_log2 = /bits/ 8 <7>;
			nvidia,count_weight = <0x400>;
			nvidia,max_dram_channels = /bits/ 8 <2>;
			nvidia,type = <1>;
			status = "disabled";
		};
       };
};
