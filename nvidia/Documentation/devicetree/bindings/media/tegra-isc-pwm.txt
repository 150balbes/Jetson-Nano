## nvidia/Documentation/devicetree/bindings/watchdog/nvidia,tegra-wdt-t18x.txt
```
* NVIDIA Tegra18x Watchdog controller

Required properties:

- compatible: Should be "nvidia,tegra-wdt-t18x"
- reg: Should contain WDT and corresponding timer source
  registers location and length. There must be three register
  addresses and size in following sequence:
	WDT0 base address and size.
	Timer0 base address and size.
	TKE TOP base address and size.

	If timer index and watchdog index is not provided then
	the address must be the actual base address of WDT and
	timer which will be use.

Optional properties for recovery mode:
- interrupts: interrupt number to the cpu
- nvidia,wdt-cluster-id: ID of the cpu cluster monitored by this WDT instance.
- nvidia,enable-on-init: toggle switch for enable during init
- nvidia,heartbeat-init: default timeout in secs (120 secs if not specified)
- nvidia,shutdown-timeout: timeout in secs during shutdown before watchdog
			reset occurs. same as heartbeat if not specified.
- nvidia,expiry-count: total expiration levels supported by the watchdog.
       Should be 1 if not specified. (Deprecated)
- nvidia,extend-watchdog-suspend: Boolean. Extend the disable of watchdog
	timer to syscore suspend and re-eanble on syscore resume. If this
	is selected then do not disable watchdog timer in device suspend
	otherwise disable in device suspend.
- nvidia,watchdog-index: Watchdog to be use, it can be 0, 1 or 2.
- nvidia,timer-index: Timer to be use for counter. It can be 0 to 7.

If nvidia,watchdog-index or nvidia,timer-index are provided then property
"reg" must contain the base address of timer and watchdog.

Optional properties for debug purpose:

- nvidia,disable-debug-reset:
	Disable system wide debug reset assertion at fourth expiration of the
	counter. WDT debug reset can be intercepted by debug logic, e.g. to
	preserve information. This reset should be enabled if not specified.
- nvidia,disable-por-reset:
	Disable internal full system reset at fifth expiration of the counter.
	WDT POR reset cannot be intercepted and acts as a Power On Reset. This
	reset should be enabled if not specified.
- nvidia,disable-remote-interrupt:
	Disable remote interrupt which happen in 3rd expiry of the counter.

Examples:

watchdog@30c0000 {
       compatible = "nvidia,tegra-wdt-18x";
       reg = <0x0 0x030c0000 0x0 0x10000
              0x0 0x03090000 0x0 0x10000>;
       nvidia,expiry-count = <5>;
       status = "disabled";
};

watchdog@30d0000 {
       compatible = "nvidia,tegra-wdt-18x";
       reg = <0x0 0x030c0000 0x0 0x10000
              0x0 0x030a0000 0x0 0x10000>;
       nvidia,expiry-count = <5>;
       status = "disabled";
};
```

## nvidia/arch/arm64/Kconfig
```kconfig
config ARCH_TEGRA_18x_SOC
	bool "Tegra 18x family SOC (Downstream options)"
	select CPU_V8
	select ARM_GIC
	select ARM_GIC_PM
	select COMMON_CLK
	select SOC_BUS
	select ARCH_REQUIRE_GPIOLIB
	select PINCTRL
	select ARCH_SUPPORTS_MSI if PCI_TEGRA
	select PCI_MSI if PCI_TEGRA
	select ARCH_TEGRA_APE
	select ARCH_HAS_RESET_CONTROLLER
	select ARM64_CPU_SUSPEND
	default n
	help
	  NVIDIA Tegra Downstream options for 18x family of SoCs

config ARCH_TEGRA_19x_SOC
	bool "Tegra 19x family SOC (Downstream options)"
	select PINCTRL
	default n
	help
	  NVIDIA Tegra Downstream options for 19x family of SoCs

config ARCH_TEGRA_23x_SOC
	bool "Tegra 23x family SOC (Downstream options)"
	select PINCTRL
	default n
	help
	  NVIDIA Tegra Downstream options for 23x family of SoCs

append_menu "Kernel Features"

config TEGRA_EBP
	bool "Tegra Early Boot Partition"
	select ARM64_NON_SHARED_TLBI
	select MINIMAL_GIC_INIT
	default n
	help
	  NVIDIA Tegra single core stripped down configuration
	  designed for fast boot time.

endmenu
```

## nvidia/drivers/Kconfig
```kconfig
append_menu "Device Drivers"

if ARCH_TEGRA
source "drivers/bluetooth/realtek/Kconfig"
source "drivers/misc/tegra186-ahc/Kconfig"
source "drivers/nvpmodel/Kconfig"
source "drivers/nvlink/Kconfig"
source "drivers/nvpps/Kconfig"
source "drivers/trusty/Kconfig"
source "drivers/virt/tegra/Kconfig"
endif

endmenu
```

## nvidia/drivers/block/Kconfig
```kconfig
if BLK_DEV

config TEGRA_HV_BLKDEV
	bool "Tegra Virtual Block I/O Device"
	depends on BLK_DEV && TEGRA_HV_MANAGER
	default n

endif # BLK_DEV
```

## nvidia/drivers/bluetooth/realtek/Kconfig
```kconfig
config RTK_BTUSB
	tristate "Realtek 8822C USB BT"
	depends on BT
	default n
	---help---
	  This module adds support for RTL8822CE chipset

	  This driver module will be called rtl8822ce
	  Use m if unsure
```

## nvidia/drivers/char/Kconfig
```kconfig
#
# Character device configuration
#

config HMM_DMIRROR
	tristate "HMM dummy driver, to test Heterogeneous Memory Management"
	depends on HMM
	default n
	help
	  Say Y here if you want to build the HMM dummy mirror driver.
	  Doing so will allow you to test the HMM mirror infrastructure.

	  If in doubt, say "N".
```

## nvidia/drivers/firmware/Kconfig
```kconfig
append_menu "Firmware Drivers"

source "drivers/firmware/tegra/Kconfig"

endmenu
```

## nvidia/drivers/gpio/Kconfig
```kconfig
if GPIOLIB

config GPIO_TEGRA186
	bool "NVIDIA Tegra186 GPIO support"
	select GPIO_SYSFS
	default y if ARCH_TEGRA_18x_SOC || ARCH_TEGRA_19x_SOC
	help
	Support for the NVIDIA Tegra186 GPIO controller driver.


config GPIO_TMPM32X_I2C
	tristate "GPIO support for Toshiba MCU TMPM32x I2C"
	depends on I2C
	depends on OF
	select MFD_TMPM32X_I2C
	select GPIOLIB_IRQCHIP
	help
	  GPIO driver for Toshiba MCU TMPM32x I2C.

endif
```

## nvidia/drivers/hid/Kconfig
```kconfig
append_menu "HID support"

config HID_NVIDIA_STAND
	tristate "NVIDIA Stand driver support"
	depends on HID
	---help---
	  Provides support for NVIDIA Stand device to process vendor specific
	  HID data.

	  Say Y here to enable this driver and to compile this driver as a module,
	  choose M here. If unsure, say N

menu "SHIELD accessory HID drivers"

config HID_SHIELD_BLAKE
	tristate "SHIELD game controller"
	depends on USB_HID
	---help---
	Support for NVIDIA SHIELD game controller.

config HID_SHIELD_REMOTE
	tristate "SHIELD remote control support"
	depends on USB_HID
	---help---
	Support for NVIDIA SHIELD remote control.

endmenu

endmenu
```

## nvidia/drivers/hwmon/Kconfig
```kconfig
if HWMON

config GENERIC_PWM_TACHOMETER
	tristate "Generic PWM based tachometer driver"
	depends on PWM
	help
	  Enables a driver to use PWM signal from motor to use
	  for measuring the motor speed. The RPM is captured by
	  PWM modules which has PWM capture capability and this
	  drivers reads the captured data from PWM IP to convert
	  it to speed in RPM.

endif
```
