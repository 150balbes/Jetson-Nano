## nvidia/Documentation/devicetree/bindings/platform/tegra/tegra-eqos.txt
```
Device tree binding for NVIDIA Tegra186 Ethernet QOS Controller
=================================================================

The Tegra186 EQOS (Ethernet QOS) device is an Ethernet controller which
supports Quality of Service features.

Supported Hardware Features are
=====================================================/
10/100 Mbps Support                         : YES
1000 Mbps Support                           : YES
Half-duplex Support                         : YES
PCS Registers(TBI/SGMII/RTBI PHY interface) : NO
VLAN Hash Filter Selected                   : NO
SMA (MDIO) Interface                        : YES
PMT Remote Wake-up Packet Enable            : YES
PMT Magic Packet Enable                     : YES
RMON/MMC Module Enable                      : YES
ARP Offload Enabled                         : YES
IEEE 1588-2008 Timestamp Enabled            : YES
Energy Efficient Ethernet Enabled           : YES
Transmit Checksum Offload Enabled           : YES
Receive Checksum Offload Enabled            : YES
MAC Addresses 16–31 Selected                : YES
MAC Addresses 32–63 Selected                : YES
MAC Addresses 64–127 Selected               : YES
Timestamp System Time Source                : INTERNAL
Source Address or VLAN Insertion Enable     : YES
Active PHY Selected                         : RGMII
MTL Receive FIFO Size                       : 16 KBytes
MTL Transmit FIFO Size                       : 16 KBytes
IEEE 1588 High Word Register Enable          : YES
DCB Feature Enable                           : NO
Split Header Feature Enable                  : YES
TCP Segmentation Offload Enable              : YES
DMA Debug Registers Enabled                  : YES
AV Feature Enabled                           : YES
Low Power Mode Enabled                       : YES
Hash Table Size                              : No hash table selected
Total number of L3 or L4 Filters             : 8 L3/L4 Filter
Number of MTL Receive Queues                 : 4
Number of MTL Transmit Queues                : 4
Number of DMA Receive Channels               : 4
Number of DMA Transmit Channels              : 4
Number of PPS Outputs                        : No PPS output
Number of Auxiliary Snapshot Inputs          : 1 auxiliary input
=====================================================/

Required properties:
- compatible:			should be "nvidia,eqos"
- reg: 				Physical base address and length of registers.
- interrupts: 			An array of tuples specifying IRQ number for
				each tx/rx queue in case of multi-queue, and
				for the only tx/rx queue,in case of single queue.
				please check example at end for reference.
- clocks: 			Specifies the needed clocks.
- clock-names: 			Specifies the names of the needed clocks.
- resets: 			Specifies the reset line.
- reset-names: 			Specifies the name of the reset line.
- iommu-group-id:		Specifies IOMMU group ID.
- nvidia,csr_clock_speed:	This is a free-running clock input provided
				by the application. The MAC Control Interface,
				CSR, and Station Management Agent (SMA) of the
				MAC run on this clock. The valid frequency range
				of this clock is 20–300 MHz (minimum frequency
				is 25 MHz when the MMC module is active in
				1000 Mbps mode). Frequencies outside this range
				may result in incorrect operation
- nvidia,use_multi_queues:	EQOS HW supports upto 4 Tx/Rx Queues/Channels.
				This property enables us to make use of 4Queues,
				each queue size is configured to 4KB. if this
				property is not defined then EQOS HW is
				configured to make use of a single queue with a
				total of 16KB size.To support Jumbo frame
				feature we makes use of a single queue so that
				9k packet size can be fit into a single queue.
- nvidia,ptp_ref_clock_speed: 	This is reference for PTP clock frequency and
				the value set for tegra is 125MHz.
				The frequency of this clock is programmable and
				can be configured based on the requirements.
				The maximum frequency it can take is 125MHz and
				minimum frequency is 25MHz
- nvidia,queue_prio: 		An array where each entry specifies priority of
				rx queue. Based on the VLAN tag PCP priority
				value rx packets will be routed the corresponding
				channel.
				For example - If the values are "0 7 2 3", it
				means that packets with priority 0 will be
				mapped to DMA channel 0, similarly 7 will be
				mapped to 1 and so on.
				"nvidia,queue_prio = <0 7 2 3> " means
				priority-0 = DMA-0, priority-7 = DMA-1,
				priority-2 = DMA-2, priority-3 = DMA-3
- nvidia,phy-reset-gpio:	If this gpio is provided, then the PHY is reset
				by toggling this gpio LOW during driver probe.
- nvidia,phy-intr-gpio: 	Specifies gpio pin for PHY interrupts.
- nvidia,rxq_enable_ctrl:	Mode of the RxQ to enabled either AV mode or legacy mode.
				example: rxq_enable_ctrl = <rx0 rx1 rx2 rx3>
					0x0 = Not enabled, 0x1 = Enabled for AV
					0x2 = Enabled for Legacy, 0x3 = Reserved
- nvidia,phy-max-frame-size: 	Specifies maximum frame size supported by PHY
				in kilobytes. Default is 10kb. It Will determine
				jumbo frame size.
- phy-mode: 			should be "rgmii".
- pinctrl-names			If we define these property, then we can control
				EQOS pin-mux states dynamically so that we can
				save power based on the Ethernet link.
- pinctrl-0			Valid only when "pinctrl-names" is defined, this
				property has the configuration that need to be
				set to EQOS signals when Ethernet link is down.
- pinctrl-1			Valid only when "pinctrl-names" is defined, this
				property has the configuration that need to be
				set when Ethernet link is up.

Optional properties:
- nvidia,use_tagged_ptp: 	if this property is set we will make use of the
				channel/Queue which is defined in "ptp_dma_ch"
				for routing the rx ptp packets.
- nvidia,ptp_dma_ch: 		Specifies channel/Queue number where the rx PTP
				packets need to be be routed.
				Channel 0 is default.
- nvidia,chan_napi_quota: 	Specifies number of tx/rx completions to process
				when napi handler is called.  Default is "64".
- nvidia,pause_frames: 		Used to disable/enable PAUSE frames support.
				This is a flag. If this property is present
				then PAUSE frames will be enabled.
- nvidia,brcm_phy_apd_mode: 	Flag specifies the Auto Power Down mode for
				BRCM89610 PHY.
- nvidia,iso_bw:		ISO BW, indicates sum of read and write bandwidth.
- nvidia,eth_iso_enable:	Specifies whether ISO enabled for EQOS or not.
- nvidia,slot_intvl_val:	Specifies slot interval for fetching the data from DMA.
				In T186 EQOS - 125usec is default and fixed value.
				In T194 EQOS this value can be changed based on the usecase.
- nvidia,rx_riwt:		Specifies the RX wathcdog interrupt timeout in usec
				for an Rx descriptor for which IOC bit is not set.
				The RIWT field is programmed as (<val> * 256) / 62.5

Example:

	ether_qos@2490000 {
		compatible = "nvidia,eqos";
		reg = <0x0 0x02490000 0x0 0x10000>;    /* EQOS Base Register */
		reg-names = "eqos_base";
		interrupts =	<0 194 0x4>,    /* common */
				<0 195 0x4>,    /* power */
				<0 190 0x4>,    /* rx0 */
				<0 186 0x4>,    /* tx0 */
				<0 191 0x4>,    /* rx1 */
				<0 187 0x4>,    /* tx1 */
				<0 192 0x4>,    /* rx2 */
				<0 188 0x4>,    /* tx2 */
				<0 193 0x4>,    /* rx3 */
				<0 189 0x4>;    /* tx3 */
		nvidia,csr_clock_speed = <0x19>; /* CSR clock speed 25MHz */
		clocks = <&tegra_car TEGRA186_CLK_EQOS_AXI>,
			<&tegra_car TEGRA186_CLK_EQOS_RX>,
			<&tegra_car TEGRA186_CLK_EQOS_PTP_REF>,
			<&tegra_car TEGRA186_CLK_EQOS_TX>,
			<&tegra_car TEGRA186_CLK_AXI_CBB>;
		clock-names = "eqos_axi", "eqos_rx", "eqos_ptp_ref", "eqos_tx", "axi_cbb";
		resets = <&tegra_car TEGRA186_RESET_EQOS>;
		reset-names = "eqos_rst";
		phy-mode = "rgmii";
		status = "disabled";
		pinctrl-names = "idle", "default";
                pinctrl-0 = <&eqos_tx_tri_state_idle>;
                pinctrl-1 = <&eqos_tx_tri_state_default>;
		nvidia,queue_prio = <0 1 2 3>;
		nvidia,use_tagged_ptp;
		nvidia,chan_napi_quota = <64 64 64 64>;
		nvidia,ptp_dma_ch = <3>;
		nvidia,phy-max-frame-size = <10>;
		nvidia,ptp_ref_clock_speed = <125>;
		nvidia,use_multi_queues
		nvidia,brcm_phy_apd_mode;

	}
```

## nvidia/Documentation/devicetree/bindings/tegra_gte/tegra-gte.txt
```
NVIDIA Tegra T194 GTE (Generic hardware Timestamping Engine) driver bindings

GTE is a hardware block which monitors various events for the state change and
timestamps them using TSC counter. Tegra implements LIC GTE and AON GTE
instances. LIC GTE is used only to monitor LIC IRQ lines and AON GTE is used
to monitor GPIO lines.

Required properties:

- compatible:
	Array of strings.
	One of:
	- "nvidia,tegra194-gte-lic"
		For CCPLEX LIC IRQ GTE monitoring
	- "nvidia,tegra194-gte-aon"
		For AON GPIO GTE monitoring
- reg:
	physical base address
- interrupts:
	interrupt number
- nvidia,num-slices:
	u32 property indicating number of slices of the given GTE instance
- nvidia,gpio-controller:
	phandle to the gpio controller for which GTE is monitoring its GPIO,
	mandatory for the tegra194-gte-aon, not needed for tegra194-gte-lic

Optional:

- nvidia,int-threshold:
	u32 property to indicate GTE hardware FIFO watermark. It defaults to 1
	if not defined

Example:
/ {
	tegra_gte_lic: gte@3aa0000 {
		compatible = "nvidia,tegra194-gte-lic";
		reg = <0x0 0x3aa0000 0x0 0x10000>;
		interrupts = <0 11 0x4>;
		nvidia,int-threshold = <1>;
		nvidia,num-slices = <11>;
		status = "disabled";
	};

	tegra_gte_aon: gte@c1e0000 {
		compatible = "nvidia,tegra194-gte-aon";
		reg = <0x0 0xc1e0000 0x0 0x10000>;
		interrupts = <0 13 0x4>;
		nvidia,int-threshold = <1>;
		nvidia,num-slices = <3>;
		nvidia,gpio-controller = <&tegra_aon_gpio>;
		status = "disabled";
	};
};
```

## nvidia/Documentation/devicetree/bindings/tegra_hv/tegra_hv_pm_ctl.txt
```
* Tegra Hypervisor PM control (tegra_hv_pm_ctl)

Required properties:
- compatible: Should be "nvidia,tegra-hv-pm-ctl".
- ivc : IVC channel ID between Guest VM and Sysmgr.

Optional properties:
- wait-for-guests: Used for dependency management.
                   VMs which should be inactive (shutdown/suspended)
                   before this VM should be specified in this property

Example:
	tegra_hv_pm_ctl {
		compatible = "nvidia,tegra-hv-pm-ctl";
		status = "okay";
		ivc = <&tegra_hv 102>;
		wait-for-guests = <1 2 3 ...>;
	};
```

## nvidia/Documentation/devicetree/bindings/tegra_hv/tegra_hv_wdt_handler.txt
```
* Tegra Hypervisor watchdog handler

Required properties:
- compatible: Should be "nvidia,tegra-hv-wdt-handler".
- ivc : IVC channel ID between Guest VM and WDT Monitor.

Example:
	tegra_hv_wdt_handler {
		compatible = "nvidia,tegra-hv-wdt-handler";
		status = "okay";
		ivc = <&tegra_hv 204>;
	};
```

## nvidia/Documentation/devicetree/bindings/thermal/tegra-pwm-fan.txt
```
Bindings for a fan connected to the PWM lines

Properties details:
- compatible		: "pwm-fan"
- pwms			: the PWM that is used to control the PWM fan

- shared_data
  - active_steps	: Entries for references in active_rpm[], active_pwm[], active_rru[], active_rrd[]
  - active_rru		: This value is kept on added to cur_pwm till it reaches at
			  next active step from the table. This is repeated until cur_pwm
			  value reaches target_pwm
  - active_rrd		: This value is kept on subtracted from cur_pwm till it reaches at
			  previous active step from the table. This is repeated until cur_pwm
			  value reaches target_pwm
  - state_cap_lookup 	: Index to refer in active_pwm[]
  - pwm_period		: To derive duty cycle
  - pwm_id		: Assigned PWM controller id to tegra fan
			  Same as mentioned id in pwms. In pwms, the id starts from 1
			  pwm_id in pfsd, the id starts from 0
  - step_time		: Time taken for each step during rru/rrd
  - state_cap		: Capping state value out of available active_steps
  - active_pwm_max	: Max pwm value (256)
  - pwm_gpio		: GPIO pin used for pwm
  - use_tach_feedback   : Enable the tachometer feedback logic. If a pwm set
			  request is raised, two worker threads are scheduled.
			  One for setting the pwm value and one for correcting
			  the pwm based on desired rpm for the pwm requested.
			  The tachometer readings are validated for 16 consecutive times
			  before the feedbacklogic bails out successfully.
			  If the rpm validation fails, the second worker thread
			  keeps updating the pwm using the rru/rrd values.
  - rpm_ramp_time_ms	: The rpm validation worker thread waits for the given
			  value(milliseconds) after scheduling the pwm  set
			  worker thread.
  - rpm_diff_tolerance  : How much rpm diff is to be tolerated by the rpm
			  validation logic.
  - rpm_valid_retry_count : In case the fan rpm is in limit, how many times
			    should the validation logic test for regression.
  - rpm_valid_retry_delay : How much delay to be used during the validation
			    retries after the rpm is brought to threshold values
  - rpm_invalid_retry_delay : In case the rpm expected and tachometer reading
			      values mismatch, how much delay should be used for
			      next validation.
  - use_tmargin		: If Tmargin algorithm is being used in therm_fan_est
    			  driver. This node needs to be enabled for the pwm fan
			  driver to work properly.
  - is_always_on	: Enable if the fan is always on.

Example:

	pwm_fan_shared_data: pfsd {
		status = "okay";
		num_resources = <0>;
		active_steps = <10>;
		active_rpm = <0 1000 2000 3000 4000 5000 6000 7000 10000 11000>;
		active_rru = <40 2 1 1 1 1 1 1 1 1>;
		active_rrd = <40 2 1 1 1 1 1 1 1 1>;
		state_cap_lookup = <2 2 2 2 3 3 3 4 4 4>;
		pwm_period = <45334>;
		pwm_id = <3>;
		step_time = <100>; /* mesecs */
		state_cap = <7>;
		active_pwm_max = <256>;
		pwm_gpio = <&tegra_aon_gpio TEGRA_AON_GPIO(V, 6) GPIO_ACTIVE_LOW>; /* TEGRA_MAIN_GPIO_PV6 */
	};
	pwm-fan {
		status = "okay";
		compatible = "pwm-fan";
		#pwm-cells = <1>;
		pwms = <&tegra_pwm4 0 45334>;
		shared_data = <&pwm_fan_shared_data>;
		active_pwm = <0 80 120 160 255 255 255 255 255 255>;
	};
};
```
