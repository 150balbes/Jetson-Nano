## nvidia/Documentation/devicetree/bindings/pinctrl/nvidia,tegra186-padctl.txt
```
Device tree binding for NVIDIA Tegra186 XUSB PADCTL
========================================================

The Tegra186 XUSB PADCTL manages UTMI/HSIC/SuperSpeed USB 2.0/3.0 pads, each of
which can be configured with one out of HOST_ONLY/DEVICE_ONLY/OTG capabilities.

This document defines the device-specific binding for the Tegra186 PADCTL driver.
This driver models pads and lanes as phy instances with the generic phy
abstraction. Function drivers (XHCI/XUDC drivers) could retrieve its own
phy instance via devm_phy_get() call.

Refer to pinctrl-bindings.txt in this directory for generic information about
pin controller device tree bindings and ../phy/phy-bindings.txt for details on
how to describe and reference PHYs in device trees.

Required properties:
--------------------
- compatible: should be "nvidia,tegra186-xusb-padctl"
- reg: Physical base address and length of PADCTL.
- interrupts: IRQ number of PADCTL.
- #phy-cells: Should be 1. The specifier is the index of the PHY to reference.
  See <dt-bindings/pinctrl/pinctrl-tegra-padctl.h> for the list of valid values.
- mboxes: Must contain an entry for the XUSB mailbox channel.
  See ../mailbox/mailbox.txt for details.
- mbox-names: Must include the following entries:
  - xusb

Optional properties:
-------------------
- vbus-{0,1,2}-supply: VBUS regulator for the corresponding UTMI pad.
- vddio-hsic-supply: VDDIO regulator for the HSIC pads.
- pinctrl-{1,}: For over-current support, we have to specify 3 different
  pinctrl states for each VBUS_EN pin in sequence of "sfio tristate state",
  "sfio passthrough state" and "default state", for setting over-current support
  with VBUS_EN as tristate and passthrough states,and to restore to its default
  state. For example, if there are 2 VBUS_EN pins, we should set pinctrl-1 to
  pinctrl-6 as:
  1:pin 0 sfio tristate state,
  2:pin 1 sfio tristate state,
  3:pin 0 sfio passthrough state,
  4:pin 1 sfio passthrough state,
  5:pin 0 default state,
  6:pin 1 default state.
- pinctrl-names: should be set to vbus_en0_sfio, vbus_en0_default,
  vbus_en1_sfio, vbus_en1_default, ... up to the highest supported pin number.
  The first pinctrl-names item should be "default" since pinctrl-0 is used for
  XUSB ports, not for VBUS_ENx pins.

Lane muxing:
------------

Child nodes contain the pinmux configurations following the conventions from
the pinctrl-bindings.txt document. Typically a single, static configuration is
given and applied at boot time.

Each subnode describes groups of lanes along with parameters and pads that
they should be assigned to. The name of these subnodes is not important. All
subnodes should be parsed solely based on their content.

Each subnode only applies the parameters that are explicitly listed. In other
words, if a subnode that lists a function but no pin configuration parameters
implies no information about any pin configuration parameters. Similarly, a
subnode that describes only a parameter implies no information about what
function the pins are assigned to.

Required properties:
- nvidia,lanes: An array of strings. Each string is the name of a lane.

Optional properties:
- nvidia,function: A string that is the name of the function (pad) that the
  pin or group should be assigned to. Valid values for function names are
  listed below.
- nvidia,usb3-port: USB3 port (0/1/2) to which the lane is mapped.
- nvidia,port-cap: USB port capability.

Note that not all of these properties are valid for all lanes. Lanes can be
divided into four groups:

  - otg-0, otg-1, otg-2:

    Valid functions for this group are: "xusb", "uart", "rsvd".
    nvidia,port-cap property is required when the function is xusb.

  - hsic-0:

    Valid functions for this group are: "xusb", "rsvd".

  - usb3-0, usb3-1, usb3-2:

    Do not set function for this group.
    nvidia,port-cap is required.

  - cdp-0, cdp-1, cdp-2:

    Valid functions for this group is: "xusb". No other property is required.
    This type of lane is an abstraction of Tegra CDP (charging downstream port)
    which can be turned on by host controller driver using generic phy API to
    declare a UTMI host port as CDP.

- nvidia,oc-pin: the overcurrent VBUS pin (should be >=0) the lane is using.
  When this property is specified, the corresponding OC pin will be monitored
  and if overcurrent event happens, the pad associated with this lane will be
  reported. Overcurrent support is default disabled if this property is absent.

Example:
========

SoC file extract:
-----------------

	pinctrl@0x03520000 {
		compatible = "nvidia,tegra186-xusb-padctl";
		reg = <0x0 0x03520000 0x0 0x1000>,
			<0x0 0x02500000 0x0 0xa0000>;
		interrupts = <0 167 0x4>;
		mboxes = <&xusb_mbox>;
		mbox-names = "xusb";

		#phy-cells = <1>;
	};

Board file extract:
-------------------

	# XUSB host mode takes UTMI pad#2 and SuperSpeed pad#2 for a USB 3.0 host
	#  port. Also add CDP support for that UTMI pad#2.
	xhci@0x03530000 {
		...
		phys = 	<&board-padctl TEGRA_PADCTL_PHY_UTMI_P(2)>,
			<&board-padctl TEGRA_PADCTL_PHY_USB3_P(2)>,
			<&board-padctl TEGRA_PADCTL_PHY_CDP_P(2)>;
		phy-names = "utmi-2", "usb3-2", "cdp-2";

		...
	}

	...

	# XUSB device mode takes UTMI pad#0 and SuperSpeed pad#0 for a USB3.0 device port
	xudc@0x03550000 {
		...
		phys = 	<&board-padctl TEGRA_PADCTL_PHY_UTMI_P(0)>,
			<&board-padctl TEGRA_PADCTL_PHY_USB3_P(0)>,
		phy-names = "usb2", "usb3";

		...
	}

	board-padctl: pinctrl@0x03520000 {
		pinctrl-0 = <&tegra_xusb_padctl_pinmux_default>;
		pinctrl-1 = <&vbus_en0_sfio_tristate_state>;
		pinctrl-2 = <&vbus_en1_sfio_tristate_state>;
		pinctrl-3 = <&vbus_en0_sfio_passthrough_state>;
		pinctrl-4 = <&vbus_en1_sfio_passthrough_state>;
		pinctrl-5 = <&vbus_en0_default_state>;
		pinctrl-6 = <&vbus_en1_default_state>;
		pinctrl-names = "default",
			"vbus_en0_sfio_tristate", "vbus_en1_sfio_tristate",
			"vbus_en0_sfio_passthrough", "vbus_en1_sfio_passthrough",
			"vbus_en0_default", "vbus_en1_default";

		vbus-2-supply = <&vdd_usb3_vbus>;

		pinctrl_default: pinmux {
			usb2-micro-AB {
				nvidia,lanes = "otg-0";
				nvidia,function = "xusb";
				nvidia,port-cap = <TEGRA_PADCTL_PORT_OTG_CAP>;
				nvidia,oc-pin = <0>;
			};

			usb3-micro-AB {
				nvidia,lanes = "usb3-0";
				nvidia,port-cap = <TEGRA_PADCTL_PORT_OTG_CAP>;
				nvidia,oc-pin = <0>;
			};

			usb2-std-A {
				nvidia,lanes = "otg-2";
				nvidia,function = "xusb";
				nvidia,port-cap = <TEGRA_PADCTL_PORT_HOST_ONLY>;
				nvidia,oc-pin = <1>;
			};

			usb3-std-A {
				nvidia,lanes = "usb3-2";
				nvidia,port-cap = <TEGRA_PADCTL_PORT_HOST_ONLY>;
				nvidia,oc-pin = <1>;
			};
		};
	};
```

## nvidia/Documentation/devicetree/bindings/platform/tegra/nvidia,carmel-pmu.txt
```
NVIDIA Carmel Uncore PMU
========================

This driver supports hardware perfmon event counting for the 4 L2 clusters
and for the L3. The supported events are standard ARM L2/L3 event numbering,
but shifted and masked with a unit number for the sake of granular unit
tracking. The event format is EEU, where 'EE' is the standard ARM event number
and U is the unit (0-3 for the L2s, 4 for the L3).

These standard ARM events are supported:

Event				ID		Type
L2D_CACHE			0x16		L2
L2D_CACHE_REFILL		0x17		L2
L2D_CACHE_WB			0x18		L2

BUS_ACCESS			0x19		L3
BUS_CYCLES			0x1D		L3
L3D_CACHE_ALLOCATE		0x29		L3
L3D_CACHE_REFILL		0x2A		L3
L3D_CACHE			0x2B		L3
L3D_CACHE_WB			0x2C		L3

L2D_CACHE_LD			0x50		L2
L2D_CACHE_ST			0x51		L2
L2D_CACHE_REFILL_LD		0x52		L2
L2D_CACHE_REFILL_ST		0x53		L2
L2D_CACHE_REFILL_VICTIM		0x56		L2

For example, to track L2 cache events (0x16) on clusters 0 and 2 as well as L3
events (0x2b):

perf stat -a -e r160,r162,r2b4

Required properties:
	- compatible : "nvidia,carmel-pmu"
	- interrupts : single hardware-specified interrupt
	- interrupt-affinity : this driver must be pinned to Carmel core 0 (cpu@0)
		in order to correctly field PMU interrupts from the L2/L3 units.

Example:
	carmel-pmu {
		compatible = "nvidia,carmel-pmu";
		interrupts = <0 365 0x4>;
		interrupt-affinity = <&{/cpus/cpu@0}>;
	};
```

## nvidia/Documentation/devicetree/bindings/platform/tegra/nvidia,tegra_thermal_throttle.txt
```
Tegra Thermal Throttle Driver
-----------------------------

This file documents the DT bindings of the Tegra Thermal Throttle driver. The
throttling driver registers one or more cooling devices for throttling clocks
in the system and provides passive cooling. The type of clock throttling
supported by the driver are specified in the file:
dt-bindings/nvidia,tegra-thermal-throttle.h.

The throttling driver calculates a throttling frequency by doing a linear
interpolation between the maximum and minimum frequencies of the clock. The
throttled frequency can then be calculated using the equation:
    throt_freq = max_freq - (cur_state * freq_step_size)

The throttle driver queries the max/min frequencies using CCF for all clocks
except the cpu clocks and assumes a fixed frequency step size for each clock it
throttles. The max/min frequencies for the CPU clocks are obtained from the
cpufreq subsystem. It then uses mechanisms such as cpufreq and pmqos to set
throttled frequency. The driver throttles all the available CPUs and doesn't
support individual CPU cluster throttling.

The goal of passive cooling is to reduce power consumption for each cooling
device cur state. The minimum frequency step size of clock depends on several
factors and is different for each clock. Making throttling steps that are
smaller than this step size will not result in the requested frequency and can
result in bad thermal performance. The throttling driver must therefore at each
step select a different throttling frequency from the clock's list of available
frequencies. To address this the throttling driver assumes a fixed frequency
step size for each clock and provides DT properties that can scale the step
size. The resultant throttling equation therefore becomes:
    throt_freq = max_freq - (((cur_state * freq_step_size) / slope_adj) + offset)

Required properties:
- clocks : This property provides a list of clocks that can be throttled. Must
  provide at least one valid clock. Must contain one entry for each entry in
  clock-names. See ../clocks/clock-bindings.txt for details.
- clock-names: Must include either:
  - Clock names for all CPUs "cpu0, cpu1, cpu2, cpu3", to throttle all CPUs. Or
  - Clock name for GPU "gpu" to throttle the GPU.

Required subnodes: The throttle node must provide at least one cooling device
node with at least one clock to throttle.

Required cooling device properties:
- cdev-type: See ../thermal/thermal.txt for details.
- cooling-cells: See ../thermal/thermal.txt for details.
- nvidia,throttle-clocks: This property contains the list of clocks that need to
  be throttled by the cooling device and their throttle rate tuning parameters.
  The property is an array of triplets where each triplet contains the clock
  throttling type, the slope adjustment factor and an offset. A valid throttle
  clock entry must contain all three properties and at least one valid triplet
  must be defined for the cooling device to be valid.
  - throttling type: The first property in the triplet specifies the clock
    throttling type and must be one of the values specified in
    nvidia,tegra-thermal-throttle.h.
  - slope-adj: The second property in the triplet is used to increase or
    decrease the rate of frequency change by adjusting the freq_step_size for
    the clock. A slope adjust of 100 scales the step size by 1 and should be
    used as a default value if slope adjustment is not needed. The slope
    adjusted freq_step_size is calculated as: freq_step_size * 100 / slope-adj.
    A value of 50 therefore doubles the step size and decreases the max cooling
    states. Whereas, slope-adj of 200 increases the step size and increases the
    max cooling states. The slope adjust must be a positive non zero value.
    Care must be taken while specifying the slope-adj as making the step size
    smaller than the frequency step size of the clock will not affect the final
    clock frequency as explained above.
  - offset: Specifies the offset that will be added to the clock throttling
    frequency. Since each cooling device can throttle more than one clock there
    is often a need to delay the throttling on one of the clocks. Specifying
    this property adds max frequency entries at the start of the throttling
    table for that clock which effectively delays the throttling for the clock.
    The number of steps added depends on the freq_step_size and slope_adj and
    can be determined as shown in [1] below. Offset is specified in units of Hz
    default offset of 0Hz must be specified if no offset is required.

Optional cooling device properties:
- nvidia,cutoff: To ensure a cooling device can throttle all clocks to their
  minimum frequencies the max_state of the cooling device is decided by the
  clock with the maximum max_state i.e.
      max_state_clk1 = (max_freq - min_freq) / freq_step_size
      max_state = max(max_state_clk1, max_state_clk2 ...)
  Specifying the cutoff property ensures that the throttling stops as soon as
  one of the clocks in the cooling device reache its minimum frequency, causing
  the equation above to change to:
      max_state = min(max_state_clk1, max_state_clk2 ...)
  A missing property or a value of 0 disables cutoff. Allowed values are 0,1.

Notes:
The properties cutoff, offset and slope-adj tune the throttling response and
change the max_state of the cooling device. The max_state of the cooling device
can be calculated as follows:
    max_state_clk_1 = (((offset / freq_step_size) + ((max_freq - min_freq) /
			freq_step_size)) * slope_adj) / 100 ..... [1]
if cutoff not specified:
    max_state = max(max_state_clk1, max_state_clk2 ...)

Example:
tegra_thermal_throttle {
	compatible = "nvidia,tegra-thermal-throttle";
	clocks = <&bpmp_clks TEGRA194_CLK_NAFLL_CLUSTER0>,
			<&bpmp_clks TEGRA194_CLK_NAFLL_CLUSTER1>,
			<&bpmp_clks TEGRA194_CLK_NAFLL_CLUSTER2>,
			<&bpmp_clks TEGRA194_CLK_NAFLL_CLUSTER3>,
			<&bpmp_clks TEGRA194_CLK_NAFLL_GPU>;
	clock-names = "cpu0", "cpu1", "cpu2", "cpu3", "gpu";
	cpu_balanced {
		cdev-type = "cpu-balanced";
		#cooling-cells = <2>;
		nvidia,cutoff = <1>;
		nvidia,throttle_clocks = <TEGRA_THROTTLE_CPU 100 0,
					 TEGRA_THROTTLE_GPU 100 0>;
	};
};
```
