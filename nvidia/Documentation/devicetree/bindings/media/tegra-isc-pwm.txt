## nvidia/Documentation/devicetree/bindings/media/tegra-isc-pwm.txt
```
NVIDIA tegra isc pwm driver

This file documents the properties used by the isc-mgr driver in tegra platform

Required properties:
- compatible : Should be "nvidia, isc-pwm"
- pwms : PWM property to point to the PWM chip, chip-relative PWM number and to
         specify the period time to be used
- pwm-cells : Specify the number of cells used for the PWM chip
- npwm : number of PWMs controlled by this chip

Example:
isc_pwm: isc_pwm_gen {
    compatible = "nvidia, isc-pwm";
    pwms = <&tegra_pwm2 0 0>; /* by default the number of cells is 2 */
    #pwm-cells = <2>;
    npwm = <3>; /* number of PWMs controlled by this chip */
    status = "okay";
};
```

## nvidia/Documentation/devicetree/bindings/misc/nvidia,nct1008.txt
```
Tegra External Temperature Sensor driver
----------------------------------------

This file documents the DT bindings of the NCT1008 external temperature sensor
driver. NCT1008 belongs to a class of sensors that reports two temperatures,
one local and one external. On Tegra systems the local sensor measures the
board temperature and the external sensor measures the junction temperature on
the die. The sensor is connected as an I2C slave and can be communicated with
using the SMBus protocol. The Tegra NCT1008 driver supports TMP451 and MAX6649
in addition to the NCT1008 sensor.

NCT1008 driver is an I2C client that registers itself as two sensors to
the thermal framework and supports programmable temperature alerts and
overtemperature shutdown limits. The sensor ids are defined in
<dt-bindings/misc/nvidia,nct1008.h>.

Required properties :
- compatible : The compatibility string must match the sensor that is
  being used and should be one of the following:
  - onsemi,nct72
  - ti,tmp451
  - maxim,max6649
- reg : An I2C client property which specifies the slave address of the sensor
  on the I2C bus.
- #thermal-sensor-cells : Should be 1. See ./thermal.txt for a description of
  this property.
- conv-rate : Specifies the value to be programmed into the conversion rate
  register of the sensor. Valid range is 0 - 9. See the sensor datasheet for the
  exact conversion rates.

Optional properties :
- interrupts : An I2C client property which specifies the interrupt used by the
  sensor for temperature alerts.
- temp-alert-gpio : This property specifies the gpio used by the sensor to
  trigger the temperature alert.
- loc-shutdown-limit : When present, this property specifies the temperature at
  which the local sensor will assert the thermal trigger signal to the
  Power Management IC. which can be configured to reset or shutdown the device.
  In the absence of this property the over temperature shutdown from local
  sensor will be disabled. Can take any value in the valid temperature range of
  the sensor.
- ext-shutdown-limit : Similar to the loc-shutdown-limit. Used to specify the
  over temperature shutdown limit for the external sensor.
- extended-range : This property is used to control the range of temperature
  measurement in the sensor. Allowed values are 0,1. A value of 1 enables
  extended temperature monitoring range and a missing property disables it.
- offset : Specifies the offset to be programmed to the offset register. The
  property is in units of 0.25C and has a valid range of -128C to 127C.
- offset-hi-res : Similar to the offset property but allows offset to be
  programmed in units of 0.0625C.
- support-fuse-offset : When present the driver reads the fuse registers which
  has the measured offset at a known temperature. After performing linear
  correction on the true physical temperature (which is offset + known
  temperature) a value for offset and nfactor are calculated. These values are
  then used to program the corresponding registers in the sensor hardware. The
  property takes no value.
- alpha : Specifies the slope of the linear correction that is performed when
  support-fuse-offset is specified.
- beta : Specifies the intercept of the linear correction that is performed when
  support-fuse-offset is specified.

Note:
The external temperature reported by the sensor can often be inaccurate which
can be corrected by progamming the offset register. The NCT1008 driver allows
offset to be specified in couple of ways as using the various offset properties
described above. The support-fuse-offset property takes effect only if both
offset and offset-hi-res are absent. The offset-hi-res property takes effect
only if offset property is absent.
```

## nvidia/Documentation/devicetree/bindings/misc/nvs/nvs_dsm.txt
```
* NVidia Sensor (NVS) Dynamic Sensor Meta (DSM)

This driver uses the NVidia Sensor (NVS) framework.
See the nvs.txt documentation for NVS DT capabilities.
The nvs_dsm sensor driver supports dynamic sensors.

Required properties:
- compatible: Device or generic name.
	      Supported device names:
	      - nvidia,nvs_dsm

Optional properties:
- status: set to "ok" or "okay" for normal operation.  Set to anything else
	  to unload the driver without ever communicating with the device.
  Note: The "anything else" above is typically "disabled".
	Since the driver will unload without communicating with the device, the
	device will be left in its POR state.

Example:
	nvs_dsm {
		compatible = "nvidia,nvs_dsm";
		status = "okay";
	};
```

## nvidia/Documentation/devicetree/bindings/misc/therm_est.txt
```
Thermal estimator driver.

Properties :
 - compatible : Should contain "nvidia,therm-est".
 - polling-period : Polling wait times for thermal estimation, in milliseconds.
 - tc1 : Coefficient 1 for thermal trend calculation.
 - tc2 : Coefficient 2 for thermal trend calculation.
 - node for subdev : Node for subdevice information. Required.
 - use_tmargin : if tmargin algorithm should be used for calculating the
   effective temp. Refer Tmargin section for more info.

Properties in subdev node : Required.
 - subdev_names : list of strings. It contains list of the name of the therm
		zones used for estimation.
 - node for coeff_set : contains a set of zone specific coefficients+offset.
			This node can be numerous.

Properties in coeff_set : Required. Can be numerous.
 - toffset : Temperature offset for thermal estimation, in milli-celsius.
 - coeffs : An array of coefficients, the number of entries should be twenty
	per sub device.

Example:

	therm_est_sensor {
		device_type = "therm-est-subdev";
		polling-period = <1100>;
		tc1 = <10>;
		tc2 = <1>;
		subdev {
			subdev_names = "Tdiode_tegra", "Tboard_tegra";

			coeff_set@0 {
				toffset = <9793>;
				coeffs = <
					2 1 1 1 1 1 1 1 1 1 1 0 1 1 0 0 0 0 (-1) (-7)
					(-11) (-7) (-5) (-3) (-3) (-2) (-1) 0 0 0 1 1 1 2 2 3 4 6 11 18
				>;
			};

			coeff_set@1 {
				toffset = <708>;
				coeffs = <
					-1 -1 1 1 1 1 1 1 1 1 1 0 1 1 0 0 0 (-1) (-3) (-9)
					(-6) (-4) (-1) 0 0 0 0 0 0 0 1 1 1 2 2 5 7 10 17 20
				>;
			};
		};
	};

Tmargin Algorithm:
The native max temp algorithm lacks support for accomodating multiple thermal
fan curves. Tmargin algorithm solves this by calculating the effective
temperature as a difference from critical temperature of the therm fan est
group. This allows us to take a union of two fan curves and satisfy the needs
of both the therm-fan-est groups.
The algorithm use the effective temperature(crit_temp - sensor_reading) to
drive the cooling device.

Properties rules for therm-fan-est dt entry:
 - use_tmargin : To use the tmargin feature.
 - profiles : New profile tmargin should be defined and chosen as default.
	* The trip temperatures need to be given only in ascending order for the
	  thermal framework to register therm-fan-est zone. Hence, the dt values
	  for active trip temps should be given in ascending values of tmargin
	  values.
	* Hysterysis is used only in cooling scenario. Since tmargin is
	  considered as a diff wrt crit_Temp, hysterysis values should be taken
	  as -ve values.

Properties rules for fan dt entry:
 - profiles : New profile for tmargin should be defined and chosen as default.
	* The trip temps are considered in a ascending order of tmargin temps.
	  Hence, the pwm values should be considered in a descending order of
	  pwms.
	* active_steps - The tmargin trip values are considered in the ascending
	  order(hence actual trip temps will be in descending order), so the
	  pwm mapping should be in the reverse order starting from 255 for
	  index 0.

Example :

        thermal-fan-est {
                compatible = "thermal-fan-est";
                name = "thermal-fan-est";
                status = "okay";
                num_resources = <0>;
                shared_data = <&thermal_fan_est_shared_data>;
                trip_length = <10>;
                use_tmargin;

                profiles {
                        default = "tmargin";
                        quiet {
                                active_trip_temps = <0 50000 63000 72000 81000
                                                140000 150000 160000 170000 180000>;
                                active_hysteresis = <0 18000 8000 8000 8000
                                                0 0 0 0 0>;
                        };
                        cool {
                                active_trip_temps = <0 35000 53000 62000 73000
                                                140000 150000 160000 170000 180000>;
                                active_hysteresis = <0 9000 8000 8000 9000
                                                0 0 0 0 0>;
                        };
                        tmargin {
                                active_trip_temps = <0 10000 15000 25000 35000
                                                45000 55000 65000 75000 105000>;
                                active_hysteresis = <0 0 0 0 (-3000)
                                                (-4000) (-4000) 0 0 0>;
                        };
                };
        };

        pwm-fan {
                compatible = "pwm-fan";
                status = "okay";
                #pwm-cells = <1>;
                pwms = <&tegra_pwm4 0 45334>;
                shared_data = <&pwm_fan_shared_data>;
                profiles {
                        default = "tmargin";
                        quiet {
                                state_cap = <8>;
                                active_pwm = <0 60 90 120 150 180 210 240 255 255>;
                        };
                        cool {
                                state_cap = <4>;
                                active_pwm = <0 77 120 160 255 255 255 255 255 255>;
                        };
                        tmargin {
                                state_cap = <0>;
                                active_pwm = <255 255 240 210 180 150 120 90 60 0>;
                        };
                };
        };
```

## nvidia/Documentation/devicetree/bindings/nvpmodel/nvpmodel.txt
```
NVIDIA nvpmodel driver bindings

Nvpmodel is a driver that provides sysfs nodes that allow capping certain clock
frequencies in order to keep the power consumption under a certain budget.

These caps are designed to be relatively static. They should not be used
during runtime (under load) to dynamically change the power budget.

Required properties:

- compatible: should be "nvidia,nvpmodel"

Optional properties:

- clocks: Clock IDs that the driver should support capping
- clock-names: List of strings which identify the relevant clocks

Both properties must have the same number of clocks. The strings that appear
in the clock-names property will be the names of the sysfs nodes that will be
provided. The clock IDs and names should appear in the same order.

Sample:

nvpmodel: {
        compatible = "nvidia,nvpmodel";
        clocks = <&tegra_car TEGRA186_CLK_NVENC
                        &tegra_car TEGRA186_CLK_NVDEC>;
        clock-names = "nvenc", "nvdec";
        status = "okay";
};
```
