## nvidia/drivers/media/platform/tegra/Kconfig
```kconfig
source "drivers/media/platform/tegra/mipical/Kconfig"

config VIDEO_CAMERA
	tristate "generic camera device support"
	depends on I2C && ARCH_TEGRA
	select REGMAP_I2C
	---help---
	  This is a driver for generic camera devices
	  for use with the tegra isp.

config VIDEO_TEGRA_VI
	depends on TEGRA_GRHOST
	depends on VIDEO_V4L2 && VIDEO_V4L2_SUBDEV_API && OF
	select VIDEOBUF2_DMA_CONTIG
	select V4L2_FWNODE
	tristate "Tegra video input host1x client driver"
	default y
	help
	  Driver for the Tegra video input hardware based on
	  media controller framework and interact with host1x
	  apis to support both user space as well as kernel
	  programming of VI hardware registers
	  To compile this driver as a module, choose M here:
	  the module will be called nvhost-vi.

config VIDEO_TEGRA_VI_TPG
	depends on VIDEO_TEGRA_VI
	tristate "Tegra video input test pattern generator driver"
	default m
	help
	  Driver for the Tegra video input test pattern generator
	  driver is based on media controller framework and interact
	  with host1x apis to support both user space as well as kernel
	  programming of VI hardware registers to generate predefined
	  test patterns.
	  To compile this driver as a module, choose M here:
	  the module will be called nvhost-vi-tpg.

config VIDEO_CAMERA_SKT
	depends on VIDEO_CAMERA && OF
	tristate "Tegra camera sensor kernel tests"
	default m
	help
	  Enables the Tegra camera sensor kernel tests.

config VIDEO_ISC
	tristate "ISC(Image Sensor Control) device support"
	depends on I2C && ARCH_TEGRA
	---help---
	  This is a driver for the ISC
	  for controlling power, interrupt and registering
	  i2c clients related to image sensor.
```

## nvidia/drivers/media/spi/Kconfig
```kconfig
config VIDEO_IMX204
	tristate "IMX204 camera sensor support"
	depends on SPI && VIDEO_V4L2 && VIDEO_V4L2_SUBDEV_API
        select REGMAP_SPI
	---help---
	  This is a Video4Linux2 sensor-level driver for the Sony
	  IMX204 camera sensor

	  To compile this driver as a module, choose M here: the module
	  will be called imx204.
```

## nvidia/drivers/misc/Kconfig
```kconfig
append_menu "Misc devices"

config MODS
	tristate "NVIDIA MODS driver"
	select OF_DYNAMIC
	select OF_RESOLVE
	default n
	---help---
	The NVIDIA MODS driver gives user space software direct access to
	hardware.  The NVIDIA Diagnostic Software uses this to test hardware.
	This driver should normally be disabled in all production builds.

	Say Y here to compile the NVIDIA MODS driver into the kernel or say M
	to compile it as a module.

	If unsure, say N here.

config SAF775x_HWDEP
        tristate "SAF775x HWDEP Driver"
        default n
        depends on I2C || SPI

config SAF36XX_HWDEP
        tristate "SAF36XX HWDEP Driver"
        default n
        depends on SPI && SPI_MASTER
        help
          Provides interfaces for flashing SAF36XX

config SENSORS_NCT1008
	tristate "ON Semiconductor Temperature Sensor"
	default n
	depends on I2C
	help
	 Say yes here if you wish to include the ON Semiconductor
	 NCT1008 Temperature sensor.

config SENSORS_PEX9749
	tristate "Thermal sensor for PEX9749"
	default n
	depends on I2C
	help
	  Say yes to enable thermal sensor monitoring for PEX9749. PEX9749
	  is an I2C slave which allows PEX9749 configuration registers to
	  be read or written by an external I2C master independently of
	  PCIe link state.

config TEGRA_CPC
	tristate "Tegra content protection controller"
	depends on I2C
	help
	  This driver allows authenticated IO access to storage blocks on
	  CPC controller via i2c.

config THERM_EST
	bool "Thermal estimator driver"
	default n
	---help---
	Thermal driver which estimates temperature based of other sensors.

config FAN_THERM_EST
	tristate "Fan driving temp estimator"
	---help---
	Thermal driver that estimates the fan driving temperature based on
	other sensors.

	This enables a virtual sensor that polls other registered thermal
	zone devices for temperature updates.

config EQOS_APE_HWDEP
	tristate "EQOS APE HWDEP Driver"
	default n
	depends on TEGRA_NVADSP
	help
	  Driver provides mechanism to synchronize EAVB and APE clock.
	  This driver copies the EAVB time stamp on APE time registers
	  to synchroniza the initial phase offset. It calculates the
	  frequency offset between the two clocks  by taking subsequent
	  snapshots of the clock and taking the difference. Based on the
	  calculated frequency offset, the pll_a clock (parent of APE clock)
	  frequency is adjusted.

config TEGRA_SKIN
	tristate "Thermal skin temperature estimator"
	---help---
	  Thermal driver which estimates hotspot(s) tempeature based on power
	  features like rail power, rail current, backlight brightness. The
	  driver estimates multiple hotspot temperatures based on OF configuration.

config TEGRA_PCIE_EP_MEM
	tristate "Client driver for Tegra PCIe end point"
	depends on PCI
	help
	 Say Y if Tegra is working in PCIe-End Point mode and a client
	 driver is required

if ARCH_TEGRA
source "drivers/misc/nvs-dfsh/Kconfig"
source "drivers/misc/nvs/Kconfig"
source "drivers/misc/nvs-aonsh/Kconfig"
source "drivers/misc/tegra-profiler/Kconfig"
source "drivers/misc/eventlib/Kconfig"
endif

config BLUEDROID_PM
	tristate "Bluedroid_pm driver support"
	help
	  Bluetooth Bluedroid power management Driver.
	  This driver provides power control and dynamic active power saving
	  mechanism for bluetooth radio devices.

	  Say Y here to compile support for bluedroid_pm support into the kernel
	  or say M to compile it as module (bluedroid_pm).

endmenu
```

## nvidia/drivers/misc/eventlib/Kconfig
```kconfig
config EVENTLIB
	tristate "Enable Eventlib"
	default y
	depends on SYSFS
	help
	  This option enables Eventlib.
	  Say Y or M if you want to enable Eventlib.
```

## nvidia/drivers/misc/nvs-aonsh/Kconfig
```kconfig
config NVS_AON_SHUB
	tristate "Tegra T18x AON Sensor Hub driver"
	depends on ARCH_TEGRA_18x_SOC && TEGRA_AON && NVS_IIO
	select NV_TEGRA_IVC
	select TEGRA_HSP
	help
	  Say Y here for Tegra T18x sensor hub for projects that only use
	  sensors connected to an auxilliary CPU.

	  The driver uses the NVS (NVidia Sensor) IIO framework.
```

## nvidia/drivers/misc/nvs-dfsh/Kconfig
```kconfig
config NVS_DFSH
	tristate "Line discipline for NVS DFSH"
	depends on TTY && IIO_BUFFER && IIO_TRIGGERED_BUFFER && NVS_IIO
	default n
	help
	  Say Y here for TTY line discipline for NVS
	  DFSH stream.

	  This driver cannot be built as a module.
	  If unsure, say N.
```

## nvidia/drivers/misc/nvs/Kconfig
```kconfig
#
# NVS (NVidia Sensor framework)
#
config NVS
	tristate "Common module for NVSensor drivers"
	depends on SYSFS
	default n
	help
	  Say Y here for NVSensor framework support.
	  This is a common module for NVS (NVidia Sensor)
	  drivers (nvs_<device>).

config NVS_IIO
	tristate "Common module for NVSensor IIO drivers"
	depends on SYSFS && IIO && IIO_KFIFO_BUF && IIO_TRIGGER && NVS
	default n
	help
	  Say Y here for IIO NVSensor framework support.
	  This is a common module for NVS (NVidia Sensor)
	  IIO (Industrial Input/Output) drivers (nvs_<device>).

config NVS_INPUT
	tristate "Common module for NVSensor INPUT drivers"
	depends on SYSFS && NVS
	default n
	help
	  Say Y here for INPUT NVSensor framework support.
	  This is a common module for NVS (NVidia Sensor)

config NVS_RELAY
	tristate "Common module for NVSensor RELAY drivers"
	depends on SYSFS && NVS
	default n
	help
	  Say Y here for INPUT NVSensor framework support.
	  This is a common module for NVS (NVidia Sensor)

config NVS_ON_CHANGE
	tristate "Common module for NVSensor on-change drivers"
	depends on SYSFS && NVS
	default n
	help
	  Say Y here for the NVSensor framework for on-change sensors.

	  This is required for NVS (NVidia Sensor) drivers (nvs_<device>)
	  that control an on-change sensor (as defined by Android) in
	  their device. This is typically autoselected by these drivers.

config NVS_LIGHT
	tristate "Common module for NVSensor light drivers"
	depends on SYSFS
	default n
	help
	  Say Y here for the NVSensor framework for ambient light sensors.

	  This is required for NVS (NVidia Sensor) drivers (nvs_<device>)
	  that control an ambient light sensor (ALS) in their device.
	  This is typically autoselected by these drivers.

config NVS_PROXIMITY
	tristate "Common module for NVSensor proximity drivers"
	depends on SYSFS
	default n
	help
	  Say Y here for the NVSensor framework for proximity sensors.
	  This is required for NVS (NVidia Sensor) drivers (nvs_<device>)
	  that control a proximity sensor in their device.

config NVS_TRIGGERED_BUFFER
	bool "Alias for IIO_TRIGGERED_BUFFER"
	select IIO_TRIGGER
	select IIO_BUFFER
	select IIO_TRIGGERED_BUFFER
	default n
	help
	  Say Y here for the NVSensor framework for proximity sensors.
	  This is required for NVS (NVidia Sensor) drivers (nvs_<device>)
	  that control a proximity sensor in their device.

config NVS_GTE
	tristate "NVSensor Generic Timestamping Engine"
	depends on TEGRA_HTS_GTE
	help
	  Enable this option for hardware timestamping support on NVS
	  (NVidia Sensor) interrupts. The NVS framework will use the nVidia
	  Tegra GTE hardware.
```

## nvidia/drivers/misc/tegra-cec/Kconfig
```kconfig
if ARCH_TEGRA

config TEGRA_CEC_SUPPORT
	bool "Tegra CEC support"
	depends on TEGRA_DC
	---help---
	 Enables HDMI-CEC driver for Tegra SoC.

endif
```

## nvidia/drivers/net/can/Kconfig
```kconfig
if CAN_DEV
source "drivers/net/can/mttcan/native/Kconfig"
source "drivers/net/can/mttcan/ivc/Kconfig"
source "drivers/net/can/nvsec/Kconfig"
endif
```

## nvidia/drivers/net/ethernet/nvidia/Kconfig
```kconfig
#
# NVIDIA network device configuration
#
source "drivers/net/ethernet/nvidia/pcie/Kconfig"
```

## nvidia/drivers/net/ethernet/nvidia/pcie/Kconfig
```kconfig
config PCIE_TEGRA_VNET
	bool "NVIDIA Tegra PCIe virtual net driver"
	help
	  Say Y here if you want to support Tegra PCIe endpoint device on
	  the host. This driver adds support in the host to communicate with
	  virtual network function driver available in Tegra PCIe endpoint.
```

## nvidia/drivers/net/ethernet/realtek/Kconfig
```kconfig
#
# Realtek device configuration
#

config R8168
	tristate "Realtek 8168 gigabit ethernet support"
	depends on PCI && NET_VENDOR_REALTEK
	---help---
	  Say Y here if you have a Realtek 8168 PCI Gigabit Ethernet adapter.

	  To compile this driver as a module, choose M here: the module
	  will be called r8168.  This is recommended.

config R8168_NAPI
    bool "Realtek 8168 NAPI"
    default y
    depends on PCI && NET_VENDOR_REALTEK
    ---help---
      Say Y here if you have a Realtek 8168 PCI Gigabit Ethernet adapter.

config R8168_VLAN
    bool "Realtek 8168 VLAN"
    default y
    depends on PCI && NET_VENDOR_REALTEK
    ---help---
      Say Y here if you have a Realtek 8168 PCI Gigabit Ethernet adapter.

config R8168_ASPM
    bool "Realtek 8168 ASPM"
    default y
    depends on PCI && NET_VENDOR_REALTEK
    ---help---
      Say Y here if you have a Realtek 8168 PCI Gigabit Ethernet adapter.

config R8168_S5WOL
    bool "Realtek 8168 S5WOL"
    default y
    depends on PCI && NET_VENDOR_REALTEK
    ---help---
      Say Y here if you have a Realtek 8168 PCI Gigabit Ethernet adapter.
```
