## nvidia/drivers/iio/accel/Kconfig
```kconfig
append_menu "Accelerometers"

#
# Accelerometer drivers
#
# When adding new entries keep the list in alphabetical order

config NVS_AIS328DQ
	tristate "STMicroelectronics accelerometer AIS328DQ"
	depends on I2C && IIO_BUFFER && IIO_TRIGGERED_BUFFER && NVS_IIO
	help
	  Say yes here to build support for STMicroelectronics AIS328DQ
	  accelerometer using NVS (NVidia Sensor framework).

endmenu
```

## nvidia/drivers/iio/gyro/Kconfig
```kconfig
append_menu "Digital gyroscope sensors"

#
# Gyroscope drivers
#
# When adding new entries keep the list in alphabetical order

config NVS_A3G4250D
	tristate "STMicroelectronics gyroscope A3G4250D"
	depends on I2C && IIO_BUFFER && IIO_TRIGGERED_BUFFER && NVS_IIO
	help
	  Say yes here to build support for STMicroelectronics A3G4250D
	  gyroscope using NVS (NVidia Sensor framework).

endmenu
```

## nvidia/drivers/iio/imu/nvs_bmi/Kconfig
```kconfig
config NVS_BMI160_IIO
	tristate "Bosch BMI160 IMU using IIO transport"
	depends on I2C && SYSFS && IIO
	select NVS
	select NVS_IIO
	default n
	help
	  Enable Bosch BMI160 IMU

config NVS_BMI160_INPUT
	tristate "Bosch BMI160 IMU using INPUT transport"
	depends on I2C && SYSFS && INPUT
	select NVS
	select NVS_INPUT
	default n
	help
	  Enable Bosch BMI160 IMU

config NVS_BMI160_RELAY
	tristate "Bosch BMI160 IMU using RELAYFS transport"
	depends on I2C && SYSFS
	select NVS
	select NVS_RELAY
	default n
	help
	  Enable Bosch BMI160 IMU

config NVS_BMI08X_IIO
	tristate "Bosch BMI08X IMU using IIO transport"
	depends on I2C && SYSFS && IIO
	select NVS
	select NVS_IIO
	default n
	help
	  Enable Bosch BMI08X IMU

config NVS_BMI08X_INPUT
	tristate "Bosch BMI08X IMU using INPUT transport"
	depends on I2C && SYSFS && INPUT
	select NVS
	select NVS_INPUT
	default n
	help
	  Enable Bosch BMI08X IMU

config NVS_BMI08X_RELAY
	tristate "Bosch BMI08X IMU using RELAYFS transport"
	depends on I2C && SYSFS
	select NVS
	select NVS_RELAY
	default n
	help
	  Enable Bosch BMI08X IMU
```

## nvidia/drivers/iio/light/Kconfig
```kconfig
append_menu "Light sensors"

#
# Light sensor drivers
#
# When adding new entries keep the list in alphabetical order

config NVS_BH1730FVC
	tristate "ROHM BH1730FVC ALS"
	depends on I2C && IIO_BUFFER && IIO_TRIGGERED_BUFFER && NVS_IIO && NVS_LIGHT
	help
	  Say Y here for ROHM Co., Ltd. BH1730FVC
	  Digital 16bit Serial Output Type
	  Ambient Light Sensor (ALS) support.

	  The driver uses the NVS (NVidia Sensor) IIO, light framework.

config NVS_CM3217
	tristate "Capella CM3217 ALS"
	depends on I2C && IIO_BUFFER && IIO_TRIGGERED_BUFFER && NVS_IIO && NVS_LIGHT
	help
	  Say Y here for Capella Microsystems, Inc. CM3217
	  Ambient Light Sensor (ALS) support.

	  The driver uses the NVS (NVidia Sensor) IIO, light framework.

config NVS_CM3218
	tristate "Capella CM3218 ALS"
	depends on I2C && IIO_BUFFER && IIO_TRIGGERED_BUFFER && NVS_IIO && NVS_LIGHT
	help
	  Say Y here for Capella Microsystems, Inc. CM3218 and CM32181
	  Ambient Light Sensor (ALS) driver support.

	  The driver uses the NVS (NVidia Sensor) IIO, light framework.

config NVS_ISL2902X
	tristate "INTERSIL ISL2902X ALS/Proximity"
	depends on I2C && IIO_BUFFER && IIO_TRIGGERED_BUFFER && NVS_IIO && NVS_LIGHT && NVS_PROXIMITY
	help
	  Say Y here for Intersil ISL29028 and ISL29029
	  Ambient Light Sensor (ALS) and proximity driver
	  support.

	  The driver uses the NVS (NVidia Sensor) IIO, light and
	  proximity framework.

config NVS_JSA1127
	tristate "SOLTEAMOPTO JSA1127 ALS"
	depends on I2C && IIO_BUFFER && IIO_TRIGGERED_BUFFER && NVS_IIO && NVS_LIGHT
	help
	  Say Y here for Solteamopto JSA1127
	  Ambient Light Sensor (ALS) driver support.

	  The driver uses the NVS (NVidia Sensor) IIO, light framework.

config NVS_LTR659
	depends on I2C && IIO_BUFFER && IIO_TRIGGERED_BUFFER && NVS_IIO && NVS_LIGHT && NVS_PROXIMITY
	tristate "LITEON LTR-659PS or LTR_558ALS"
	help
	  Say Y here for LITEON LTR-659PS or LTR-558ALS
	  ALS/proximity sensor driver support.

	  The driver uses the NVS (NVidia Sensor) IIO, light and
	  proximity framework.

config NVS_MAX4400X
	tristate "Maxim MAX4400X ALS/Proximity"
	depends on I2C && IIO_BUFFER && IIO_TRIGGERED_BUFFER && NVS_IIO && NVS_LIGHT && NVS_PROXIMITY
	help
	  Say Y here for Maxim MAX44005 and MAX44006/MAX44008
	  Ambient Light Sensor (ALS) support.
	  Proximity is supported on the MAX44005.

	  The driver uses the NVS (NVidia Sensor) IIO, light and
	  proximity framework.

config NVS_VEML6030
	tristate "Vishay VEML6030 ALS"
	depends on I2C && IIO_BUFFER && IIO_TRIGGERED_BUFFER && NVS_IIO && NVS_LIGHT
	help
	  Say Y here for Vishay Semiconductors VEML6030
	  Ambient Light Sensor (ALS) driver support.

	  The driver uses the NVS (NVidia Sensor) IIO, light framework.

endmenu
```

## nvidia/drivers/iio/magnetometer/Kconfig
```kconfig
append_menu "Magnetometer sensors"

#
# Magnetometer sensors
#
# When adding new entries keep the list in alphabetical order


config NVI_AK89XX
	tristate "Asahi Kasei AK89XX 3-Axis Magnetometer"
	depends on I2C && IIO_BUFFER && IIO_TRIGGERED_BUFFER && NVS_IIO
	help
	  Say yes here to build support for Asahi Kasei AK89XX 3-Axis
	  Magnetometer that can be connected via Invensense MPU.

	  To compile this driver as a module, choose M here: the module
	  will be called nvi-ak89xx.

endmenu
```

## nvidia/drivers/iio/pressure/Kconfig
```kconfig
append_menu "Pressure sensors"

#
# Pressure drivers
#
# When adding new entries keep the list in alphabetical order

config NVI_BMPX80
	tristate "Bosch Digital pressure sensor"
	depends on I2C && IIO_BUFFER && IIO_TRIGGERED_BUFFER && NVS_IIO
	help
	  Say yes here to build support for Bosch pressure sensor
	  that can be connected via Invensense MPU.

	  To compile this driver as a module, choose M here: the module
	  will be called nvi-bmpX80.

endmenu
```

## nvidia/drivers/iio/temperature/Kconfig
```kconfig
append_menu "Temperature sensors"
config NVS_TMP1X2_IIO
	tristate "TI temperature sensor using IIO transport"
	depends on I2C && SYSFS && IIO
	select NVS
	select NVS_ON_CHANGE
	select NVS_IIO
	default n
	help
	  Enable TI temperature sensor

config NVS_TMP1X2_INPUT
	tristate "TI temperature sensor using INPUT transport"
	depends on I2C && SYSFS && INPUT
	select NVS
	select NVS_ON_CHANGE
	select NVS_INPUT
	default n
	help
	  Enable TI temperature sensor

config NVS_TMP1X2_RELAY
	tristate "TI temperature sensor using RELAYFS transport"
	depends on I2C && SYSFS
	select NVS
	select NVS_ON_CHANGE
	select NVS_RELAY
	default n
	help
	  Enable TI temperature sensor
endmenu
```

## nvidia/drivers/input/keyboard/Kconfig
```kconfig
if INPUT_KEYBOARD

config KEYBOARD_TIMED_GPIO
	tristate "Timed GPIO Buttons"
	depends on GPIOLIB
	help
	  This driver implements support for buttons connected
	  to GPIO pins of various CPUs (and some other chips).
	  Key presses are timed and can send different key codes
	  depending on time it was pressed.

	  Say Y here if your device has buttons connected
	  directly to such GPIO pins.  Your board-specific
	  setup logic must also provide a platform device,
	  with configuration data saying which GPIOs are used.

	  To compile this driver as a module, choose M here: the
	  module will be called gpio_timed_keys.

endif
```

## nvidia/drivers/input/touchscreen/Kconfig
```kconfig
if INPUT_TOUCHSCREEN

config TOUCHSCREEN_NVIDIA_ATMEL_MXT
        tristate "NVIDIA Atmel mXT I2C Touchscreen"
        depends on I2C
        select FW_LOADER
        help
          Say Y here if you have Atmel mXT series I2C touchscreen,
          such as AT42QT602240/ATMXT224, connected to your system.

          If unsure, say N.

          To compile this driver as a module, choose M here: the
          module will be called atmel_mxt_ts.

          It is Nvidia Atmel driver which is impoved based on
          atmel k3.14 driver.

config TOUCHSCREEN_LR388K7
	tristate "Sharp LR388K7 touchscreen"
	depends on SPI_MASTER
	help
	  Say Y here if you have a LR388K7 and want to enable
	  support for the built-in touchscreen.

	  If unsure, say N.

	  To compile this driver as a module, choose M here: the
	  module will be called lr388k7.

config TOUCHSCREEN_RM31080A
	tristate "RAYDIUM_31080A based touchscreens"
	depends on SPI_MASTER
	help
	  Say Y here if you have a touchscreen interface using the
	  RAYDIUM_T31080A controller, and your board-specific initialization
	  code includes that in its table of SPI devices.

	  If unsure, say N (but it's safe to say "Y").

	  To compile this driver as a module, choose M here: the
	  module will be called RAYDIUM_31080A.

config TOUCHSCREEN_EXC80
	tristate "EGALAX_EXC80 based touchscreens"
	depends on I2C
	help
	  Say Y here if you have a touchscreen interface using the
	  EGALAX controller, and your board-specific initialization
	  code includes that in its table of I2C devices.

	  If unsure, say N (but it's safe to say "Y").

	  To compile this driver as a module, choose M here: the
	  module will be called EGALAX.

config TOUCHSCREEN_EXC80_USB
	tristate "EGALAX_EXC80 USB based touchscreens"
	help
	  Say Y here if you have a touchscreen interface using the
	  EGALAX controller, and your board-specific initialization
	  code includes that in its table.

	  If unsure, say N (but it's safe to say "Y").

	  To compile this driver as a module, choose M here: the
	  module will be called egalax_ts_usb.

endif
```

## nvidia/drivers/iommu/Kconfig
```kconfig
config TEGRA_ARM_SMMU_T19x
	bool "TEGRA ARM SMMU for T19x"
	depends on ARM_SMMU
	default n
	help
	  Support for implementations of the ARM System MMU architecture
	  versions 1 and 2 for T19x based architectures.

	  Say Y here if your SoC includes an IOMMU device implementing
	  the ARM SMMU architecture for T19x based architectures.

config ARM_SMMU_SUSPEND
	bool "ARM SMMU SUSPEND"
	depends on ARM_SMMU
	default n
	help
	  Support for ARM System MMU suspend where all the required SMMU
	  registers will be saved to memory and upon resume warmboot/bootloader
	  will restore SMMU registers from memory.
```

## nvidia/drivers/media/i2c/Kconfig
```kconfig
if VIDEO_V4L2

menu "NVIDIA overlay Encoders, decoders, sensors and other helper chips"
	visible if !MEDIA_SUBDRV_AUTOSELECT || COMPILE_TEST

config VIDEO_IMX185
	tristate "IMX185 camera sensor support"
	depends on I2C && VIDEO_V4L2 && VIDEO_V4L2_SUBDEV_API
	---help---
	This is a Video4Linux2 sensor-level driver for the Sony
	IMX185 camera sensor

	To compile this driver as a module, choose M here: the module
	will be called imx185.

config VIDEO_IMX477
        tristate "IMX477 camera sensor support"
	depends on I2C && VIDEO_V4L2 && VIDEO_V4L2_SUBDEV_API
	---help---
	  This driver supports IMX477 camera sensor from Sony

	  To compile this driver as a module, choose M here: the module
	  will be called imx477.

config VIDEO_IMX219
        tristate "IMX219 camera sensor support"
	depends on I2C && VIDEO_V4L2 && VIDEO_V4L2_SUBDEV_API
	---help---
	  This driver supports IMX219 camera sensor from Sony

	  To compile this driver as a module, choose M here: the module
	  will be called imx219.

config VIDEO_IMX268
	tristate "IMX268 camera sensor support"
	depends on I2C && VIDEO_V4L2 && VIDEO_V4L2_SUBDEV_API
	---help---
	  This is a Video4Linux2 sensor-level driver for the Sony
	  IMX268 camera sensor

	  To compile this driver as a module, choose M here: the module
	  will be called imx268.

config VIDEO_IMX274
	tristate "IMX274 camera sensor support"
	depends on I2C && VIDEO_V4L2 && VIDEO_V4L2_SUBDEV_API
	---help---
	  This is a Video4Linux2 sensor-level driver for the Sony
	  IMX274 camera sensor

	  To compile this driver as a module, choose M here: the module
	  will be called imx274.

config VIDEO_IMX318
	tristate "IMX318 camera sensor support"
	depends on I2C && VIDEO_V4L2 && VIDEO_V4L2_SUBDEV_API
	---help---
	  This is a Video4Linux2 sensor-level driver for the Sony
	  IMX318 camera sensor

	  To compile this driver as a module, choose M here: the module
	  will be called imx318.

config VIDEO_LC898212
	tristate "LC898212 focuser support"
	depends on I2C && VIDEO_V4L2 && VIDEO_V4L2_SUBDEV_API
	---help---
	  This driver supports LC898212 camera focuser

	  To compile this driver as a module, choose M here: the module
	  will be called lc898212.

config VIDEO_OV5693
	tristate "OV5693 camera sensor support"
	depends on I2C && VIDEO_V4L2 && VIDEO_V4L2_SUBDEV_API
	---help---
	  This is a Video4Linux2 sensor-level driver for the OmniVision
	  OV5693 camera.

	  To compile this driver as a module, choose M here: the module
	  will be called ov5693.

config VIDEO_OV9281
	tristate "OmniVision OV9281 camera sensor support"
	depends on I2C && VIDEO_V4L2 && VIDEO_V4L2_SUBDEV_API
	---help---
	  This is a Video4Linux2 sensor driver for the OmniVision
	  OV9281 camera sensor, for use with the tegra isp.

	  To compile this driver as a module, choose M here: the module
	  will be called ov9281.

config VIDEO_OV10823
	tristate "OmniVision OV10823 camera sensor support"
	depends on I2C && VIDEO_V4L2 && VIDEO_V4L2_SUBDEV_API
	---help---
	  This is a Video4Linux2 sensor driver for the OmniVision
	  OV10823 camera sensor, for use with the tegra isp.

	  To compile this driver as a module, choose M here: the module
	  will be called ov10823.

config VIDEO_OV23850
	tristate "OmniVision OV23850 sensor support"
	depends on I2C && VIDEO_V4L2 && VIDEO_V4L2_SUBDEV_API
	---help---
	  This driver supports OmniVision OV23850 camera sensor

	  To compile this driver as a module, choose M here: the module
	  will be called ov23850.

config I2C_IOEXPANDER_PCA9570
	tristate "nxp PCA9570 I2C IO Expander"
	help
	  If you say yes here you get support for the nxp PCA9570
	  I2C IO Expander devices.

	  To compile this driver as a module, choose M here: the module
	  will be called pca9570.

config VIDEO_TC358840
	tristate "Toshiba TC358840 decoder"
	depends on VIDEO_V4L2 && I2C && VIDEO_V4L2_SUBDEV_API
	select HDMI
	---help---
	  Support for the Toshiba TC358840 HDMI to MIPI CSI-2 bridge.

	  To compile this driver as a module, choose M here: the
	  module will be called tc358840.

config VIDEO_LT6911UXC
        tristate "Lontium LTX6911UXC HDMI to CSI bridge"
	depends on VIDEO_V4L2 && VIDEO_V4L2_SUBDEV_API
	---help---
	  This driver supports LT6911UXC bridge from Lontium

	  To compile this driver as a module, choose M here: the module
	  will be called lt6911uxc.

config I2C_IOEXPANDER_SER_MAX9295
	tristate "MAX9295 Serializer I2C IO Expander"
	help
	  If you say yes here you get support for the MAX9295 serializer
	  I2C IO Expander.

	  To compile this driver as a module, choose M here: the module
	  will be called max9295.

config I2C_IOEXPANDER_DESER_MAX9296
	tristate "MAX9296 Deserializer I2C IO Expander"
	help
	  If you say yes here you get support for the MAX9296 deserializer
	  I2C IO Expander.

	  To compile this driver as a module, choose M here: the module
	  will be called max9296.

config VIDEO_IMX390
	tristate "IMX390 camera sensor support"
	depends on I2C && VIDEO_V4L2 && VIDEO_V4L2_SUBDEV_API && I2C_IOEXPANDER_SER_MAX9295 && I2C_IOEXPANDER_DESER_MAX9296
	---help---
	  This is a Video4Linux2 sensor-level driver for the Sony
	  IMX390 camera sensor

	  To compile this driver as a module, choose M here: the module
	  will be called imx390.

endmenu

endif
```

## nvidia/drivers/media/platform/Kconfig
```kconfig
menu "NVIDIA overlay V4L platform devices"
source "drivers/media/platform/tegra/Kconfig"
if V4L_TEST_DRIVERS
source "drivers/media/platform/tegra-vivid/Kconfig"
endif #V4L_TEST_DRIVERS
endmenu
```
