## nvidia/drivers/platform/tegra/Kconfig
```kconfig
config DENVER_CPU
	bool "Denver CPU"
	help
	  Support for NVIDIA Denver CPU

config DENVER_MCA
	tristate "Denver Machine Check Handler"
	depends on DENVER_CPU
	select SERROR_HANDLER
	help
	  The Denver Machine Check handler. It collects and reports errors from
	  the Denver CPUs.

config TEGRA_AON
	bool "Tegra AON driver"
	depends on ARCH_TEGRA_18x_SOC
	select NV_TEGRA_IVC
	select TEGRA_HSP

config TEGRA_ARI_MCA
	tristate "Tegra Abstract Request Interface (ARI) Machine Check"
	select SERROR_HANDLER
	help
	  The Tegra Abstract Request Interface (ARI) Machine Check handler. This
	  handles the Machine Check registers that are accessible via ARI.

config TEGRA_BRIDGE_MCA
	tristate "AXI/APB Bridge Machine Check"
	select SERROR_HANDLER
	help
	  The Tegra AXI/APB Bridge Machine Check handler. This
	  handes the SERRs from failed AXI/APB transactions.

config TEGRA_A57_SERR
        tristate "A57 SError Handler"
	select SERROR_HANDLER
	help
	  The A57 SError Handler.  This handles the SERRs from A57 cores,
	  specifically L1 ECC errors.

config TEGRA_18X_SERROR
        tristate "Tegra18 SError handler"
        depends on ARCH_TEGRA_18x_SOC
        select DENVER_MCA
	select TEGRA_ARI_MCA
	select TEGRA_BRIDGE_MCA
	select TEGRA_A57_SERR
        help
          The Tegra18 SError handler. This handles Denver SErrors, A57 SErrors,
	  CCPLEX errors, and fabric slave errors.

config TEGRA_BWMGR
        bool "Enable EMC Bandwidth Manager"
        depends on COMMON_CLK
        default n
        help
          Enables Bandwidth manager support for EMC clock. Required when using Common Clock Framework

config TEGRA_CAMERA_RTCPU
	bool "Enable Tegra Camera RTCPU Driver"
	depends on ARCH_TEGRA_18x_SOC
	select NV_TEGRA_IVC
	select TEGRA_HSP

config TEGRA_ISOMGR
        bool "Isochronous Bandwidth Manager "
        help
          When enabled, drivers for ISO units can obtain ISO BW.
          The memory controller (MC) for each Tegra platform can supply
          a limited amount of isochronous (real-time) bandwidth.  When
          enabled, isomgr will manage a pool of ISO BW.

config TEGRA_ISOMGR_POOL_KB_PER_SEC
        int "Size of isomgr pool "
        default 0
        help
          Set this maximum ISO BW (in Kbytes/sec) that platform supports.
          The memory controller (MC) for each Tegra platform can supply
          a limited amount of isochronous (real-time) bandwidth.  Each
          platform must specify the maximum amount of ISO BW that isomgr
          should manage.

config TEGRA_ISOMGR_SYSFS
        bool "Visibility into Isochronous Bandwidth Manager state "
        depends on TEGRA_ISOMGR
        help
          When enabled, sysfs can be used to query isomgr state.
          This is used for visibility into isomgr state.  It could
          be useful in debug or in understanding performance on a
          running system.

config TEGRA_ISOMGR_MAX_ISO_BW_QUIRK
        bool "Relax Max ISO Bw limit"
        depends on TEGRA_ISOMGR
        default n
        help
          When enabled, allows system with less ISO bw continue to
          work. This is necessary for systems running at lower
          EMC clock freq or on FPGA.

config TEGRA_MC
        bool "Tegra MC"
        default y
        help
          Enable Tegra MC.

config TEGRA_MC_TRACE_PRINTK
	bool "Enable trace_printk debugging for MC"
	depends on FTRACE_PRINTK

config TEGRA_OF_MCERR
        bool "Tegra MCERR OF"
        default y
        help
          Enable Tegra MC ERR OF.

config TEGRA_PM_IRQ
	bool "Enable PM IRQ"
	default y if ARCH_TEGRA_18x_SOC || ARCH_TEGRA_19x_SOC

config TEGRA_PMC_AO_WAKE
	bool "Enable AO WAKE from PMC"
	default y if ARCH_TEGRA_18x_SOC || ARCH_TEGRA_19x_SOC

config TEGRA_WAKEUP
	bool "Enable WAKEUP"
	default y if ARCH_TEGRA_18x_SOC || ARCH_TEGRA_19x_SOC

config TEGRA_PTP_NOTIFIER
	tristate "Enable PTP Notifier"
	depends on ARCH_TEGRA_18x_SOC
	default y if EQOS

config TEGRA_SAFETY_SCE
	tristate "Enable CCPLEX-SCE communication Driver for Safety"
	depends on ARCH_TEGRA_18x_SOC
	select NV_TEGRA_IVC
	select TEGRA_HSP
	help
	  This enables communication between CCPLEX and SCE over IVC channel.
	  This also provides a userspace command response interface as
	  character device which will be used by other safety modules.

config TEGRA_19X_RAS
	tristate "Tegra19 RAS Handler"
	depends on ARCH_TEGRA_19x_SOC && RAS && ARM64_RAS
	default y
	select SERROR_HANDLER
	help
	  This driver adds RAS handlers for Carmel Correctable Errors,
	  Uncorrectable Errors per core, per core cluster and per CCPLEX

config TEGRA_CBB_NOC
	tristate "Tegar19x CBB NOC Bridge Error handler"
	depends on ARCH_TEGRA_19x_SOC
	default y
	select SERROR_HANDLER
	help
	  The Tegra Control Backbone(CBB)/Network-on-chip(NOC) error handler.
	  This drivers handles SError from bridges due to failed transactions.

config POWERGATE_TEGRA_BPMP
        def_bool NV_TEGRA_BPMP

config TEGRA_HV_XHCI_DEBUG
	bool "Enable Tegra Hypervisor XHCI Server Debug"
	depends on TEGRA_HV_MANAGER
	default n
	help
	  Enable Tegra XHCI Server debugging when runs in virtualization.

config TEGRA_HSP
	bool "Enable Tegra Hardware Synchronization Primitives driver"
	default y

config TEGRA_NVDUMPER
	bool "Enable nvdumper"
	depends on ARCH_TEGRA
	default n
	help
	  This is debug feature to dump whole memory when system crashes.

config TEGRA_CENTRAL_ACTMON
	bool "Tegra Activity Monitor"
	depends on ARCH_TEGRA
	default n
	help
	  Actmon is a hardware block that can be used to track the activity of
	  certain hardware units. It can boost EMC clock depending
	  on the memory trafic among various client. It is called central actmon
	  as it monitors central activity for example MC activity. HW fabric of
	  central and unit actmon is different. If unsure, say Y here.

config TEGRA_FIRMWARES_CLASS
	bool
	default n

config TEGRA_FIRMWARES_INVENTORY
	tristate "Tegra firmwares inventory"
	select TEGRA_FIRMWARES_CLASS
	default y
	help
	  Register version readers for firmwares

config TEGRA_FIQ_DEBUGGER
	bool "Enable the FIQ serial debugger on Tegra"
	default n
	select FIQ_DEBUGGER
	select FIQ_GLUE
	help
	  Enables the FIQ serial debugger on Tegra

config TEGRA_BOOTLOADER_DEBUG
	tristate "Creates sys-fs interface dumping registers read by bootloader"
	default n
	select TEGRA_BOOTLOADER_DEBUG_INIT
	help
	  When enabled, tegra_bootloader_verify_regs sys-fs is created.

config TEGRA_BOOTLOADER_DEBUG_INIT
	bool
	depends on TEGRA_BOOTLOADER_DEBUG

config TEGRA_BOOTLOADER_BOOT_CFG
	tristate "Creates sysfs interface for BCP data"
	depends on TEGRA_BOOTLOADER_DEBUG_INIT
	default n
	help
	  When enabled, boot_cfg sys-fs is created.

config NV_TEGRA_IVC
	bool "Tegra IVC protocol support (Downstream version)"
	default n
	help
	  Enable the Tegra IVC library, which implements a lockless, shared-
	  memory queue.

config TEGRA_CPU_TOPOLOGY_DEBUGFS
	bool "Tegra CPU topology in debugfs"
	depends on ARCH_TEGRA_18x_SOC
	default n
	help
	  When enabled, make symbolic links to cpux (sysfs nodes) inside directories
	  in debugfs, build as per cpu type available for classifiying the cpus.

config TEGRA_CPU_TOPOLOGY_SYSFS
	tristate "Tegra CPU topology in sysfs"
	depends on ARCH_TEGRA_18x_SOC
	default m
	help
	  When enabled, make symbolic links to cpux (sysfs nodes) inside directories
	  in sysfs, build as per cpu type available for classifiying the cpus.

config TEGRA_CLOCKS_CONFIGURE
	bool "Configure initial state of clocks"
	default y if ARCH_TEGRA_18x_SOC || ARCH_TEGRA_19x_SOC
	help
	  Enable or disable clocks during kernel initialization.
	  This helps in optimizing power by disabling some always on clocks.

source "drivers/platform/tegra/nvadsp/Kconfig"
```

## nvidia/drivers/platform/tegra/nvadsp/Kconfig
```kconfig
config TEGRA_NVADSP
	tristate "Enable Host ADSP driver"
	default n
	select ARM_GIC_PM
	select FIQ
	help
	  Enables support for Host ADSP driver.

	  If unsure, say N

config TEGRA_NVADSP_ON_SMMU
	bool "Use SMMU to relocate ADSP"
	depends on (TEGRA_IOMMU_SMMU || OF_TEGRA_IOMMU_SMMU) && TEGRA_NVADSP
	default n
	help
	  Use SMMU to relocate ADSP OS.

config TEGRA_ADSP_DFS
	bool "Enable ADSP DFS"
	depends on TEGRA_NVADSP
	default n
	help
	  Enable ADSP dynamic frequency scaling. Use this config
	  to scale adsp frequency via actmon or set fixed value.

	  If unsure, say N

config TEGRA_ADSP_ACTMON
	bool "Enable ADSP ACTMON"
	depends on TEGRA_ADSP_DFS
	default n
	help
	  Enable ADSP actmon. It converts adsp activty to frequency and
	  asks adsp dfs to set the adsp frequency. Use it if adsp frequency
	  to be scaled dynamically by actmon.

	  If unsure, say N

config TEGRA_ADSP_CPUSTAT
	bool "Enable ADSP CPUSTAT"
	depends on DEBUG_FS && TEGRA_NVADSP && !TEGRA_ADSP_ACTMON
	default n
	help
	  Enable ADSP cpu usage measurement using actmon

	  If unsure, say N

config TEGRA_ADSP_FILEIO
	bool "Enable ADSP file io"
	depends on TEGRA_NVADSP
	default n
	help
	  Enable dumping to and reading from file on host from ADSP

	  If unsure, say N

config TEGRA_ADSP_LPTHREAD
	bool "Enable ADSP usage calc by lpthread"
	depends on DEBUG_FS && TEGRA_NVADSP
	default n
	help
	  Enable calculation of ADSP usage by running a low priority
	  thread in background whenever OS is not suspended. Can be
	  enable or disabled by echo to adsp_usage file.

	  If unsure, say N

config TEGRA_EMC_APE_DFS
	bool "Enable emc dfs due to APE"
	depends on TEGRA_NVADSP
	default n
	help
	  Enable emc dfs due to APE DRAM access

	  If unsure, say N

config TEGRA_ADSP_CONSOLE
	bool "Enable ADSP console"
	depends on TEGRA_NVADSP
	default y
	help
	  Enable ADSP console access

	  If unsure, say N

config MBOX_ACK_HANDLER
	bool "Enable mailbox acknowledge handler"
	depends on TEGRA_NVADSP
	default n
	help
	  Enable mailbox acknowledge handler

	  if unsure, say N
```

## nvidia/drivers/regulator/Kconfig
```kconfig
if REGULATOR

config REGULATOR_PMIC_OTP
	bool "Provide a regulator with PMIC OTP without PMIC registration"
	help
	  This driver able to provide all regulator interface to client
	  without any actual implementation. This should be used if it
	  is required to use the PMCI OTP configuration and do not want
	  to register PMIC.

endif
```

## nvidia/drivers/spi/Kconfig
```kconfig
if SPI
if SPI_MASTER

config SPI_TEGRA186_AON
	bool "Tegra18x AON SPI proxy driver"
	depends on ARCH_TEGRA_18x_SOC
	default y
	select NV_TEGRA_IVC
	select TEGRA_HSP

endif

config SPI_AURIX_TEGRA
	tristate "Nvidia Aurix-Tegra SPI Protocol Driver"
	depends on SPI_TEGRA124_SLAVE && TEGRA_HV_PM_CTL
	default n
	help
	 SPI protocol driver for communication between Aurix and Tegra

endif
```

## nvidia/drivers/staging/Kconfig
```kconfig
if STAGING

source "drivers/staging/ozwpan/Kconfig"
source "drivers/staging/platform/tegra/gte/Kconfig"
source "drivers/staging/platform/tegra/gte_test/Kconfig"
source "drivers/staging/platform/tegra/dummy_carveout/Kconfig"

endif # STAGING
```

## nvidia/drivers/staging/platform/tegra/dummy_carveout/Kconfig
```kconfig
config	DUMMY_MEMORY_CARVEOUT
	bool "Memory reservation specific to driver"
	help
	  Enable this option to integrate dummy driver to reserve memory
	  carveout specific to driver.It is a an example to reserve memory
	  carvout that will help to allocate buffers/block from carveout.
```

## nvidia/drivers/staging/platform/tegra/gte/Kconfig
```kconfig
config TEGRA_HTS_GTE
	bool "Generic hardware Timestamping Engine"
	depends on ARCH_TEGRA_19x_SOC && !NVPPS
	help
	  Enable this option for integrated generic timestamping support on
	  NVIDIA Tegra systems-on-chip. The driver supports LIC IRQs and AON
	  GPIO monitoring for hardware timestamping.
```

## nvidia/drivers/staging/platform/tegra/gte_test/Kconfig
```kconfig
config TEGRA_GTE_TEST
	tristate "Tegra Generic Timestamping Engine Test"
	depends on TEGRA_HTS_GTE
	help
	  Enable this option for integrated generic timestamping support on
	  NVIDIA Tegra systems-on-chip. The driver supports LIC IRQs and AON
	  GPIO monitoring for hardware timestamping.
```

## nvidia/drivers/thermal/tegra/Kconfig
```kconfig
append_menu "NVIDIA Tegra thermal drivers"

config TEGRA_AOTAG
	bool "Tegra Always-On-Thermal-Alert-Generator"
	help
	  Support for Tegra Always-On thermal Alert Generator

config TEGRA_TJ_THERMAL
	bool "Tegra Tj temperature"
	default y
	help
	  Enable this option to read the temperature of hottest spot on Tegra
	  SoC. The driver can be configured (via device-tree) to account for
	  multiple thermal zones and the corresponding configurable hotspot
	  offsets, and, report the maximum temperature from the same, hence,
	  representing the hottest point on the chip.

config TEGRA_CORE_CAPS
	tristate "Tegra core DVFS thermal limits"
	depends on TEGRA_DVFS
	help
	  This config enables a cooling device that enforces VF limits on the
	  core voltage rail.

config TEGRA_DFLL_CAPS
	tristate "Tegra DFLL DVFS thermal limits"
	depends on TEGRA_DVFS
	help
	  This config enables a cooling device that enforces VF limits on the
	  cpu DFLL clock.

endmenu
```

## nvidia/drivers/tty/serial/Kconfig
```kconfig
if TTY

config TEGRA_COMBINED_UART
	bool "Tegra combined UART"
	depends on ARCH_TEGRA_18x_SOC
	default n
	help
	  Tegra combined UART is a client-server model which allows a server
	  running on SPE to multiplex a single UART controller amongst multiple
	  UART clients.

	  This config enables the Linux client driver. Instead of
	  directly bit banging the UART controller, the client driver
	  communicates with the SPE server using mailbox registers. The SPE
	  server multiplexes the UART controller amongst the various clients.
	  This allows all the clients to send output and receive input through a
	  single UART controller.

	  Combined-uart uses 'ctrl /' as break-signal for SysRq, for example:
	  'ctrl / + h' for sysrq-help.

config TEGRA_HV_COMM
	tristate "Tegra Hypervisor Communication"
	depends on TEGRA_HV_MANAGER
	help
	  Add support for emulating a TTY device over the Tegra Hypervisor interface.

	  To compile this driver as a module, choose M here: the
	  module will be called tegra_hv_comm.

endif
```

## nvidia/drivers/video/tegra/host/Kconfig
```kconfig
if ARCH_TEGRA

config TEGRA_T19X_GRHOST
	tristate "Tegra 19x graphics host driver"
	depends on TEGRA_GRHOST && ARCH_TEGRA_19x_SOC
	default y
	help
	  Driver for the Tegra graphics host hardware.

config TEGRA_GRHOST_NVDLA
	bool "Tegra NVDLA support"
	depends on TEGRA_GRHOST && ARCH_TEGRA_19x_SOC
	default y
	help
	  Enables Deep Learning Accelerator engine support under nvhost
	  Say N here if not sure.

config TEGRA_GRHOST_PVA
	bool "Tegra PVA support"
	depends on TEGRA_GRHOST && ARCH_TEGRA_19x_SOC
	default y
	help
	  Enables Programmable Vision Accelerator engine support under nvhost
	  Say Y here if not sure.

config TEGRA_GRHOST_SLVSEC
	bool "Tegra SLVS-EC support"
	depends on TEGRA_GRHOST && ARCH_TEGRA_19x_SOC
	default y
	help
	  Enables SLVS-EC Camera interface support under nvhost
	  Say Y here if not sure.

config TEGRA_GRHOST_CAPTURE_SUPPORT
	bool "Tegra camera capture support module"
	depends on TEGRA_T19X_GRHOST && VIDEO_TEGRA_VI && TEGRA_GRHOST_ISP
	default y
	help
	  Enables support module for camera capture using VI and ISP
	  Say Y here if not sure.

config TEGRA_NVDLA_TRACE_PRINTK
	bool "Enable trace_printk debugging in NVDLA driver"
	depends on FTRACE_PRINTK && TEGRA_GRHOST_NVDLA

endif
```
