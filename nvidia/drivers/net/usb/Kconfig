## nvidia/drivers/net/usb/Kconfig
```kconfig
if USB_NET_DRIVERS

config USB_RTL8152_SHIELD
        tristate "Realtek RTL8152/RTL8153 Based USB Ethernet Adapters For Shield"
        select MII
        help
          This option adds support for Realtek RTL8152 based USB 2.0
          10/100 Ethernet adapters and RTL8153 based USB 3.0 10/100/1000
          Ethernet adapters.

          To compile this driver as a module, choose M here: the
          module will be called r8152.

endif # USB_NET_DRIVERS
```

## nvidia/drivers/net/wireless/Kconfig
```kconfig
source "drivers/net/wireless/bcmdhd/Kconfig"
source "drivers/net/wireless/bcmdhd_pcie/Kconfig"
source "drivers/net/wireless/realtek/rtl8812au/Kconfig"
source "drivers/net/wireless/realtek/rtl8814au/Kconfig"
source "drivers/net/wireless/realtek/rtl8821au/Kconfig"
source "drivers/net/wireless/realtek/rtl8821cu/Kconfig"
source "drivers/net/wireless/realtek/rtl8822bu/Kconfig"
source "drivers/net/wireless/realtek/rtl8822ce/Kconfig"
```

## nvidia/drivers/net/wireless/bcmdhd/Kconfig
```kconfig
config BCMDHD
	tristate "Broadcom FullMAC wireless cards support"
	---help---
	  This module adds support for wireless adapters based on
	  Broadcom FullMAC chipset.

	  If you choose to build a module, it'll be called dhd. Say M if
	  unsure.

config BCMDHD_SDIO
	bool "SDIO bus interface support"
	depends on BCMDHD && MMC

config BCMDHD_PCIE
	bool "PCIe bus interface support"
	depends on BCMDHD && PCI

config BCMDYNAMIC
	bool "Broadcom 43241/4352 wireless card support"
	depends on BCMDHD

config BCM43241
	bool "Broadcom 43241 wireless card support"
	depends on BCMDHD && !BCMDYNAMIC

config BCM4354
	bool "Broadcom 4354 wireless cards PRC support"
	depends on BCMDHD && !BCM43241 && !BCMDYNAMIC
	---help---
	  This module adds support for wireless adapters based on
	  Broadcom 4354 chipset.

config BCM4339
	bool "Broadcom 4339 wireless cards PRC support"
	depends on BCMDHD && !BCM43241 && !BCM4354 && !BCMDYNAMIC
	---help---
	  This module adds support for wireless adapters based on
	  Broadcom 4339 chipset.

config BCMDHD_FW_PATH
	depends on BCMDHD
	string "Firmware path"
	default "/system/vendor/firmware/fw_bcmdhd.bin"
	---help---
	  Path to the firmware file.

config BCMDHD_NVRAM_PATH
	depends on BCMDHD
	string "NVRAM path"
	default "/system/etc/wifi/bcmdhd.cal"
	---help---
	  Path to the calibration file.

config BCMDHD_HW_OOB
	bool "Use out of band interrupt"
	depends on BCMDHD
	---help---
	  Use out of band interrupt for card interrupt and wake on wireless.

config DHD_USE_STATIC_BUF
	bool "Enable memory preallocation"
	depends on BCMDHD
	default n
	---help---
	  Use memory preallocated in platform

config DHD_USE_SCHED_SCAN
	bool "Use CFG80211 sched scan"
	depends on BCMDHD && CFG80211
	default n
	---help---
	  Use CFG80211 sched scan

config BCMDHD_DISABLE_MCC
	bool "Disable Multi channel concurrency"
	depends on BCMDHD
	---help---
	  Disable Multi channel concurrency to operate WLAN and P2P interfaces on same channel.

config BCMDHD_CUSTOM_SYSFS_TEGRA
	bool "Custom sysfs for Tegra platform"
	depends on BCMDHD
	default n
	---help---
	  Enable custom sysfs for Tegra platform.

config BCMDHD_CUSTOM_NET_PERF_TEGRA
	bool "Custom network performance boost for Tegra platform"
	depends on BCMDHD
	---help---
	  Enable custom network performance boost for Tegra platform.
	  Dynamically boosts clock frequencies based on network traffic
	  requirements.

config BCMDHD_QMONITOR
	bool "Monitoring the DHD queue utilization"
	depends on BCMDHD
	---help---
	  The feature allows monitoring the DHD queue utilization
	  to get the percentage of a time period where the number of
	  pending packets is above a configurable theshold.
	  Based on IOVAR "qtime_percent" results, the server indicates
	  to the Video Encoder if its bitrate can be increased or
	  must be decreased. Currently, this works only with P2P interfaces
	  and with PROP_TXSTATUS.

config BCMDHD_CUSTOM_NET_BW_EST_TEGRA
	bool "Custom network bandwidth estimator for Tegra platform"
	depends on BCMDHD
	---help---
	  Enable custom network bandwidth estimator for Tegra platform.

config BCMDHD_CUSTOM_NET_DIAG_TEGRA
	bool "Custom network diagnostics for Tegra platform"
	depends on BCMDHD
	---help---
	  Enable custom network diagnostics for Tegra platform.
```

## nvidia/drivers/net/wireless/realtek/rtl8812au/Kconfig
```kconfig
config RTL8812AU
	tristate "Realtek 8812A USB WiFi"
	depends on USB
	default n
	---help---
	  This module adds support for USB wifi dongles based on Realtek
	  RTL8812AU wireless chipset

	  This driver module will be called rtl8812au.
	  Use m if unsure.
```

## nvidia/drivers/net/wireless/realtek/rtl8814au/Kconfig
```kconfig
config RTL8814AU
	tristate "Realtek 8814A USB WiFi"
	depends on USB
	default n
	---help---
	  This module adds support for USB wifi dongles based on Realtek
	  RTL8814AU wireless chipset

	  This driver module will be called rtl8814au.
	  Use m if unsure.
```

## nvidia/drivers/net/wireless/realtek/rtl8821au/Kconfig
```kconfig
config RTL8821AU
	tristate "Realtek 8821A USB WiFi"
	depends on USB
	default n
	---help---
	  This module adds support for USB wifi dongles based on Realtek
	  RTL8821AU wireless chipset.

	  This driver module will be called rtl8821au
	  Use m if unsure.
```

## nvidia/drivers/net/wireless/realtek/rtl8821cu/Kconfig
```kconfig
config RTL8821CU
	tristate "Realtek 8821C USB WiFi"
	depends on USB
        default n
	---help---
	  This module adds support for USB wifi dongles based on Realtek
	  RTL8821CU wireless chipset.

	  This driver module will be called rtl8821cu
	  Use m if unsure.
```

## nvidia/drivers/net/wireless/realtek/rtl8822bu/Kconfig
```kconfig
config RTL8822BU
	tristate "Realtek 8822B USB WiFi"
	depends on USB
	default n
	---help---
	 This module adds support for USB wifi dongles based on Realtek
	 RTL8822BU wireless chipset

	 This driver module will be called rtl8822bu
	 Use m if unsure.
```

## nvidia/drivers/net/wireless/realtek/rtl8822ce/Kconfig
```kconfig
config RTL8822CE
	tristate "Realtek 8822C PCIE WiFi"
	depends on PCI
	default n
	---help---
	  This module adds support for RTL8822CE chipset

	  This driver module will be called rtl8822ce
	  Use m if unsure
```

## nvidia/drivers/nvlink/Kconfig
```kconfig
config TEGRA_NVLINK
	bool "Tegra NVLINK Support"
	depends on ARCH_TEGRA_19x_SOC
	default y
	help
	  This config enables the Tegra NVLINK driver stack. NVLINK is a high
	  speed serial communication protocol and an interconnect developed by
	  NVIDIA. NVLINK provides higher bandwidth and lower latency in
	  comparison to PCIe.

	  NVLINK can be used to connect the Tegra SOC to various external
	  devices. High speed memory accesses can be made over NVLINK between
	  Tegra and the external device.
```

## nvidia/drivers/pci/dwc/Kconfig
```kconfig
config PCIE_TEGRA
	tristate "Nvidia Tegra PCIe host controller (T19x)"
	depends on PCI
	depends on ARCH_TEGRA
	help
	 Enables support for the PCIe controller in the Tegra (19x) SoC.
	 This controller can work either as EP or RC. In order to enable
	 host-specific features PCIE_TEGRA_HOST must be selected and in order
	 to enable device-specific features PCIE_TEGRA_EP must be selected.
	 This uses the DesignWare core.

if PCIE_TEGRA

config PCIE_TEGRA_HOST
	tristate "PCIE TEGRA Host Mode"
	depends on PCI
	depends on PCI_MSI_IRQ_DOMAIN
	select PCIE_DW_HOST
	default y
	help
	 Say Y here if you want to enable root port mode functionality of the
	 PCIe controllers found in Tegra T19x SoC. Selecting this alone doesn't
	 enable the DMA functionality built into the root port

config PCIE_TEGRA_DW_DMA_TEST
	bool "DMA test framework"
	depends on PCIE_TEGRA_HOST
	help
	 Say Y here if you want to enable test framework for the DMA which is
	 integrated into root port. Please note that this framework should be
	 used only for testing purposes and enabling it would have security
	 implications. If you are not sure, select NO.

config PCIE_TEGRA_EP
	tristate "PCIE TEGRA Endpoint Mode"
	depends on PCI_ENDPOINT
	select PCIE_DW_EP
	help
	 Enables support for the PCIe controller in the Tegra (T19x) SoC
	 to work in endpoint mode.

endif
```

## nvidia/drivers/pci/endpoint/functions/Kconfig
```kconfig
#
# Tegra PCIe Endpoint Test Function
#

config PCIE_EPF_NV_TEST
	tristate "Tegra PCIe Endpoint Test driver"
	depends on PCI_ENDPOINT
	help
	   Enable this configuration option to enable the test driver
	   for Tegra PCIe Endpoint.

	   If in doubt, say "N" to disable Tegra PCIe Endpoint test driver.

config PCIE_EPF_TEGRA_VNET
	tristate "Tegra PCIe Endpoint virtual network driver"
	depends on PCI_ENDPOINT
	help
	   Enable this configuration option to enable the virtual network
	   driver for Tegra PCIe Endpoint.

	   If in doubt, say "N" to disable Tegra PCIe Endpoint virtual
	   network driver.
```

## nvidia/drivers/pci/host/Kconfig
```kconfig
config PCIE_TEGRA_DW
	tristate "NVIDIA Tegra DesignWare Core based PCIe controller"
	depends on ARCH_TEGRA
	select PCIEPORTBUS
	select PCIE_K49_DW
	help
	 Say Y here if you want support for the next gen PCIe host controller
	 which is based on Synopsys DesignWare IP suite found on next gen
	 NVIDIA Tegra SoCs.

config PCIE_TEGRA_DW_DMA_TEST
	bool "DMA test framework"
	depends on PCIE_TEGRA_DW
	help
	 Say Y here if you want to enable test framework for the DMA which is
	 integrated into root port. Please note that this framework should be
	 used only for testing purposes and enabling it would have security
	 implications. If you are not sure, select NO.
```
