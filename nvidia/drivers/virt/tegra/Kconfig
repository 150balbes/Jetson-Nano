## sound/soc/aml/m8/Kconfig
```kconfig
menuconfig SND_AML_M8
	tristate "AML-SND-M8 Board"
	depends on SND_AML_M8_SOC
	select SWITCH
	select SND_SOC_PCM2BT
#	select SND_SOC_AML_M8_CODEC
#	select SND_SOC_RT5616
	select SND_SOC_DUMMY_CODEC
#	select SND_SOC_RT5631
#	select SND_SOC_AMLPMU3 if AML1218
#	select SND_SOC_AMLPMU4 if AML1220
#	select SND_SOC_ES8323

menuconfig SND_ODROID_HDMI
	tristate "ODROID-SND-HDMI card"
	depends on SND_AML_M8_SOC

menuconfig SND_ODROID_DAC
	tristate "ODROID-SND-DAC card"
	depends on SND_AML_M8_SOC
	select SND_SOC_PCM5102

menuconfig SND_ODROID_DAC2
	tristate "ODROID HiFi-Shield2(pcm5242) Support"
	depends on SND_AML_M8_SOC
	select SND_SOC_PCM512x_I2C

menuconfig SND_AML_G9TV
	tristate "AML-SND-G9TV Board"
	depends on SND_AML_M8_SOC && SWITCH
	select SND_SOC_DUMMY_CODEC
	select SND_SOC_AMLPMU4 if AML1220
	select SND_SOC_TAS5707
```
