## nvidia/drivers/virt/tegra/Kconfig
```kconfig
config TEGRA_HV_PM_CTL
	bool "Nvidia Tegra hypervisor PM control"
	depends on TEGRA_HV_MANAGER
	help
	  Nvidia Tegra hypervisor PM control driver handles power state
	  transition commands over IVC channel.

config TEGRA_HV_WDT_HANDLER
	tristate "Nvidia Tegra driver to handle Non privilege guest WDT expiry"
	select NV_TEGRA_IVC
	default n
	help
	  NVIDIA Tegra WDT Expiry handler provides user interface for
	  querying non-privileged guest WDT expiry. User application
	  can take necessary action on receiving guest WDT expiry
	  message. Expiry of the  privileged guest needs to be handled
	  outside Tegra.

config TEGRA_HV_MANAGER
	bool "Nvidia Tegra hypervisor management & IVC"
	depends on TEGRA_VIRTUALIZATION
	select NV_TEGRA_IVC
	help
	  The NVIDIA hypervisor management driver provides IVC channels
	  configured by the hypervisor.

	  Select Y to enable

config	TEGRA_VIRTUALIZATION
	bool "Tegra Virtualization support"
	depends on ARCH_TEGRA_12x_SOC || ARCH_TEGRA_210_SOC || ARCH_TEGRA_18x_SOC
	select VIRTUALIZATION
	default n
	help
	  Enable Tegra Virtualization support; turning this option on
	  enables features like the tegra virtualization manager and
	  all others than depend on it.

	  Select y to enable virtualization features on the tegra platforms
	  that support it.

config TEGRA_HV_SYSFS
	tristate "Nvidia Tegra hypervisor sysfs entries"
	depends on TEGRA_HV_MANAGER
	default y
	help
	  Enable this to allow access via sysfs to hypervisor log, uart relay and
	  PCT data.

	  Can be made a module (=m) to save boot time
	  If unsure, say Y here

config TEGRA_VM_ERR_HANDLER
	tristate "Nvidia Tegra handler for VM error notifications"
	depends on TEGRA_VIRTUALIZATION
	  default y
	help
	  Provides a handler that receives VM error notifications
	  from the Hypervisor.
	    If unsure, keep Y
```

## nvidia/drivers/watchdog/Kconfig
```kconfig
if WATCHDOG

config TEGRA21X_WATCHDOG
	tristate "Tegra T21x watchdog"
	help
	  Say Y here to include support for the watchdog timer
	  embedded in NVIDIA Tegra T210 SoCs.

	  To compile this driver as a module, choose M here: the
	  module will be called tegra21x_wdt.

config TEGRA18X_WATCHDOG
	tristate "Tegra T18x watchdog"
	depends on ARCH_TEGRA_18x_SOC
	help
	  Say Y here to include support for the watchdog timer
	  embedded in NVIDIA Tegra SoCs.

	  To compile this driver as a module, choose M here: the
	  module will be called tegra18x_wdt.

config TEGRA_HV_WATCHDOG
	tristate "Tegra Hypervisor watchdog"
	depends on TEGRA_HV_MANAGER
	help
	  Say Y here to include support for the watchdog timer
	  embedded in NVIDIA Tegra Hypervisor systems.

	  To compile this driver as a module, choose M here: the
	  module will be called tegra_hv_wdt.

config SOFT_PLATFORM_WATCHDOG
	tristate "Software watchdog platform driver"
	select WATCHDOG_CORE
	help 
	  A software monitoring watchdog platform device driver. This will fail to
	  reboot your system from some situations that the hardware watchdog will
	  recover from. Equally it's a lot cheaper to install.

endif
```

## nvidia/nvgpu/drivers/gpu/nvgpu/Kconfig
```kconfig
config GK20A
	tristate "Nvidia GK20A GPU support"
	default y
	help
	  Choose this option if you have an SoC with integrated
	  Nvidia GPU IP.

config GK20A_PMU
	bool "Support GK20A PMU"
	depends on GK20A
	default n
	help
	  Say Y here to enable GK20A PMU features.

choice
	depends on GK20A
	prompt "Enable GK20A frequency scaling"
	default GK20A_DEVFREQ
	optional
	help
	  Select this entry to enable gk20a scaling

config GK20A_DEVFREQ
	depends on COMMON_CLK && PM_DEVFREQ
	bool "Use Devfreq"
	help
	  Select this to use devfreq based scaling.
	  Devfreq is a common framework that allows using
	  variety of different governors and changing
	  between governors on the fly. By default, no
	  governor is selected.

endchoice

config GK20A_PM_QOS
	depends on GK20A_DEVFREQ
	bool "Use PM_QOS constraints for devfreq based scaling"
	default y
	help
	  Enable support to pass PM_QOS constraints to devfreq based
	  scaling.

config GK20A_RDMA
        bool "Support GK20A RDMA"
        depends on GK20A && MMU_NOTIFIER
        default n
        help
          Say Y here to enable GK20A RDMA features.

config NVGPU_TRACK_MEM_USAGE
        bool "Track the usage of system memory in nvgpu"
	depends on GK20A
	default n
	help
	  Say Y here to allow nvgpu to track and keep statistics on
	  the system memory used by the driver. This does recreate
	  some of the kmem_leak tracking but this is also applicable
	  to other OSes which do not have Linux' kmem_leak.


config GK20A_CYCLE_STATS
	bool "Support GK20A GPU CYCLE STATS"
	depends on GK20A
	default y
	help
	  Say Y here to enable the cycle stats debugging features.

config GK20A_CTXSW_TRACE
	bool "Support GK20A Context Switch tracing"
	depends on GK20A
	default y
	help
	  Enable support for the GK20A Context Switch Tracing. In this mode,
	  FECS collects timestamps for contexts loaded on GR engine. This
	  allows tracking context switches on GR engine, as well as
	  identifying processes that submitted work.

config TEGRA_GK20A_NVHOST
	bool "Support interfacing with nvhost hardware"
	depends on TEGRA_GRHOST || TEGRA_HOST1X
	depends on GK20A
	default y
	help
	  Enable support in GK20A for the nvhost (host1x) dma engine hardware
	  that includes things like hardware syncpts. This requires either
	  TEGRA_GRHOST or TEGRA_HOST1X.

config TEGRA_GK20A
	bool "Enable the GK20A GPU on Tegra"
	depends on GK20A
	default y
	help
	  Enable support for the GK20A graphics engine on Tegra
	  by adding a Tegra platfrom interface to the GK20A driver.

config TEGRA_ACR
	bool "Enable HS bin support on GM20B GPU on Tegra"
	depends on GK20A && GK20A_PMU
	default n
	help
	  Enable Support for Loading High Secure binary, and using
	  Write Protected Regions (WPR) for storing ucodes, and bootstrap
	  PMU, FECS and GPCCS in Low Secure mode.

config TEGRA_USE_NA_GPCPLL
	bool "Enable noise aware mode of GM20B GPCPLL on Tegra"
	depends on GK20A
	depends on COMMON_CLK
	default n
	help
	  Enable noise aware (NA) mode of GM20b GPCPLL. In this mode PLL output
	  frequency is automatically adjusted when GM20b voltage is fluctuating
	  because of transient PMIC or power distribution tree noise.

config GK20A_PCI
	bool "Support PCIe NVIDIA GPUs on nvgpu"
	depends on PCI && GK20A
	default y
	help
	  Enable support for GPUs on PCIe bus.

config GK20A_TRACE_PRINTK
	bool "Support trace_printk debugging"
	depends on GK20A && TRACING
	default n
	help
	  Enable nvgpu debug facility to redirect debug spew to ftrace. This
	  affects kernel memory use, so should not be enabled by default.

config GK20A_VIDMEM
	bool "Support separate video memory on nvgpu"
	depends on GK20A
	default n
	help
	  Enable support for using and allocating buffers in a distinct video
	  memory aperture (in contrast to general system memory), available on
	  GPUs that have their own banks. PCIe GPUs have this, for example.

config NVGPU_SUPPORT_CDE
	bool "Support extraction of comptags for CDE"
	depends on GK20A
	default y
	help
	  Enable support for extraction of comptags for CDE.

config NVGPU_USE_TEGRA_ALLOC_FD
	bool "Use tegra_alloc_fd() for allocating dma_buf fds for vidmem"
	depends on GK20A && GK20A_VIDMEM
	default y
	help
	  Use tegra_alloc_fd() for allocating dma_buf fds. This allocates
	  the fds above 1024 which exempts them from counting against process
	  fd limit.

	  It is only available in Tegra kernel.
```

## nvidia/security/tlk_driver/Kconfig
```kconfig
config FIQ
	bool

config FIQ_GLUE
	bool

config TRUSTED_LITTLE_KERNEL
	bool "Enable Open Trusted Execution driver"
	select TEGRA_USE_SECURE_KERNEL
	select FIQ
	select FIQ_GLUE
	help
	  This option adds kernel support for communication with the
	  Trusted LK secure OS monitor/runtime support.
	  If you are unsure how to answer this question, answer N.
```

## nvidia/sound/pci/hda/Kconfig
```kconfig
append_menu "HD-Audio"

config SND_HDA_TEGRA
	tristate "NVIDIA Tegra HD Audio"
	depends on ARCH_TEGRA ||  ARCH_TEGRA_18x_SOC
	select SND_HDA
	help
	  Say Y here to support the HDA controller present in NVIDIA
	  Tegra SoCs

	  This options enables support for the HD Audio controller
	  present in some NVIDIA Tegra SoCs, used to communicate audio
	  to the HDMI output.

	  To compile this driver as a module, choose M here: the module
	  will be called snd-hda-tegra.

endmenu
```

## nvidia/sound/soc/tegra-alt/Kconfig
```kconfig
if SND_SOC

config SND_SOC_TEGRA_ALT_186
	def_bool y
	depends on SND_SOC_TEGRA_ALT
	depends on ARCH_TEGRA_18x_SOC

config SND_SOC_TEGRA186_DSPK_ALT
	tristate
	depends on SND_SOC_TEGRA_ALT && SND_SOC_TEGRA_ALT_186

config SND_SOC_TEGRA186_ASRC_ALT
	tristate
	depends on SND_SOC_TEGRA_ALT && SND_SOC_TEGRA_ALT_186

config SND_SOC_TEGRA186_ARAD_ALT
	tristate
	depends on SND_SOC_TEGRA_ALT && SND_SOC_TEGRA_ALT_186

config SND_SOC_TEGRA_T186REF_P4573_ALT
	tristate "SoC Audio support for P4573 with CS53L30 and RT5658"
	depends on SND_SOC_TEGRA_T186REF_ALT
	select SND_SOC_CS53L30
	select SND_SOC_RT5659
	help
	  Say Y or M here.

config SND_SOC_TEGRA_T186REF_AUTO_ALT
	tristate "SoC Audio support for T186Ref Automotive"
	depends on SND_SOC_TEGRA_T186REF_ALT
	help
	  Say Y or M here.

config SND_SOC_TEGRA186_ARAD_WAR
	def_bool y
	depends on SND_SOC_TEGRA186_ARAD_ALT
	depends on TEGRA186_AHC

config SND_SOC_TEGRA186_ASRC_WAR
	def_bool n
	depends on SND_SOC_TEGRA186_ASRC_ALT
	depends on SND_SOC_TEGRA186_ARAD_WAR

config TEGRA186_ASRC_INT_CLEAR_WAR
	def_bool y
	depends on SND_SOC_TEGRA186_ASRC_ALT

config SND_SOC_TEGRA_ALT
	tristate "Alternative DAPM-based SoC audio support for the Tegra System-on-Chip"
	depends on ARCH_TEGRA
        depends on SND_DMAENGINE_PCM
	select REGMAP_MMIO
	select SND_DYNAMIC_MINORS
	help
	  Say Y or M here if you want support for SoC audio on Tegra, using the
	  alternative driver that exposes to user-space the full routing capabilities
	  of the AHUB (Audio HUB) hardware module.

config SND_SOC_TEGRA_ALT_210
	def_bool y
	depends on SND_SOC_TEGRA_ALT

config SND_SOC_TEGRA210_XBAR_ALT
	tristate
	depends on SND_SOC_TEGRA_ALT && SND_SOC_TEGRA_ALT_210

config SND_SOC_TEGRA210_ADMAIF_ALT
	tristate
	depends on SND_SOC_TEGRA_ALT && SND_SOC_TEGRA_ALT_210

config SND_SOC_TEGRA210_I2S_ALT
	tristate
	depends on SND_SOC_TEGRA_ALT && SND_SOC_TEGRA_ALT_210

config SND_SOC_TEGRA210_DMIC_ALT
	tristate
	def_tristate SND_SOC_TEGRA_ALT && SND_SOC_TEGRA_ALT_210
	depends on SND_SOC_TEGRA_ALT && SND_SOC_TEGRA_ALT_210

config SND_SOC_TEGRA210_AMX_ALT
	tristate
	def_tristate SND_SOC_TEGRA_ALT && SND_SOC_TEGRA_ALT_210
	depends on SND_SOC_TEGRA_ALT && SND_SOC_TEGRA_ALT_210

config SND_SOC_TEGRA210_ADX_ALT
	tristate
	def_tristate SND_SOC_TEGRA_ALT && SND_SOC_TEGRA_ALT_210
	depends on SND_SOC_TEGRA_ALT && SND_SOC_TEGRA_ALT_210

config SND_SOC_TEGRA210_MIXER_ALT
	tristate
	depends on SND_SOC_TEGRA_ALT && SND_SOC_TEGRA_ALT_210

config SND_SOC_TEGRA210_SFC_ALT
	tristate
	depends on SND_SOC_TEGRA_ALT && SND_SOC_TEGRA_ALT_210

config SND_SOC_TEGRA210_AFC_ALT
	tristate
	def_tristate SND_SOC_TEGRA_ALT && SND_SOC_TEGRA_ALT_210
	depends on SND_SOC_TEGRA_ALT && SND_SOC_TEGRA_ALT_210

config SND_SOC_TEGRA210_MVC_ALT
	tristate
	def_tristate SND_SOC_TEGRA_ALT && SND_SOC_TEGRA_ALT_210
	depends on SND_SOC_TEGRA_ALT && SND_SOC_TEGRA_ALT_210

config SND_SOC_TEGRA210_IQC_ALT
	tristate "Tegra210 IQC driver"
	depends on SND_SOC_TEGRA_ALT && SND_SOC_TEGRA_ALT_210
	help
	  Say Y or M if you want to add support for Tegra210 IQC module.

config SND_SOC_TEGRA210_OPE_ALT
	tristate
	def_tristate SND_SOC_TEGRA_ALT && SND_SOC_TEGRA_ALT_210
	depends on SND_SOC_TEGRA_ALT && SND_SOC_TEGRA_ALT_210

config SND_SOC_TEGRA210_ADSP_ALT
	tristate
	depends on SND_SOC_TEGRA_ALT && SND_SOC_TEGRA_ALT_210 && TEGRA_NVADSP
	select SND_SOC_COMPRESS

config DISABLE_ADSP_AUDIO
	bool "Disable ADSP Audio Driver"
	def_bool n
	depends on SND_SOC_TEGRA_ALT && SND_SOC_TEGRA_ALT_210 && TEGRA_NVADSP
	help
	 Say Y if you want to disable support for Tegra210 ADSP module

config SND_SOC_TEGRA_T210REF_ALT
	tristate "SoC Audio support for T210Ref"
	depends on SND_SOC_TEGRA_ALT
	depends on ARCH_TEGRA_210_SOC
	select SND_SOC_TEGRA210_XBAR_ALT
	select SND_SOC_TEGRA210_PCM_ALT
	select SND_SOC_TEGRA210_ADMA_ALT
	select SND_SOC_TEGRA210_ADMAIF_ALT
	select SND_SOC_TEGRA210_I2S_ALT
	select SND_SOC_TEGRA210_DMIC_ALT
	select SND_SOC_TEGRA210_AMX_ALT
	select SND_SOC_TEGRA210_ADX_ALT
	select SND_SOC_TEGRA210_MIXER_ALT
	select SND_SOC_TEGRA210_SFC_ALT
	select SND_SOC_TEGRA210_AFC_ALT
	select SND_SOC_TEGRA210_MVC_ALT
	select SND_SOC_TEGRA210_OPE_ALT
	select SND_SOC_TEGRA210_ADSP_ALT if TEGRA_NVADSP && !DISABLE_ADSP_AUDIO
	select SND_SOC_TEGRA_ASOC_HWDEP_ALT
	select SND_SOC_SPDIF
	select SND_SOC_AD193X_I2C
	help
	  Say Y or M here.

config SND_SOC_TEGRA_T186REF_ALT
	tristate "SoC Audio support for T186Ref"
	depends on SND_SOC_TEGRA_ALT
	depends on ARCH_TEGRA_18x_SOC
	select SND_SOC_TEGRA210_XBAR_ALT
	select SND_SOC_TEGRA210_PCM_ALT
	select SND_SOC_TEGRA210_ADMA_ALT
	select SND_SOC_TEGRA210_ADMAIF_ALT
	select SND_SOC_TEGRA210_I2S_ALT
	select SND_SOC_TEGRA210_DMIC_ALT
	select SND_SOC_TEGRA210_AMX_ALT
	select SND_SOC_TEGRA210_ADX_ALT
	select SND_SOC_TEGRA210_MIXER_ALT
	select SND_SOC_TEGRA210_SFC_ALT
	select SND_SOC_TEGRA210_AFC_ALT
	select SND_SOC_TEGRA210_MVC_ALT
	select SND_SOC_TEGRA210_OPE_ALT
	select SND_SOC_TEGRA210_ADSP_ALT if TEGRA_NVADSP && !DISABLE_ADSP_AUDIO
	select SND_SOC_TEGRA186_ASRC_ALT
	select SND_SOC_TEGRA186_ARAD_ALT
	select SND_SOC_TEGRA186_DSPK_ALT
	select SND_SOC_TEGRA_ASOC_HWDEP_ALT
	select SND_SOC_SPDIF
	select SND_SOC_COMPRESS
	help
	  Say Y or M here.

config SND_SOC_TEGRA210_AUDIO_ALT
	tristate "SoC Audio support for Tegra210"
	depends on I2C
	depends on ARCH_TEGRA_210_SOC || ARCH_TEGRA_18x_SOC
	select SND_SOC_TEGRA210_XBAR_ALT
	select SND_SOC_TEGRA210_PCM_ALT
	select SND_SOC_TEGRA210_ADMA_ALT
	select SND_SOC_TEGRA210_ADMAIF_ALT
	select SND_SOC_TEGRA210_I2S_ALT
	select SND_SOC_TEGRA210_DMIC_ALT
	select SND_SOC_TEGRA210_AMX_ALT
	select SND_SOC_TEGRA210_ADX_ALT
	select SND_SOC_TEGRA210_MIXER_ALT
	select SND_SOC_TEGRA210_SFC_ALT
	select SND_SOC_TEGRA210_AFC_ALT
	select SND_SOC_TEGRA210_MVC_ALT
	select SND_SOC_TEGRA210_OPE_ALT
	select SND_SOC_TEGRA210_ADSP_ALT if TEGRA_NVADSP && !DISABLE_ADSP_AUDIO
	select SND_SOC_TEGRA186_ASRC_ALT if ARCH_TEGRA_18x_SOC
	select SND_SOC_TEGRA186_ARAD_ALT if ARCH_TEGRA_18x_SOC
	select SND_SOC_TEGRA186_DSPK_ALT if ARCH_TEGRA_18x_SOC
	select SND_SOC_SPDIF
	select SND_SOC_COMPRESS
	select SND_SOC_RT5640
	select SND_SOC_RT5659
	select SND_SOC_SGTL5000
	help
	  Say Y or M here if you want to enable support for ASoC machine driver on
	  Tegra210 and successor platforms like Tegra186, Tegra194.

config SND_SOC_TEGRA_T210REF_P2382_ALT
	tristate "SoC Audio support for P2382Ref T210"
	depends on SND_SOC_TEGRA_ALT
	depends on ARCH_TEGRA_210_SOC
	select SND_SOC_TEGRA210_XBAR_ALT
	select SND_SOC_TEGRA210_PCM_ALT
	select SND_SOC_TEGRA210_ADMA_ALT
	select SND_SOC_TEGRA210_ADMAIF_ALT
	select SND_SOC_TEGRA210_I2S_ALT
	select SND_SOC_TEGRA210_AMX_ALT
	select SND_SOC_TEGRA210_ADX_ALT
	select SND_SOC_TEGRA210_MIXER_ALT
	select SND_SOC_TEGRA210_SFC_ALT
	select SND_SOC_TEGRA210_AFC_ALT
	select SND_SOC_TEGRA210_MVC_ALT
	select SND_SOC_TEGRA210_OPE_ALT
	select SND_SOC_TEGRA210_ADSP_ALT if TEGRA_NVADSP && !DISABLE_ADSP_AUDIO
	select SND_SOC_TEGRA_ASOC_HWDEP_ALT
	select SND_SOC_SPDIF
	help
	  Say Y or M here

endif
```
